## CMakeLists.txt
```
cmake_minimum_required(VERSION 3.20.0)
find_package(Zephyr REQUIRED HINTS $ENV{ZEPHYR_BASE})
project(xiao_hci_uart)

target_sources(app PRIVATE src/main.c src/h4_rx.c)
target_include_directories(app PRIVATE ${CMAKE_CURRENT_SOURCE_DIR}/..)

file(CREATE_LINK "${CMAKE_BINARY_DIR}/compile_commands.json"
  "${CMAKE_CURRENT_SOURCE_DIR}/compile_commands.json" SYMBOLIC)

# NCS v3.4.1 initializes only byte 0 and the tail of the next bounce buffer.
# Generate an audited copy with full sentinel initialization. Defer the old/new
# boundary for every successful swap until count and DMA pointer agree across
# a profile-specific 1 us quiet interval; settle first-byte anomaly recovery
# the same way. The guarded SDK source remains unchanged on disk. Host replay
# and diagnostic hardware passes do not qualify the HCI transport.
# The audited source also has an overflowing static swap-threshold initializer.
# main.c calls uart_configure() before RX, replacing that unused threshold
# with 112. Keep assertions; suppress -Woverflow only on this generated copy.
# See docs/development/pb-019-hci-resume-results.md.
set(_uarte_source "${ZEPHYR_BASE}/drivers/serial/uart_nrfx_uarte.c")
file(SHA256 "${_uarte_source}" _uarte_sha256)
if(NOT _uarte_sha256 STREQUAL
    "d68f45fbef9da8077efe6c9f94c609393fc3485bd1d486e4f710288f6d808bd3")
  message(FATAL_ERROR "UARTE source changed: review the HCI compatibility repair")
endif()
find_package(Python3 REQUIRED COMPONENTS Interpreter)
set(_uarte_compat "${CMAKE_BINARY_DIR}/uart_nrfx_uarte_compat.c")
execute_process(COMMAND "${Python3_EXECUTABLE}"
  "${CMAKE_CURRENT_SOURCE_DIR}/../../scripts/patch_ncs_uarte.py"
  "${_uarte_source}" "${_uarte_compat}"
  RESULT_VARIABLE _uarte_result ERROR_VARIABLE _uarte_error)
if(NOT _uarte_result EQUAL 0)
  message(FATAL_ERROR "UARTE compatibility generation failed: ${_uarte_error}")
endif()

get_target_property(_uarte_sources drivers__serial SOURCES)
set(_uarte_new_sources "")
set(_uarte_found 0)
foreach(_source IN LISTS _uarte_sources)
  if(_source MATCHES "(^|/)uart_nrfx_uarte\\.c$")
    math(EXPR _uarte_found "${_uarte_found} + 1")
    list(APPEND _uarte_new_sources "${_uarte_compat}")
  else()
    list(APPEND _uarte_new_sources "${_source}")
  endif()
endforeach()
if(NOT _uarte_found EQUAL 1)
  message(FATAL_ERROR "Expected one UARTE driver in drivers__serial, found ${_uarte_found}")
endif()
set_target_properties(drivers__serial PROPERTIES SOURCES "${_uarte_new_sources}")
target_include_directories(drivers__serial PRIVATE "${ZEPHYR_BASE}/drivers/serial")
if(CMAKE_C_COMPILER_ID STREQUAL "GNU")
  set_source_files_properties("${_uarte_compat}" TARGET_DIRECTORY drivers__serial
    PROPERTIES COMPILE_OPTIONS -Wno-overflow)
endif()
```

## prj.conf
```kconfig
# Single-core XIAO nRF54L15 Linux HCI central. UART carries binary H4 only.
# NCS 3.4.1: unused deprecated platform alias; SOC_SERIES_NRF54L remains enabled.
CONFIG_NRF_PLATFORM_LUMOS=n
CONFIG_CONSOLE=n
CONFIG_STDOUT_CONSOLE=n
CONFIG_UART_CONSOLE=n
CONFIG_LOG=n
CONFIG_GPIO=y
CONFIG_SERIAL=y
CONFIG_UART_ASYNC_API=y
# NCS v3.3.0 TIMER-backed initialization declares its runtime swap state
# unconditionally; enabling the supported runtime path initializes that state
# and avoids the SDK's unused-variable diagnostic without suppressing warnings.
CONFIG_UART_USE_RUNTIME_CONFIGURE=y
# TIMER-backed continuous RX avoids the interrupt-driven one-byte DMA gap.
CONFIG_UART_NRFX_UARTE_BOUNCE_BUF_LEN=1024
# Measured 600 us was insufficient under active CIS scheduling (driver
# assertion at uart_nrfx_uarte.c:1270). Reserve 4 ms of the 5.12 ms half-buffer
# wire time for high-priority controller work before a DMA buffer switch.
CONFIG_UART_NRFX_UARTE_BOUNCE_BUF_SWAP_LATENCY=4000
CONFIG_ASSERT=y
CONFIG_BT_CTLR_ASSERT_HANDLER=y
CONFIG_MAIN_STACK_SIZE=2048

CONFIG_BT=y
CONFIG_BT_HCI_RAW=y
CONFIG_BT_HCI_RAW_H4=y
CONFIG_BT_HCI_RAW_H4_ENABLE=y
CONFIG_BT_LL_SOFTDEVICE=y
CONFIG_BT_MAX_CONN=1
CONFIG_BT_PERIPHERAL=n
CONFIG_BT_CENTRAL=y
# Linux queries advertising-set capacity when Extended Advertising is
# advertised for scanning. SDC must implement that command even though this
# fixture never accepts peripheral connections or starts advertising.
CONFIG_BT_BROADCASTER=y
CONFIG_BT_ISO_CENTRAL=y
CONFIG_BT_ISO_MAX_CHAN=2
CONFIG_BT_ISO_TX_BUF_COUNT=6
CONFIG_BT_ISO_TX_MTU=255
CONFIG_BT_CTLR_CONN_ISO_GROUPS=1
CONFIG_BT_CTLR_CONN_ISO_STREAMS=2
CONFIG_BT_CTLR_CONN_ISO_STREAMS_PER_GROUP=2
CONFIG_BT_CTLR_SDC_PERIPHERAL_COUNT=0
CONFIG_BT_CTLR_SDC_ISO_TX_HCI_BUFFER_COUNT=6
CONFIG_BT_CTLR_SDC_ISO_TX_PDU_BUFFER_PER_STREAM_COUNT=6
CONFIG_BT_EXT_ADV=y
CONFIG_BT_CTLR_PHY_CODED=n
CONFIG_BT_CTLR_PRIVACY=y
CONFIG_BT_BUF_EVT_RX_SIZE=255
CONFIG_BT_BUF_ACL_RX_SIZE=255
CONFIG_BT_BUF_ACL_TX_SIZE=251
CONFIG_BT_BUF_CMD_TX_SIZE=255
```

## app.conf
```kconfig
# nRF5340DK hci_uart app-core (cpuapp) configuration fragment.
#
# This fragment is applied on top of the upstream Zephyr hci_uart sample
# (~/ncs/<ver>/zephyr/samples/bluetooth/hci_uart) via
# `-Dhci_uart_EXTRA_CONF_FILE=<this file>`. The sample's own
# boards/nrf5340dk_nrf5340_cpuapp.conf already enables ISO central with
# 18 ISO TX buffers and UART0 @ 1 Mbaud + HW flow control; the lines below
# re-assert the load-bearing ISO symbols so the dongle build is pinned
# against this repo and does not silently regress if the sample's board
# conf changes in a future NCS version.
#
# Built with: fw-build-dongle   (see scripts/bin/fw-build-dongle)

# Connected ISO (central side) — needed so BlueZ can establish CISes for
# LE Audio unicast. Selects BT_ISO / BT_ISO_TX / BT_ISO_RX upstream.
CONFIG_BT_ISO_CENTRAL=y

# Keep the ISO channel/buffer counts aligned with the netcore controller
# (dongle/netcore.conf sets BT_CTLR_CONN_ISO_STREAMS=2). Two CISes for the
# Mode A stereo sink (one per channel).
CONFIG_BT_ISO_MAX_CHAN=4
CONFIG_BT_ISO_TX_BUF_COUNT=18
CONFIG_BT_ISO_RX_BUF_COUNT=1

# Extended advertising is required by the receiver (it advertises with
# BT_LE_ADV_OPT_EXT_ADV); without this the controller drops the adv
# reports and discovery never sees the receiver.
CONFIG_BT_EXT_ADV=y
```

## netcore.conf
```kconfig
# nRF5340DK hci_uart net-core (cpunet / hci_ipc) configuration fragment.
#
# Applied to the hci_ipc child image via
# `-Dhci_ipc_EXTRA_CONF_FILE=<this file>` when building the dongle with
# fw-build-dongle. This is the SoftDevice Controller (SDC) configuration
# that makes the controller usable as an LE Audio central for the
# receiver.
#
# Built with: fw-build-dongle   (see scripts/bin/fw-build-dongle)

# Connected ISO central — pulls in BT_CTLR_CENTRAL_ISO / BT_CTLR_CONN_ISO
# on the SDC side so CISes can be established and ISO data flows.
CONFIG_BT_ISO_CENTRAL=y

# RAM-conscious connection/ISO slot counts. The defaults balloon to 16
# connections and overflow cpunet RAM by ~20 KB; two connections and two
# CISes per group are enough for one stereo unicast sink (Mode A = two
# mono CISes, one per channel).
CONFIG_BT_MAX_CONN=2
CONFIG_BT_CTLR_CONN_ISO_STREAMS=2
CONFIG_BT_CTLR_CONN_ISO_STREAMS_PER_GROUP=2

# One peripheral slot — we only ever connect to the single receiver.
CONFIG_BT_CTLR_SDC_PERIPHERAL_COUNT=1

# Extended advertising support. The receiver advertises with
# BT_LE_ADV_OPT_EXT_ADV; without this the controller cannot report it and
# discovery fails.
CONFIG_BT_EXT_ADV=y

# Linux 7.1 issues extended scan parameters with PHYs=0x05 (1M + Coded,
# active scan on both). The SDC controller strictly rejects active
# scanning on the Coded PHY (HCI error 0x11 Unsupported Feature), which
# kills discovery entirely. Disable Coded so the scan PHY set collapses
# to 1M/2M only.
CONFIG_BT_CTLR_PHY_CODED=n

# Drop LL privacy so the kernel does not enable address resolution —
# keeps the connect path as simple as possible for a test central.
CONFIG_BT_CTLR_PRIVACY=n
```

## app.overlay
```dts
/ {
	chosen {
		zephyr,bt-c2h-uart = &uart20;
		/delete-property/ zephyr,console;
		/delete-property/ zephyr,shell-uart;
	};
};

/* The stock SAMD11 bridge connects only TX/RX. No fictitious RTS/CTS. */
&uart20 {
	current-speed = <1000000>;
	/delete-property/ hw-flow-control;
	timer = <&timer21>;
};

/* Owned directly by the UART driver, not the counter driver or MPSL. */
&timer21 {
	status = "disabled";
};
```

## src/main.c
```c
/* SPDX-License-Identifier: MIT
 * Continuous DMA H4 bridge for the XIAO's two-wire stock CDC UART.
 * UART callbacks only copy bytes and transfer DMA-buffer ownership. Packet
 * allocation/controller submission run in a thread, never the UART ISR.
 */
#include <errno.h>
#include <zephyr/kernel.h>
#include <zephyr/device.h>
#include <zephyr/drivers/uart.h>
#include <zephyr/sys/atomic.h>
#include <zephyr/sys/ring_buffer.h>
#include <zephyr/bluetooth/controller.h>
#include <zephyr/bluetooth/hci_raw.h>
#include <zephyr/bluetooth/hci_types.h>
#include <zephyr/bluetooth/buf.h>

#include "hci_identity.h"
#include "h4_rx.h"

BUILD_ASSERT(DT_NODE_HAS_PROP(DT_CHOSEN(zephyr_bt_c2h_uart), timer),
	     "No-flow RX requires hardware byte counting");

static const struct device *const uart = DEVICE_DT_GET(DT_CHOSEN(zephyr_bt_c2h_uart));
static uint8_t dma_buffers[2][512] __aligned(4);
static atomic_t dma_owned;
/* SPSC: the UART ISR produces, the host-to-controller thread consumes. */
RING_BUF_DECLARE(rx_ring, 8192);
K_SEM_DEFINE(rx_ready, 0, 1);
K_SEM_DEFINE(tx_done, 0, 1);
K_FIFO_DEFINE(controller_rx);
K_THREAD_STACK_DEFINE(h2c_stack, CONFIG_BT_HCI_TX_STACK_SIZE);
static struct k_thread h2c_thread;
static struct h4_rx parser;
static atomic_t bridge_fault;
/* Retain fatal provenance for SWD without corrupting the binary H4 UART. */
const char *volatile bridge_assert_file;
volatile unsigned int bridge_assert_line;

void assert_post_action(const char *file, unsigned int line)
{
	bridge_assert_file = file;
	bridge_assert_line = line;
	k_panic();
}

void bt_ctlr_assert_handle(char *file, uint32_t line)
{
	assert_post_action(file, line);
}

static void fail(unsigned int code)
{
	(void)atomic_cas(&bridge_fault, 0, code);
	k_sem_give(&rx_ready);
}

static void uart_event(const struct device *dev, struct uart_event *event, void *user)
{
	ARG_UNUSED(user);
	switch (event->type) {
	case UART_RX_RDY: {
		const uint8_t *data = event->data.rx.buf + event->data.rx.offset;
		size_t len = event->data.rx.len;
		if (ring_buf_put(&rx_ring, data, len) != len) {
			fail(1);
		}
		k_sem_give(&rx_ready);
		break;
	}
	case UART_RX_BUF_REQUEST:
		for (unsigned int i = 0; i < ARRAY_SIZE(dma_buffers); i++) {
			if (!atomic_test_and_set_bit(&dma_owned, i)) {
				if (uart_rx_buf_rsp(dev, dma_buffers[i], sizeof(dma_buffers[i]))) {
					atomic_clear_bit(&dma_owned, i);
					fail(2);
				}
				return;
			}
		}
		fail(3);
		break;
	case UART_RX_BUF_RELEASED:
		for (unsigned int i = 0; i < ARRAY_SIZE(dma_buffers); i++) {
			if (event->data.rx_buf.buf == dma_buffers[i]) {
				atomic_clear_bit(&dma_owned, i);
				return;
			}
		}
		fail(4);
		break;
	case UART_RX_STOPPED:
	case UART_RX_DISABLED:
		fail(5);
		break;
	case UART_TX_ABORTED:
		fail(6);
		k_sem_give(&tx_done);
		break;
	case UART_TX_DONE:
		k_sem_give(&tx_done);
		break;
	default:
		break;
	}
}

static int submit(uint8_t type, const uint8_t *data, size_t len, void *user)
{
	ARG_UNUSED(user);
	/* HCI packet credits bound queued traffic. Wait in thread context for
	 * storage without ever losing the payload or changing parser position. */
	struct net_buf *buf =
		bt_buf_get_tx(bt_buf_type_from_h4(type, BT_BUF_OUT), K_FOREVER, NULL, 0);
	if (buf == NULL) {
		return -ENOMEM;
	}
	if (len > net_buf_tailroom(buf)) {
		net_buf_unref(buf);
		return -EMSGSIZE;
	}
	net_buf_add_mem(buf, data, len);
	int err = bt_send(buf);
	if (err) {
		net_buf_unref(buf);
	}
	return err;
}

static void receive(void *a, void *b, void *c)
{
	ARG_UNUSED(a);
	ARG_UNUSED(b);
	ARG_UNUSED(c);
	uint8_t chunk[128];
	while (!atomic_get(&bridge_fault)) {
		k_sem_take(&rx_ready, K_FOREVER);
		uint32_t count;
		while (!atomic_get(&bridge_fault) &&
		       (count = ring_buf_get(&rx_ring, chunk, sizeof(chunk))) != 0) {
			if (h4_rx_feed(&parser, chunk, count, submit, NULL)) {
				fail(7);
			}
			k_yield();
		}
	}
}

static int transmit(const uint8_t *data, size_t len)
{
	k_sem_reset(&tx_done);
	int err = uart_tx(uart, data, len, SYS_FOREVER_US);
	return err ? err : k_sem_take(&tx_done, K_SECONDS(1));
}

int main(void)
{
	if (!device_is_ready(uart) || uart_callback_set(uart, uart_event, NULL)) {
		k_panic();
	}
	/* NCS v3.3.0 statically converts the CBWT baud rate to bytes twice,
	 * then overwrites the correctly computed runtime swap threshold during
	 * initialization. Reapply the exact current configuration while RX is
	 * inactive: baudrate_set() restores the intended latency headroom.
	 * On this 1 Mbaud / 512-byte-half / 4000 us setup it is 112, not 502.
	 * No SDK source patch or assertion suppression is required. The exact
	 * SDK static-initializer warning is documented/scoped in CMakeLists. */
	struct uart_config uart_config;
	if (uart_config_get(uart, &uart_config) || uart_configure(uart, &uart_config)) {
		k_panic();
	}
	bt_ctlr_set_public_addr(dongle_bd_addr);
	if (bt_enable_raw(&controller_rx)) {
		k_panic();
	}
	h4_rx_init(&parser);
	atomic_set_bit(&dma_owned, 0);
	if (uart_rx_enable(uart, dma_buffers[0], sizeof(dma_buffers[0]), 1000)) {
		k_panic();
	}
	k_thread_create(&h2c_thread, h2c_stack, K_THREAD_STACK_SIZEOF(h2c_stack), receive, NULL,
			NULL, NULL, K_PRIO_COOP(7), 0, K_NO_WAIT);
	for (;;) {
		unsigned int fault = atomic_get(&bridge_fault);
		if (fault) {
			/* Fail visibly. Do not silently resynchronize through audio
			 * bytes, drop packets, or restart and claim an intact run. */
			uint8_t event[] = {BT_HCI_H4_EVT, BT_HCI_EVT_HARDWARE_ERROR, 1, fault};
			(void)transmit(event, sizeof(event));
			(void)uart_rx_disable(uart);
			k_panic();
		}
		struct net_buf *buf = k_fifo_get(&controller_rx, K_MSEC(20));
		if (buf) {
			int err = transmit(buf->data, buf->len);
			net_buf_unref(buf);
			if (err) {
				fail(8);
			}
		}
	}
}
```

## src/h4_rx.c
```c
/* SPDX-License-Identifier: MIT */
#include "h4_rx.h"

#include <errno.h>
#include <string.h>

void h4_rx_init(struct h4_rx *rx)
{
	memset(rx, 0, sizeof(*rx));
}

int h4_rx_feed(struct h4_rx *rx, const uint8_t *data, size_t len, h4_packet_fn deliver, void *user)
{
	if (rx == NULL || deliver == NULL || (data == NULL && len != 0)) {
		return -EINVAL;
	}
	if (rx->error) {
		return rx->error;
	}
	for (size_t i = 0; i < len; i++) {
		if (rx->type == 0) {
			switch (data[i]) {
			case 1:
				rx->header_size = 3;
				break; /* Command */
			case 2:        /* ACL */
			case 5:
				rx->header_size = 4;
				break; /* ISO */
			default:
				rx->error = -EPROTO;
				return rx->error;
			}
			rx->type = data[i];
			rx->used = 0;
			rx->expected = rx->header_size;
			continue;
		}
		rx->frame[rx->used++] = data[i];
		if (rx->used == rx->header_size) {
			size_t payload = rx->frame[2];
			if (rx->type != 1) {
				payload |= (size_t)rx->frame[3] << 8;
				if (rx->type == 5) {
					payload &= 0x3fffU;
				}
			}
			if (payload > sizeof(rx->frame) - rx->header_size) {
				rx->error = -EMSGSIZE;
				return rx->error;
			}
			rx->expected += payload;
		}
		if (rx->used == rx->expected) {
			int err = deliver(rx->type, rx->frame, rx->used, user);
			if (err) {
				rx->error = err;
				return err;
			}
			rx->type = 0;
		}
	}
	return 0;
}
```

## src/h4_rx.h
```c
/* SPDX-License-Identifier: MIT */
#ifndef DONGLE_H4_RX_H
#define DONGLE_H4_RX_H

#include <stddef.h>
#include <stdint.h>

/* Bound above the configured 255-byte HCI data payloads, including headers. */
#define H4_RX_FRAME_MAX 1028U

struct h4_rx {
	uint8_t type;
	uint8_t header_size;
	size_t used;
	size_t expected;
	int error;
	uint8_t frame[H4_RX_FRAME_MAX];
};

typedef int (*h4_packet_fn)(uint8_t type, const uint8_t *packet, size_t len, void *user);

void h4_rx_init(struct h4_rx *rx);
/* Feed any fragmentation of an H4 byte stream. Packet excludes the H4 type.
 * Invalid framing or delivery failure latches an error until explicit reset;
 * never scan arbitrary payload bytes as possible new packet boundaries. */
int h4_rx_feed(struct h4_rx *rx, const uint8_t *data, size_t len, h4_packet_fn deliver, void *user);

#endif
```
