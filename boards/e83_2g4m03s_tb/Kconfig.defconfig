## boards/e83_2g4m03s_tb/Kconfig.defconfig
```kconfig
# E83-2G4M03S Test Board (10414-PCB-V1.2) — nRF5340 board configuration

# Copyright (c) 2019-2020 Nordic Semiconductor ASA
# SPDX-License-Identifier: Apache-2.0

config HW_STACK_PROTECTION
	default ARCH_HAS_STACK_PROTECTION

if BOARD_E83_2G4M03S_TB_NRF5340_CPUAPP || BOARD_E83_2G4M03S_TB_NRF5340_CPUAPP_NS

if BOARD_E83_2G4M03S_TB_NRF5340_CPUAPP && TRUSTED_EXECUTION_SECURE

# Workaround for not being able to have commas in macro arguments
DT_CHOSEN_Z_SRAM_PARTITION := zephyr,sram-secure-partition

config SRAM_SIZE
	default $(dt_chosen_reg_size_int,$(DT_CHOSEN_Z_SRAM_PARTITION),0,K)

endif # BOARD_E83_2G4M03S_TB_NRF5340_CPUAPP && TRUSTED_EXECUTION_SECURE

config BOARD_E83_2G4M03S_TB
	select USE_DT_CODE_PARTITION if BOARD_E83_2G4M03S_TB_NRF5340_CPUAPP_NS

config BT_HCI_IPC
	default y if BT_HCI

config HEAP_MEM_POOL_ADD_SIZE_BOARD
	int
	default 4096 if BT_HCI_IPC

endif # BOARD_E83_2G4M03S_TB_NRF5340_CPUAPP || BOARD_E83_2G4M03S_TB_NRF5340_CPUAPP_NS
```

## boards/e83_2g4m03s_tb/board.yml
```yaml
board:
  name: e83_2g4m03s_tb
  full_name: E83-2G4M03S Test Board (10414-PCB-V1.2)
  vendor: ebyte
  socs:
  - name: 'nrf5340'
    variants:
    - name: 'ns'
      cpucluster: 'cpuapp'
```

## boards/ebyte/e83_nrf5340/Kconfig.defconfig
```kconfig
# SPDX-License-Identifier: Apache-2.0

config HW_STACK_PROTECTION
	default ARCH_HAS_STACK_PROTECTION

if BOARD_EBYTE_E83_NRF5340_NRF5340_CPUAPP

config BT_HCI_IPC
	default y if BT_HCI

config HEAP_MEM_POOL_ADD_SIZE_BOARD
	int
	default 4096 if BT_HCI_IPC

endif # BOARD_EBYTE_E83_NRF5340_NRF5340_CPUAPP
```

## boards/ebyte/e83_nrf5340/Kconfig.ebyte_e83_nrf5340
```kconfig
# SPDX-License-Identifier: Apache-2.0

config BOARD_EBYTE_E83_NRF5340
	select SOC_NRF5340_CPUAPP_QKAA if BOARD_EBYTE_E83_NRF5340_NRF5340_CPUAPP
	select SOC_NRF5340_CPUNET_QKAA if BOARD_EBYTE_E83_NRF5340_NRF5340_CPUNET
```

## boards/ebyte/e83_nrf5340/board.yml
```yaml
board:
  name: ebyte_e83_nrf5340
  full_name: Ebyte E83-2G4M03S nRF5340
  vendor: ebyte
  socs:
  - name: 'nrf5340'
```

## tests/bsim/testcase.yaml
```yaml
tests:
  bsim.le_audio_receiver:
    platform_allow: nrf54l15bsim/nrf54l15/cpuapp
    integration_platforms:
      - nrf54l15bsim/nrf54l15/cpuapp
    tags: bluetooth audio bap bsim
    build_only: false
    extra_configs:
      - CONFIG_BT_TESTING=y
```

## tests/unit/actuator/testcase.yaml
```yaml
tests:
  unit.actuator:
    platform_allow: native_sim/native/64
    tags: audio actuator sample_adjust
```

## tests/unit/actuator_apll/testcase.yaml
```yaml
tests:
  unit.actuator_apll:
    platform_allow: native_sim/native/64
    tags: audio actuator apll
```

## tests/unit/actuator_apll_nohfclk/testcase.yaml
```yaml
tests:
  unit.actuator_apll_nohfclk:
    platform_allow: native_sim/native/64
    tags: audio actuator apll nohfclkaudio
```

## tests/unit/actuator_none/testcase.yaml
```yaml
tests:
  unit.actuator_none:
    platform_allow: native_sim/native/64
    tags: audio actuator none
```

## tests/unit/actuator_sample_adjust_historical/testcase.yaml
```yaml
tests:
  unit.actuator_sample_adjust_historical:
    platform_allow: native_sim/native/64
    tags: audio actuator sample_adjust historical retired
```

## tests/unit/app_lifecycle/testcase.yaml
```yaml
tests:
  unit.app_lifecycle:
    platform_allow: native_sim/native/64
    tags: audio lifecycle boot
```

## tests/unit/audio_i2s/testcase.yaml
```yaml
tests:
  unit.audio_i2s:
    platform_allow: native_sim/native/64
    tags: audio i2s asrc
```

## tests/unit/audio_i2s_common/dts/bindings/i2s/vnd,audio-i2s-fake.yaml
```yaml
# Copyright (c) 2025
# SPDX-License-Identifier: Apache-2.0

compatible: "vnd,audio-i2s-fake"

description: |
  Test-only fake I2S controller driver with nrfx-style TX block
  ownership.  Only used by the audio_i2s unit suites; never present
  in production firmware.

include: [i2s-controller.yaml]

properties: {}
```

## tests/unit/audio_i2s_identity/testcase.yaml
```yaml
tests:
  unit.audio_i2s_identity:
    platform_allow: native_sim/native/64
    tags: audio i2s identity
```

## tests/unit/audio_shell/testcase.yaml
```yaml
tests:
  unit.audio_shell:
    platform_allow: native_sim/native/64
    tags: audio shell diagnostics
```

## tests/unit/audio_shell_noperf/testcase.yaml
```yaml
tests:
  unit.audio_shell_noperf:
    platform_allow: native_sim/native/64
    tags: audio shell diagnostics
```

## tests/unit/audio_shell_nrf54/testcase.yaml
```yaml
tests:
  unit.audio_shell_nrf54:
    platform_allow: native_sim/native/64
    tags: audio shell diagnostics flpr
```

## tests/unit/audio_stream_session/testcase.yaml
```yaml
tests:
  unit.audio_stream_session:
    platform_allow: native_sim/native/64
    integration_platforms:
      - native_sim/native/64
    tags: audio session
```

## tests/unit/bt_bap_pairing_adapter/testcase.yaml
```yaml
tests:
  audio.bt_bap_pairing_adapter:
    platform_allow: native_sim/native/64
    integration_platforms:
      - native_sim/native/64
```
