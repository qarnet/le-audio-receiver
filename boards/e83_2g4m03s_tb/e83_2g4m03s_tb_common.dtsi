/*
 * Copyright (c) 2020 Nordic Semiconductor ASA
 *
 * SPDX-License-Identifier: Apache-2.0
 *
 * E83-2G4M03S Test Board (10414-PCB-V1.2) — shared peripherals across cores.
 *
 * This board has no LEDs, no buttons (except HW RESET), no Arduino header,
 * and no QSPI flash. The 32.768 kHz crystal uses external 12 pF load caps.
 */

/ {
	aliases {
		watchdog0 = &wdt0;
	};
};
