## CMakeLists.txt
```
# SPDX-License-Identifier: Apache-2.0
cmake_minimum_required(VERSION 3.20.0)
set(CMAKE_EXPORT_COMPILE_COMMANDS ON)
# Native BSim peers are ELF32; align initial CMake probes with verified 32-bit library paths.
set(CMAKE_C_FLAGS_INIT "${CMAKE_C_FLAGS_INIT} -m32")
set(CMAKE_CXX_FLAGS_INIT "${CMAKE_CXX_FLAGS_INIT} -m32")
set(CMAKE_ASM_FLAGS_INIT "${CMAKE_ASM_FLAGS_INIT} -m32")
# CMake capability probes provide main but may link with -nostdlib.
# Give those probe links an entry point without changing final targets.
# CMAKE_REQUIRED_LINK_OPTIONS is consumed only by try_compile checks.
list(APPEND CMAKE_REQUIRED_LINK_OPTIONS "-Wl,--entry=main")
find_package(Zephyr REQUIRED HINTS $ENV{ZEPHYR_BASE})
project(bap_unicast_client_bsim)

# ── BSIM entry point ────────────────────────────────────────────────
target_sources(app PRIVATE
  ${CMAKE_CURRENT_SOURCE_DIR}/src/main.c
)

# ── Repo-owned deterministic multi-channel TX (real BAP send with
#    checked-in LC3 corpus frames) ─────────────────────────────────────
target_sources(app PRIVATE
  ${CMAKE_CURRENT_SOURCE_DIR}/src/bsim_tx.c
)

# Embed only the four fixed BSim LC3 corpus streams.  file2hex emits raw
# initializer bytes; bsim_tx.c owns the array names and selects frames by
# logical sequence.
set(lc3_fixture_dir ${CMAKE_CURRENT_SOURCE_DIR}/../../fixtures/lc3)
set(lc3_fixture_inc_dir ${ZEPHYR_BINARY_DIR}/include/generated)
generate_inc_file_for_target(
  app
  ${lc3_fixture_dir}/bsim_48k_10ms_120b_l.lc3
  ${lc3_fixture_inc_dir}/bsim_48k_10ms_120b_l.lc3.inc
)
generate_inc_file_for_target(
  app
  ${lc3_fixture_dir}/bsim_48k_10ms_120b_r.lc3
  ${lc3_fixture_inc_dir}/bsim_48k_10ms_120b_r.lc3.inc
)
generate_inc_file_for_target(
  app
  ${lc3_fixture_dir}/bsim_48k_7p5ms_90b_l.lc3
  ${lc3_fixture_inc_dir}/bsim_48k_7p5ms_90b_l.lc3.inc
)
generate_inc_file_for_target(
  app
  ${lc3_fixture_dir}/bsim_48k_7p5ms_90b_r.lc3
  ${lc3_fixture_inc_dir}/bsim_48k_7p5ms_90b_r.lc3.inc
)

# ── BSIM test installer (one test_id per T4 scenario) ────────────────
target_sources(app PRIVATE
  ${CMAKE_CURRENT_SOURCE_DIR}/src/bsim_client_main.c
)

# ── Include paths ──────────────────────────────────────────────────
target_include_directories(app PRIVATE
  ${CMAKE_CURRENT_SOURCE_DIR}/src
)

# BSIM component headers — needed for bs_types.h, bs_tracing.h, etc.
zephyr_include_directories(
  ${BSIM_COMPONENTS_PATH}/libUtilv1/src/
  ${BSIM_COMPONENTS_PATH}/libPhyComv1/src/
)

# LSP compile-database link: expose this BSim client image's
# compile_commands.json at the app root for clangd closest-ancestor
# discovery.  Absolute target (build tree lives in the shared SDK
# bsim_out); scripts/gen-lsp-links.sh can also repair it.
file(CREATE_LINK
     "${CMAKE_BINARY_DIR}/compile_commands.json"
     "${CMAKE_CURRENT_SOURCE_DIR}/compile_commands.json"
     SYMBOLIC)
```

## Kconfig
```
# BSIM client Kconfig — minimal symbols for the parameterized client.
mainmenu "LE Audio Client — BSIM"

config INFO_REPORTING_INTERVAL
	int "Number of SDUs between log reports"
	default 0

source "Kconfig.zephyr"
```

## Kconfig.sysbuild
```
# Copyright (c) 2025
# SPDX-License-Identifier: Apache-2.0

source "share/sysbuild/Kconfig"

config NATIVE_SIMULATOR_PRIMARY_MCU_INDEX
	int
	default 0 if $(BOARD_TARGET_STRING) = "NRF54L15BSIM_NRF54L15_CPUAPP"
```

## prj.conf
```kconfig
# BSIM parameterized client — up to two TX streams, source discovery.
# NCS 3.4.1: unused deprecated platform alias; SOC_SERIES_NRF54L remains enabled.
CONFIG_NRF_PLATFORM_LUMOS=n
CONFIG_BT=y
CONFIG_LOG=y
CONFIG_BT_SMP=y
CONFIG_BT_CENTRAL=y
CONFIG_BT_ISO_CENTRAL=y
CONFIG_BT_GATT_CLIENT=y
CONFIG_BT_GATT_AUTO_DISCOVER_CCC=y
CONFIG_BT_GATT_AUTO_UPDATE_MTU=y
CONFIG_UTF8=y
CONFIG_BT_AUDIO=y
CONFIG_BT_BAP_UNICAST_CLIENT=y

# Client ASE counts: 3 sink-direction eps (discover 3 server sink ASEs for
# the NO_MEM scenario), 2 source-direction eps (up to two TX streams for
# Mode A).  SRC_COUNT must be 0 or >=2 (upstream BUILD_ASSERT); SNK_COUNT=3
# also selects BT_AUDIO_TX.
CONFIG_BT_BAP_UNICAST_CLIENT_ASE_SNK_COUNT=3
CONFIG_BT_BAP_UNICAST_CLIENT_ASE_SRC_COUNT=2
CONFIG_BT_BAP_UNICAST_CLIENT_GROUP_STREAM_COUNT=2

# ISO TX: up to two streams, three enqueued buffers per stream under SW Split
# completion timing (Number of Completed Packets arrives one ISO interval later).
# Up to 240-byte Mode B SDUs (2 x 120) within 255-byte MTU.
CONFIG_BT_ISO_MAX_CHAN=2
CONFIG_BT_ISO_TX_BUF_COUNT=6
CONFIG_BT_ISO_TX_MTU=255

CONFIG_BT_EXT_ADV=y
CONFIG_BT_KEYS_OVERWRITE_OLDEST=y

# ACL/ISO buffer sizes
CONFIG_BT_BUF_EVT_RX_SIZE=255
CONFIG_BT_BUF_EVT_RX_COUNT=16
CONFIG_BT_BUF_ACL_RX_SIZE=255
CONFIG_BT_BUF_ACL_TX_SIZE=251
CONFIG_BT_BUF_CMD_TX_SIZE=255
CONFIG_BT_BUF_ACL_TX_COUNT=3
CONFIG_BT_CONN_TX_MAX=3

# BSIM test framework
CONFIG_BT_TESTING=y
CONFIG_TEST=y

CONFIG_ASSERT=y
CONFIG_LOG_MODE_IMMEDIATE=y
CONFIG_LOG_PRINTK=y

CONFIG_INFO_REPORTING_INTERVAL=0
```

## overlay-bt_ll_sw_split.conf
```kconfig
CONFIG_BT_LL_SW_SPLIT=y
CONFIG_BT_CTLR_ASSERT_HANDLER=y
CONFIG_BT_CTLR_DATA_LENGTH_MAX=251
CONFIG_BT_CTLR_SCAN_DATA_LEN_MAX=191
CONFIG_BT_CTLR_CENTRAL_ISO=y
CONFIG_BT_CTLR_CONN_ISO_GROUPS=1
CONFIG_BT_CTLR_CONN_ISO_STREAMS=2
CONFIG_BT_CTLR_CONN_ISO_STREAMS_PER_GROUP=2
CONFIG_BT_CTLR_CONN_ISO_PDU_LEN_MAX=251
CONFIG_BT_CTLR_CONN_ISO_RELIABILITY_POLICY=y
CONFIG_BT_CTLR_ISO_TX_BUFFERS=6
CONFIG_BT_CTLR_ISO_TX_BUFFER_SIZE=255
CONFIG_BT_CTLR_ISO_TX_SDU_LEN_MAX=255
CONFIG_BT_CTLR_ISO_RX_BUFFERS=1
CONFIG_BT_CTLR_ISOAL_SOURCES=2
CONFIG_BT_CTLR_ISOAL_SINKS=1
CONFIG_ASSERT=y
```

## overlay-nrf5340_cpunet_iso-bt_ll_sw_split.conf
```kconfig
# Extra controller config for client bsim netcore
# Central ISO TX needs >=120 bytes SDU for 48_4_1 preset
CONFIG_BT_ISO_TX_BUF_COUNT=4
CONFIG_BT_CTLR_ISO_TX_BUFFERS=4
CONFIG_BT_CTLR_ISO_TX_BUFFER_SIZE=255
CONFIG_BT_CTLR_ISO_TX_SDU_LEN_MAX=255

# ISO RX (not needed for source-only client, but keep small)
CONFIG_BT_CTLR_ISO_RX_BUFFERS=1
CONFIG_BT_CTLR_ISOAL_SOURCES=1
CONFIG_BT_CTLR_ISOAL_SINKS=1

CONFIG_BT_CTLR_CONN_ISO_STREAMS=2
CONFIG_BT_CTLR_CONN_ISO_STREAMS_PER_GROUP=2
CONFIG_BT_CTLR_CONN_ISO_PDU_LEN_MAX=251
CONFIG_ASSERT=y
```

## src/main.c
```c
/*
 * Copyright (c) 2025
 * SPDX-License-Identifier: Apache-2.0
 *
 * BSIM valid-LC3 client — main entry point.
 */

#include <bstests.h>
#include <zephyr/kernel.h>

void bt_ctlr_assert_handle(char *file, uint32_t line)
{
	ARG_UNUSED(file);
	ARG_UNUSED(line);
	k_panic();
}

int main(void)
{
	bst_main();
	return 0;
}
```

## src/bsim_client_test_helpers.h
```c
/*
 * Copyright (c) 2025
 * SPDX-License-Identifier: Apache-2.0
 *
 * Shared BSIM test helpers for client — PASS/FAIL macros and bst_result extern.
 */
#ifndef BSIM_CLIENT_TEST_HELPERS_H
#define BSIM_CLIENT_TEST_HELPERS_H

#include <bs_tracing.h>
#include <bstests.h>

extern enum bst_result_t bst_result;

#define FAIL(...)                                                                                  \
	do {                                                                                       \
		bst_result = Failed;                                                               \
		bs_trace_error_time_line(__VA_ARGS__);                                             \
	} while (0)

#define PASS(...)                                                                                  \
	do {                                                                                       \
		bst_result = Passed;                                                               \
		bs_trace_info_time(1, __VA_ARGS__);                                                \
	} while (0)

#endif /* BSIM_CLIENT_TEST_HELPERS_H */
```

## src/bsim_tx.h
```c
/*
 * Copyright (c) 2025
 * SPDX-License-Identifier: Apache-2.0
 *
 * BSIM deterministic multi-channel TX — repository-owned replacement for
 * the upstream repeated-tone stream_tx/stream_lc3 helpers.
 *
 * Keeps the real BAP send API while selecting sequence-indexed, checked-in
 * LC3 corpus frames. Logical sequence indexes corpus frames and contributes
 * to retained FNV-1a audit data. Transport sequence is the packet sequence
 * number passed to BAP and advances once per live stream on every SDU tick.
 */

#ifndef BSIM_TX_H
#define BSIM_TX_H

#include <stdbool.h>
#include <stdint.h>

#include <zephyr/bluetooth/audio/bap.h>

#define BSIM_TX_MAX_STREAMS        2
#define BSIM_TX_FNV1A_OFFSET_BASIS UINT32_C(0x811C9DC5)

struct bsim_tx_config {
	/** Negotiated octets per frame per channel (from the codec preset). */
	uint16_t octets_per_frame;
	/** Sampling frequency in Hz (48000). */
	uint32_t freq_hz;
	/** Frame duration in microseconds (7500 or 10000). */
	uint32_t frame_duration_us;
	/**
	 * Channel count of this stream's SDU: 1 = mono / Mode A half,
	 * 2 = Mode B stereo single-ASE ([L frame][R frame] per SDU).
	 */
	uint8_t chan_count;
	/** Mode A channel selection: 0 = Front Left, 1 = Front Right. */
	uint8_t channel_idx;
};

struct bsim_tx_result {
	uint32_t send_count;
	uint32_t fnv1a_hash;
};

/**
 * Initialize the TX thread.  Idempotent.
 */
int bsim_tx_init(void);

/**
 * Register a stream for TX.  The stream must already carry the negotiated
 * codec config (used only for logging; the explicit @p cfg selects fixed
 * corpus frames). Logical and transport sequences start at 0. Simultaneously
 * registered fixture streams must use one frame duration.
 *
 * @retval 0 success
 * @retval -EINVAL null, unsupported corpus geometry, or mismatched frame duration
 * @retval -ENOMEM all TX slots in use
 */
int bsim_tx_register(struct bt_bap_stream *bap_stream, const struct bsim_tx_config *cfg);

/** Unregister a stream from TX (stops sending on it). */
int bsim_tx_unregister(struct bt_bap_stream *bap_stream);

/**
 * Explicitly retire a drained stream's retained TX result.
 * Results remain available after unregister until the caller invokes this;
 * canonical clients never retire them implicitly.
 *
 * @retval 0 The inactive audit was forgotten.
 * @retval -EINVAL stream is NULL.
 * @retval -ENODATA No retained result belongs to stream.
 * @retval -EBUSY stream remains registered or its audit has in-flight TX.
 */
int bsim_tx_forget_result(const struct bt_bap_stream *stream);

/** Pause payload sending on one stream (transport PSN still advances per tick). */
void bsim_tx_pause(struct bt_bap_stream *bap_stream);

/** Resume sending on one stream. */
void bsim_tx_resume(struct bt_bap_stream *bap_stream);

/**
 * Number of streams that must be in the streaming state before TX starts
 * sending at all.  Used to hold Mode A TX until both ASEs stream (both
 * transmitted sequence counters then begin at zero, including reverse
 * start order).
 */
void bsim_tx_set_required_streams(int n);

/**
 * Inject exactly one malformed one-byte SDU when the next send on
 * @p bap_stream would use logical sequence @p at_seq, then resume valid LC3 frames.
 */
void bsim_tx_schedule_malformed(struct bt_bap_stream *bap_stream, uint16_t at_seq);

/**
 * After @p after_sends successful logical sends, omit payloads for exactly
 * @p intervals active SDU ticks. Transport PSN advances during each omission;
 * logical corpus sequence resumes unchanged after the gap.
 *
 * @retval 0 gap armed
 * @retval -EINVAL null/zero/invalid arguments or an already-passed send count
 * @retval -ENODATA stream is not registered
 * @retval -EALREADY another gap is armed or in progress
 */
int bsim_tx_schedule_gap(struct bt_bap_stream *bap_stream, uint32_t after_sends,
			 uint32_t intervals);

/**
 * Cap successful payload sends on one stream: payloads pause once send count
 * reaches @p limit. Transport PSN continues on live stream ticks. 0 = unlimited.
 */
void bsim_tx_set_send_limit(struct bt_bap_stream *bap_stream, uint32_t limit);

/**
 * Wait until @p bap_stream has committed its configured nonzero exact send
 * limit and auto-paused.
 *
 * @retval 0 cap reached
 * @retval -EINVAL NULL stream or zero timeout
 * @retval -ENODATA stream is not registered or has no nonzero limit
 * @retval -ETIMEDOUT notification wait expired
 * @retval -ESTALE registration generation, stream association, or expected
 *         limit state changed while waiting
 */
int bsim_tx_wait_send_limit(struct bt_bap_stream *bap_stream, uint32_t timeout_ms);

/** Successful send count for one stream. */
uint32_t bsim_tx_send_count(struct bt_bap_stream *bap_stream);

/**
 * Retained successful-send result for one logical stream.  The result remains
 * available after bsim_tx_unregister().
 *
 * @retval 0 result copied
 * @retval -EINVAL NULL argument
 * @retval -ENODATA stream has never been registered
 */
int bsim_tx_result(const struct bt_bap_stream *bap_stream, struct bsim_tx_result *result);

/** Number of registered streams currently in the streaming state. */
int bsim_tx_streaming_count(void);

#endif /* BSIM_TX_H */
```

## src/preset_override.h
```c
/*
 * Copyright (c) 2025
 * SPDX-License-Identifier: Apache-2.0
 *
 * Forced-include header for BSIM valid-LC3 client.
 *
 * Purpose:
 * 1. First include bap_lc3_preset.h so all preset macros are defined.
 * 2. Redefine BT_BAP_LC3_UNICAST_PRESET_16_2_1 to use 48_4_1.
 *    This overrides the upstream sample's preset selection without
 *    modifying any NCS source files. The server (receiver) advertises
 *    48 kHz; the codec preset must match.
 * 3. Wrap bt_bap_stream_send() to atomically count successful TX
 *    submissions. The test installer checks the counter against a
 *    threshold and calls PASS when reached.
 */

#ifndef BSIM_CLIENT_PRESET_OVERRIDE_H
#define BSIM_CLIENT_PRESET_OVERRIDE_H

#include <stdatomic.h>

/* ── Step 1: pull in all preset definitions ──────────────────────── */
#include <zephyr/bluetooth/audio/bap_lc3_preset.h>

/* ── Step 2: override 16_2_1 → selected preset ────────────────────── */
/* bap_lc3_preset.h defines BT_BAP_LC3_UNICAST_PRESET_16_2_1 as a
 * convenience macro. Since the header has already been included (include
 * guard prevents re-expansion), we can safely undef and redefine it.
 * Upstream main.c uses:
 *   static struct bt_bap_lc3_preset codec_configuration =
 *       BT_BAP_LC3_UNICAST_PRESET_16_2_1(...);
 * After this override, it expands to the selected preset.
 *
 * BSIM_CLIENT_PRESET_48_4_1 = 10 ms frame duration
 * BSIM_CLIENT_PRESET_48_3_1 = 7.5 ms frame duration
 */

#if defined(CONFIG_BSIM_CLIENT_PRESET_48_4_1)
#define BSIM_LC3_PRESET BT_BAP_LC3_UNICAST_PRESET_48_4_1
#elif defined(CONFIG_BSIM_CLIENT_PRESET_48_3_1)
#define BSIM_LC3_PRESET BT_BAP_LC3_UNICAST_PRESET_48_3_1
#else
#define BSIM_LC3_PRESET BT_BAP_LC3_UNICAST_PRESET_48_4_1
#endif

#undef BT_BAP_LC3_UNICAST_PRESET_16_2_1
#define BT_BAP_LC3_UNICAST_PRESET_16_2_1(loc, ctx) BSIM_LC3_PRESET(loc, ctx)

/* ── Step 3: wrap bt_bap_stream_send ──────────────────────────────── */
/*
 * The upstream stream_tx.c calls bt_bap_stream_send() to send LC3 frames.
 * We wrap this with a macro that intercepts the call, forwards to the real
 * API, and atomically counts successful submissions.
 *
 * Parentheses around the function name in the wrapper body prevent the
 * preprocessor from recursively expanding the macro.
 */

#include <zephyr/bluetooth/audio/bap.h>

extern atomic_int bsim_client_tx_count;

static inline int _bsim_client_send_wrap(struct bt_bap_stream *stream, struct net_buf *buf,
					 uint16_t seq_num)
{
	int ret;

	ret = (bt_bap_stream_send)(stream, buf, seq_num);
	if (ret == 0) {
		atomic_fetch_add(&bsim_client_tx_count, 1);
	}
	return ret;
}

#define bt_bap_stream_send(stream, buf, seq) _bsim_client_send_wrap((stream), (buf), (seq))

#endif /* BSIM_CLIENT_PRESET_OVERRIDE_H */
```
