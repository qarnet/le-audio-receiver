## CMakeLists.txt
```
cmake_minimum_required(VERSION 3.20.0)
set(CMAKE_EXPORT_COMPILE_COMMANDS ON)
# Native BSim peers are ELF32; align initial CMake probes with verified 32-bit library paths.
set(CMAKE_C_FLAGS_INIT "${CMAKE_C_FLAGS_INIT} -m32")
set(CMAKE_CXX_FLAGS_INIT "${CMAKE_CXX_FLAGS_INIT} -m32")
set(CMAKE_ASM_FLAGS_INIT "${CMAKE_ASM_FLAGS_INIT} -m32")
# CMake capability probes provide main but may link with -nostdlib.
# Give those probe links an entry point without changing final targets.
# CMAKE_REQUIRED_LINK_OPTIONS is consumed only by try_compile checks.
list(APPEND CMAKE_REQUIRED_LINK_OPTIONS "-Wl,--entry=main")
find_package(Zephyr REQUIRED HINTS $ENV{ZEPHYR_BASE})
project(le_audio_receiver_bsim)

set(FIXTURES ${CMAKE_CURRENT_SOURCE_DIR}/../fixtures/lc3)
set(PCM_ORACLE_DIR ${CMAKE_CURRENT_SOURCE_DIR}/../support)
set(PCM_ORACLE_SOURCE ${PCM_ORACLE_DIR}/pcm_oracle.c)
set(PCM_ORACLE_HEADER ${PCM_ORACLE_DIR}/pcm_oracle.h)
set(STATEFUL_RECIPE_SOURCE ${PCM_ORACLE_DIR}/lc3_stateful_recipes.c)
set(STATEFUL_RECIPE_HEADER ${PCM_ORACLE_DIR}/lc3_stateful_recipes.h)
set(PB031_MANIFEST ${FIXTURES}/portable-oracle-manifest.json)
set(PB031_STATEFUL_MANIFEST ${FIXTURES}/stateful-reference-manifest.json)

set(PB031_CORPUS_STEMS
  bsim_48k_10ms_120b_l
  bsim_48k_10ms_120b_r
  bsim_48k_7p5ms_90b_l
  bsim_48k_7p5ms_90b_r
)
set(PB031_STATEFUL_REFERENCE_STEMS
  stateful_48k_10ms_skip20_start0_l
  stateful_48k_10ms_loss48x18_start0_r
  stateful_48k_10ms_skip20_l
  stateful_48k_10ms_loss48x18_r
  stateful_48k_7p5ms_modea_start_r
)

file(READ ${PB031_MANIFEST} PB031_MANIFEST_JSON)
string(JSON PB031_MANIFEST_SCHEMA_VERSION ERROR_VARIABLE
  PB031_MANIFEST_SCHEMA_VERSION_ERROR GET "${PB031_MANIFEST_JSON}" schema_version)
string(JSON PB031_MANIFEST_SCHEMA_VERSION_TYPE ERROR_VARIABLE
  PB031_MANIFEST_SCHEMA_VERSION_TYPE_ERROR TYPE "${PB031_MANIFEST_JSON}" schema_version)
if(NOT "${PB031_MANIFEST_SCHEMA_VERSION_ERROR}" STREQUAL "NOTFOUND" OR
   NOT "${PB031_MANIFEST_SCHEMA_VERSION_TYPE_ERROR}" STREQUAL "NOTFOUND" OR
   NOT "${PB031_MANIFEST_SCHEMA_VERSION_TYPE}" STREQUAL "NUMBER" OR
   NOT "${PB031_MANIFEST_SCHEMA_VERSION}" STREQUAL "2")
  message(FATAL_ERROR "PB-031 manifest must provide schema_version 2")
endif()

string(JSON PB031_PCM_LIMITS_TYPE ERROR_VARIABLE PB031_PCM_LIMITS_TYPE_ERROR
  TYPE "${PB031_MANIFEST_JSON}" pcm_limits)
if(NOT "${PB031_PCM_LIMITS_TYPE_ERROR}" STREQUAL "NOTFOUND" OR
   NOT "${PB031_PCM_LIMITS_TYPE}" STREQUAL "OBJECT")
  message(FATAL_ERROR "PB-031 manifest pcm_limits must be an object")
endif()

function(pb031_manifest_limit variable member)
  string(JSON _type ERROR_VARIABLE _type_error TYPE "${PB031_MANIFEST_JSON}"
    pcm_limits ${member})
  string(JSON _value ERROR_VARIABLE _value_error GET "${PB031_MANIFEST_JSON}"
    pcm_limits ${member})
  if(NOT "${_type_error}" STREQUAL "NOTFOUND" OR
     NOT "${_value_error}" STREQUAL "NOTFOUND" OR
     NOT "${_type}" STREQUAL "NUMBER")
    message(FATAL_ERROR "PB-031 manifest pcm_limits.${member} must be numeric")
  endif()
  if("${member}" STREQUAL "min_correlation_q15")
    set(_integer_pattern "^-?[0-9]+$")
  else()
    set(_integer_pattern "^[0-9]+$")
  endif()
  if(NOT "${_value}" MATCHES "${_integer_pattern}")
    message(FATAL_ERROR "PB-031 manifest pcm_limits.${member} must be an integer")
  endif()
  set(${variable} "${_value}" PARENT_SCOPE)
endfunction()

pb031_manifest_limit(PB031_PCM_MAX_ABS_ERROR max_abs_error)
pb031_manifest_limit(PB031_PCM_MAX_RMS_ERROR max_rms_error)
pb031_manifest_limit(PB031_PCM_MIN_CORRELATION_Q15 min_correlation_q15)

set_property(DIRECTORY APPEND PROPERTY CMAKE_CONFIGURE_DEPENDS
  ${PB031_MANIFEST}
  ${PB031_STATEFUL_MANIFEST}
  ${PCM_ORACLE_SOURCE}
  ${PCM_ORACLE_HEADER}
  ${STATEFUL_RECIPE_SOURCE}
  ${STATEFUL_RECIPE_HEADER}
  ${CMAKE_CURRENT_SOURCE_DIR}/src/bsim_pcm_limits.h.in
)

foreach(stem IN LISTS PB031_CORPUS_STEMS)
  list(APPEND PB031_EMBEDDED_BINARIES ${FIXTURES}/${stem}.lc3 ${FIXTURES}/${stem}.pcm)
endforeach()
foreach(stem IN LISTS PB031_STATEFUL_REFERENCE_STEMS)
  list(APPEND PB031_EMBEDDED_BINARIES ${FIXTURES}/${stem}.pcm)
endforeach()
set_property(DIRECTORY APPEND PROPERTY CMAKE_CONFIGURE_DEPENDS ${PB031_EMBEDDED_BINARIES})

configure_file(src/bsim_pcm_limits.h.in
  ${CMAKE_CURRENT_BINARY_DIR}/bsim_pcm_limits.h
  @ONLY
)

target_sources(app PRIVATE
  ${CMAKE_CURRENT_SOURCE_DIR}/src/main.c
  ${CMAKE_CURRENT_SOURCE_DIR}/../../src/bt_bap.c
  ${CMAKE_CURRENT_SOURCE_DIR}/../../src/bt_audio_ltv_guard.c
  ${CMAKE_CURRENT_SOURCE_DIR}/../../src/bt_pairing_policy.c
  ${CMAKE_CURRENT_SOURCE_DIR}/../../src/audio_decode.c
  ${CMAKE_CURRENT_SOURCE_DIR}/../../src/audio_stream_session.c
  ${CMAKE_CURRENT_SOURCE_DIR}/../../src/audio_modea.c
  ${CMAKE_CURRENT_SOURCE_DIR}/../../src/audio_iso_seq.c
  ${CMAKE_CURRENT_SOURCE_DIR}/../../src/audio_stats.c
  ${CMAKE_CURRENT_SOURCE_DIR}/../../src/audio_drift.c
  ${CMAKE_CURRENT_SOURCE_DIR}/../../src/audio_rate_convert.c
  ${CMAKE_CURRENT_SOURCE_DIR}/../../src/audio_timing_math.c
  ${CMAKE_CURRENT_SOURCE_DIR}/../../src/audio_timing_none.c
  ${CMAKE_CURRENT_SOURCE_DIR}/../../src/stream_lifecycle.c
  ${CMAKE_CURRENT_SOURCE_DIR}/../../src/audio_volume.c
  ${PCM_ORACLE_SOURCE}
  ${STATEFUL_RECIPE_SOURCE}
  ${CMAKE_CURRENT_SOURCE_DIR}/../../src/audio_offload.c
  ${CMAKE_CURRENT_SOURCE_DIR}/src/audio_sink_stub.c
  ${CMAKE_CURRENT_SOURCE_DIR}/src/bsim_test_main.c
  ${CMAKE_CURRENT_SOURCE_DIR}/src/bsim_observer.c
)
target_link_options(app INTERFACE -Wl,--wrap=bt_audio_data_parse)

target_include_directories(app PRIVATE
  ${CMAKE_CURRENT_SOURCE_DIR}/../../src
  ${CMAKE_CURRENT_SOURCE_DIR}/src
  ${PCM_ORACLE_DIR}
  ${CMAKE_CURRENT_BINARY_DIR}
)

foreach(stem IN LISTS PB031_CORPUS_STEMS)
  generate_inc_file_for_target(
    app ${FIXTURES}/${stem}.lc3 ${CMAKE_CURRENT_BINARY_DIR}/${stem}_lc3.inc)
  generate_inc_file_for_target(
    app ${FIXTURES}/${stem}.pcm ${CMAKE_CURRENT_BINARY_DIR}/${stem}_pcm.inc)
endforeach()

foreach(stem IN LISTS PB031_STATEFUL_REFERENCE_STEMS)
  generate_inc_file_for_target(
    app ${FIXTURES}/${stem}.pcm ${CMAKE_CURRENT_BINARY_DIR}/${stem}_pcm.inc)
endforeach()

# BSIM component headers
zephyr_include_directories(
  ${BSIM_COMPONENTS_PATH}/libUtilv1/src/
  ${BSIM_COMPONENTS_PATH}/libPhyComv1/src/
)

zephyr_library_include_directories(${ZEPHYR_BASE}/samples/bluetooth)

# LSP compile-database link: expose this BSim image's compile_commands.json
# at the app root for clangd closest-ancestor discovery.  The link target is
# absolute because the BSim build tree lives in the shared SDK bsim_out,
# outside this repo; scripts/gen-lsp-links.sh can also repair it.
file(CREATE_LINK
     "${CMAKE_BINARY_DIR}/compile_commands.json"
     "${CMAKE_CURRENT_SOURCE_DIR}/compile_commands.json"
     SYMBOLIC)
```

## Kconfig
```
# BSIM receiver Kconfig — minimal symbols repo needs for BSIM build.
# Repo Kconfig cannot be sourced directly (repo lives outside ZEPHYR_BASE
# which is the Kconfig srctree root).

mainmenu "LE Audio Receiver — BSIM"

config INFO_REPORTING_INTERVAL
	int "Number of SDUs between log reports"
	default 0

config BSIM_OBSERVER
	bool "BSim-only passive BAP flow observer"
	help
	  Compiles the passive observer (tests/bsim/src/bsim_observer.c) into
	  the receiver.  Emits/counts events from real production flow;
	  never drives production state.  Production builds do not define
	  this symbol.

config BSIM_SOURCE_ASE
	bool "BSim-only source PAC capability"
	help
	  Registers a source PAC capability so a BSim client can attempt a
	  source-direction Config and exercise the repository's source
	  rejection through the real ASCS server.  Production remains
	  sink-only (CONFIG_BT_ASCS_MAX_ASE_SRC_COUNT=0).

config BSIM_SINK_POOL_LIMIT
	int "BSim-only repository sink stream pool limit"
	default 2
	depends on BSIM_OBSERVER
	help
	  Limits the repository bt_sink stream pool below the BSim ASCS sink
	  ASE count so the NO_MEM callback path is reachable in BSim.
	  Production keeps the pool equal to CONFIG_BT_ASCS_MAX_ASE_SNK_COUNT
	  with no seam symbol.

choice AUDIO_RESAMPLER
	prompt "Audio resampler"
	default AUDIO_RESAMPLER_IDENTITY

config AUDIO_RESAMPLER_IDENTITY
	bool "Identity (memcpy passthrough)"

config AUDIO_RESAMPLER_ASRC_LINEAR
	bool "Linear ASRC"
endchoice

choice AUDIO_CLOCK_ACTUATOR
	prompt "Audio clock actuator"
	default AUDIO_CLOCK_ACTUATOR_NONE

config AUDIO_CLOCK_ACTUATOR_NONE
	bool "None (data-path only)"
endchoice

config AUDIO_DRIFT_OUTPUT_CLAMP
	int "Controller output clamp (±ppm)"
	default 500

config AUDIO_DRIFT_PHASE_INTEGRAL_CLAMP
	int "Phase integral clamp (±ppm)"
	default 500

source "Kconfig.zephyr"
```

## prj.conf
```kconfig
# NCS 3.4.1: unused deprecated platform alias; SOC_SERIES_NRF54L remains enabled.
CONFIG_NRF_PLATFORM_LUMOS=n

CONFIG_BT=y
CONFIG_LOG=y
CONFIG_LOG_PRINTK=y
CONFIG_BT_BUF_EVT_RX_SIZE=255
CONFIG_BT_BUF_EVT_RX_COUNT=16
CONFIG_BT_BUF_ACL_RX_SIZE=255
CONFIG_BT_BUF_ACL_TX_SIZE=251
CONFIG_BT_BUF_CMD_TX_SIZE=255
CONFIG_BT_BUF_ACL_TX_COUNT=3
CONFIG_BT_CONN_TX_MAX=3
CONFIG_BT_ISO_TX_BUF_COUNT=3

# Settings subsystem required for pm_register/settings_load. The BSim test
# main registers a volatile source and destination backend.
CONFIG_BT_SETTINGS=y
CONFIG_SETTINGS=y

CONFIG_BT_SMP=y
CONFIG_BT_SMP_APP_PAIRING_ACCEPT=y
CONFIG_BT_SMP_ENFORCE_MITM=n
CONFIG_BT_FILTER_ACCEPT_LIST=y

CONFIG_BT_PACS_LOG_LEVEL_WRN=y
CONFIG_BT_ASCS_LOG_LEVEL_WRN=y
CONFIG_BT_BAP_UNICAST_SERVER_LOG_LEVEL_WRN=y
CONFIG_BT_BAP_STREAM_LOG_LEVEL_WRN=y
CONFIG_BT_ISO_LOG_LEVEL_WRN=y

CONFIG_BT_PERIPHERAL=y
CONFIG_BT_GAP_AUTO_UPDATE_CONN_PARAMS=n
CONFIG_BT_PERIPHERAL_PREF_MIN_INT=50
CONFIG_BT_PERIPHERAL_PREF_MAX_INT=70
CONFIG_BT_PERIPHERAL_PREF_LATENCY=0
CONFIG_BT_PERIPHERAL_PREF_TIMEOUT=400
CONFIG_BT_ISO_PERIPHERAL=y
CONFIG_UTF8=y
CONFIG_BT_AUDIO=y
CONFIG_BT_GATT_DYNAMIC_DB=y
CONFIG_BT_BAP_UNICAST_SERVER=y
CONFIG_BT_ASCS=y
CONFIG_BT_PAC_SNK=y
CONFIG_BT_PAC_SNK_LOC=y

# BSim-only resource seam: three sink ASEs + one source ASE are
# registered so the NO_MEM callback path and the source-direction
# rejection are reachable; the repository stream pool stays at two
# (CONFIG_BSIM_SINK_POOL_LIMIT) and the source PAC comes from
# CONFIG_BSIM_SOURCE_ASE.  Production is 2 sink / 0 source.
CONFIG_BT_ASCS_MAX_ASE_SNK_COUNT=3
CONFIG_BT_ASCS_MAX_ASE_SRC_COUNT=1
CONFIG_BT_ASCS_MAX_ACTIVE_ASES=3
CONFIG_BT_PAC_SRC=y
CONFIG_BT_PAC_SRC_LOC=y
CONFIG_BSIM_SOURCE_ASE=y
CONFIG_BSIM_OBSERVER=y
CONFIG_BT_ISO_MAX_CHAN=2
CONFIG_BT_AUDIO_CODEC_CFG_MAX_METADATA_SIZE=16
CONFIG_BT_AUDIO_CODEC_CFG_MAX_DATA_SIZE=32
CONFIG_BT_ATT_PREPARE_COUNT=2
CONFIG_BT_EXT_ADV=y
CONFIG_BT_DEVICE_NAME="LE Audio Receiver"

CONFIG_BT_ISO_RX_MTU=255
CONFIG_BT_ISO_RX_BUF_COUNT=4

CONFIG_SPEED_OPTIMIZATIONS=y
CONFIG_FPU=y
CONFIG_LIBLC3=y
CONFIG_BT_RX_STACK_SIZE=4096

# No hardware I2S in BSIM — sink stub validates PCM without DMA
CONFIG_I2S=n

# No VCP (volume) in BSIM — skip volume init
CONFIG_BT_VCP_VOL_REND=n
CONFIG_BT_CAP_ACCEPTOR=n

# No shell in BSIM test binary
CONFIG_SHELL=n

# No watchdog in BSIM simulation
CONFIG_WATCHDOG=n

# Identity resampler, NONE actuator (no real APLL in bsim)
CONFIG_AUDIO_RESAMPLER_IDENTITY=y
CONFIG_AUDIO_CLOCK_ACTUATOR_NONE=y

CONFIG_BT_TESTING=y
CONFIG_TEST=y

CONFIG_ASSERT=y
CONFIG_LOG_MODE_DEFERRED=y
CONFIG_LOG_BUFFER_SIZE=4096
```

## overlay-bt_ll_sw_split.conf
```kconfig
CONFIG_BT_LL_SW_SPLIT=y
CONFIG_BT_CTLR_ASSERT_HANDLER=y
CONFIG_BT_CTLR_DATA_LENGTH_MAX=251
CONFIG_BT_CTLR_ADV_DATA_LEN_MAX=191
CONFIG_BT_CTLR_PERIPHERAL_ISO=y
CONFIG_BT_CTLR_CONN_ISO_GROUPS=1
CONFIG_BT_CTLR_CONN_ISO_STREAMS=2
CONFIG_BT_CTLR_CONN_ISO_STREAMS_PER_GROUP=2
CONFIG_BT_CTLR_CONN_ISO_PDU_LEN_MAX=251
CONFIG_BT_CTLR_ISO_TX_BUFFERS=3
CONFIG_BT_CTLR_ISO_TX_BUFFER_SIZE=255
CONFIG_BT_CTLR_ISO_TX_SDU_LEN_MAX=255
CONFIG_BT_CTLR_ISO_RX_BUFFERS=4
CONFIG_BT_CTLR_ISOAL_SOURCES=1
CONFIG_BT_CTLR_ISOAL_SINKS=2
CONFIG_ASSERT=y
```

## overlay-nrf5340_cpunet_iso-bt_ll_sw_split.conf
```kconfig
# Extra controller config for receiver bsim netcore
# Match host-side ISO buffer counts: CONFIG_BT_ISO_RX_BUF_COUNT=4
# (sink-only = receive ISO, no TX needed)
CONFIG_BT_CTLR_ISO_TX_BUFFERS=1
CONFIG_BT_CTLR_ISO_TX_BUFFER_SIZE=255
CONFIG_BT_CTLR_ISO_RX_BUFFERS=4
CONFIG_BT_CTLR_ISOAL_SOURCES=1
CONFIG_BT_CTLR_ISOAL_SINKS=1
CONFIG_BT_CTLR_CONN_ISO_STREAMS=2
CONFIG_BT_CTLR_CONN_ISO_STREAMS_PER_GROUP=2
CONFIG_BT_CTLR_CONN_ISO_PDU_LEN_MAX=251
CONFIG_ASSERT=y
```

## src/main.c
```c
/*
 * Copyright (c) 2025
 * SPDX-License-Identifier: Apache-2.0
 *
 * BSIM receiver — main entry point.
 * Delegates to bst_main() which dispatches to the test framework.
 * BT init, BAP registration, and audio sink init happen in the
 * test_main_f callback, exactly like upstream bsim tests.
 */

#include <bstests.h>
#include <zephyr/kernel.h>

void bt_ctlr_assert_handle(char *file, uint32_t line)
{
	ARG_UNUSED(file);
	ARG_UNUSED(line);
	k_panic();
}

int main(void)
{
	bst_main();
	return 0;
}
```

## src/audio_i2s_stub.c
```c
/*
 * Copyright (c) 2025
 * SPDX-License-Identifier: Apache-2.0
 */

#include "audio_i2s.h"

#include <stdatomic.h>
#include <bs_tracing.h>
#include <bstests.h>

#define PASS_FRAME_COUNT 100

static atomic_int frame_count;

int audio_i2s_init(void)
{
	return 0;
}

void audio_i2s_stop(void)
{
	atomic_store(&frame_count, 0);
}

void audio_i2s_sdu_ref_update(uint32_t sdu_ref_us)
{
	(void)sdu_ref_us;
}

int audio_i2s_push(const int16_t *data, size_t sample_count)
{
	(void)data;
	(void)sample_count;

	int cnt = atomic_fetch_add(&frame_count, 1) + 1;

	if (cnt == PASS_FRAME_COUNT) {
		PASS("le_audio_receiver: received %d decoded audio frames\n", cnt);
	}

	return 0;
}
```

## src/bsim_observer.c
```c
/*
 * Copyright (c) 2025
 * SPDX-License-Identifier: Apache-2.0
 *
 * BSIM-only passive observer — implementation.
 *
 * See bsim_observer.h.  All counters are atomic; the receiver scenario
 * driver reads them through the query functions.  Event records are
 * printed with the "OBS" prefix for human-readable log inspection; the
 * strict gate parses the receiver PASS record (which carries the same
 * values) instead of these lines.
 */

#include "bsim_observer.h"

#include <stdatomic.h>
#include <string.h>

#include <zephyr/sys/printk.h>

static atomic_uint cfg_accepted;
static atomic_uint cfg_rejected;
static atomic_uint gate_open_cnt;
static atomic_uint gate_close_cnt;
static atomic_uint malformed_sdu_cnt;
static atomic_uint recv_gate_blocked_cnt;
static atomic_uint stale_half_cnt;
static atomic_uint release_cleanup_cnt;
static atomic_uint disconnect_cleanup_cnt;
static atomic_int last_dir;
static atomic_int last_code;
static atomic_int last_reason;
static atomic_int last_rej_dir;
static atomic_int last_rej_code;
static atomic_int last_rej_reason;

static atomic_uint event_seq;
static atomic_uint rel_ss_cnt;
static atomic_uint rel_ss_seq;
static atomic_uint mts_cnt;
static atomic_uint disc_seq;
static struct bsim_observer_push push_snapshot;
static bool push_ready;

static uint32_t obs_next_event(void)
{
	return atomic_fetch_add(&event_seq, 1);
}

void bsim_observer_config(bool accepted, enum bt_audio_dir dir, enum bt_bap_ascs_rsp_code code,
			  enum bt_bap_ascs_reason reason)
{
	if (accepted) {
		atomic_fetch_add(&cfg_accepted, 1);
	} else {
		atomic_fetch_add(&cfg_rejected, 1);
	}
	atomic_store(&last_dir, (int)dir);
	atomic_store(&last_code, (int)code);
	atomic_store(&last_reason, (int)reason);
	(void)obs_next_event();
	if (!accepted) {
		atomic_store(&last_rej_dir, (int)dir);
		atomic_store(&last_rej_code, (int)code);
		atomic_store(&last_rej_reason, (int)reason);
	}
	printk("OBS config %s dir=%u code=0x%02x reason=0x%02x\n", accepted ? "ok" : "rej",
	       (unsigned int)dir, (unsigned int)code, (unsigned int)reason);
}

void bsim_observer_gate_open(void)
{
	(void)obs_next_event();
	atomic_fetch_add(&gate_open_cnt, 1);
	printk("OBS gate open\n");
}

void bsim_observer_gate_close(void)
{
	(void)obs_next_event();
	atomic_fetch_add(&gate_close_cnt, 1);
	printk("OBS gate close\n");
}

void bsim_observer_malformed_sdu(void)
{
	(void)obs_next_event();
	atomic_fetch_add(&malformed_sdu_cnt, 1);
	printk("OBS malformed sdu\n");
}

void bsim_observer_recv_gate_blocked(void)
{
	(void)obs_next_event();
	atomic_fetch_add(&recv_gate_blocked_cnt, 1);
	printk("OBS recv gate blocked\n");
}

void bsim_observer_stale_half(void)
{
	(void)obs_next_event();
	atomic_fetch_add(&stale_half_cnt, 1);
	printk("OBS stale half\n");
}

void bsim_observer_cleanup_release(unsigned int slot)
{
	(void)obs_next_event();
	atomic_fetch_add(&release_cleanup_cnt, 1);
	printk("OBS release cleanup slot=%u\n", slot);
}

void bsim_observer_cleanup_disconnect(void)
{
	atomic_store(&disc_seq, obs_next_event());
	atomic_fetch_add(&disconnect_cleanup_cnt, 1);
	printk("OBS disconnect cleanup\n");
}

void bsim_observer_release_sink_stop(void)
{
	atomic_store(&rel_ss_seq, obs_next_event());
	atomic_fetch_add(&rel_ss_cnt, 1);
	printk("OBS release sink stop\n");
}

void bsim_observer_missing_ts(void)
{
	(void)obs_next_event();
	atomic_fetch_add(&mts_cnt, 1);
	printk("OBS missing ts\n");
}

static bool push_half_well_formed(bool valid, const uint8_t *payload, size_t payload_len)
{
	if (valid) {
		return payload != NULL && payload_len > 0U &&
		       payload_len <= BSIM_OBSERVER_MAX_PAYLOAD_BYTES;
	}

	return payload == NULL && payload_len == 0U;
}

void bsim_observer_pre_push(bool l_valid, const uint8_t *l_payload, size_t l_payload_len,
			    bool r_valid, const uint8_t *r_payload, size_t r_payload_len)
{
	/* Clear readiness first so malformed metadata cannot leave an earlier
	 * snapshot available to a later sink push. RX and sink execute in one
	 * serialized call stack, so no lock is required. */
	push_ready = false;
	memset(&push_snapshot, 0, sizeof(push_snapshot));

	if (!push_half_well_formed(l_valid, l_payload, l_payload_len) ||
	    !push_half_well_formed(r_valid, r_payload, r_payload_len)) {
		return;
	}

	push_snapshot.left.source_valid = l_valid;
	push_snapshot.left.payload_len = (uint16_t)l_payload_len;
	push_snapshot.right.source_valid = r_valid;
	push_snapshot.right.payload_len = (uint16_t)r_payload_len;
	if (l_valid) {
		memcpy(push_snapshot.left.payload, l_payload, l_payload_len);
	}
	if (r_valid) {
		memcpy(push_snapshot.right.payload, r_payload, r_payload_len);
	}
	push_ready = true;
}

bool bsim_observer_take_push(struct bsim_observer_push *out)
{
	if (out == NULL || !push_ready) {
		return false;
	}

	*out = push_snapshot;
	push_ready = false;
	return true;
}

uint32_t bsim_observer_get_config_accepted(void)
{
	return atomic_load(&cfg_accepted);
}

uint32_t bsim_observer_get_config_rejected(void)
{
	return atomic_load(&cfg_rejected);
}

int bsim_observer_get_last_config_dir(void)
{
	return atomic_load(&last_dir);
}

int bsim_observer_get_last_config_code(void)
{
	return atomic_load(&last_code);
}

int bsim_observer_get_last_config_reason(void)
{
	return atomic_load(&last_reason);
}

int bsim_observer_get_last_rej_dir(void)
{
	return atomic_load(&last_rej_dir);
}

int bsim_observer_get_last_rej_code(void)
{
	return atomic_load(&last_rej_code);
}

int bsim_observer_get_last_rej_reason(void)
{
	return atomic_load(&last_rej_reason);
}

uint32_t bsim_observer_get_gate_open(void)
{
	return atomic_load(&gate_open_cnt);
}

uint32_t bsim_observer_get_gate_close(void)
{
	return atomic_load(&gate_close_cnt);
}

uint32_t bsim_observer_get_malformed_sdu(void)
{
	return atomic_load(&malformed_sdu_cnt);
}

uint32_t bsim_observer_get_recv_gate_blocked(void)
{
	return atomic_load(&recv_gate_blocked_cnt);
}

uint32_t bsim_observer_get_stale_half(void)
{
	return atomic_load(&stale_half_cnt);
}

uint32_t bsim_observer_get_release_cleanup(void)
{
	return atomic_load(&release_cleanup_cnt);
}

uint32_t bsim_observer_get_disconnect_cleanup(void)
{
	return atomic_load(&disconnect_cleanup_cnt);
}

uint32_t bsim_observer_get_release_sink_stop(void)
{
	return atomic_load(&rel_ss_cnt);
}

uint32_t bsim_observer_get_missing_ts(void)
{
	return atomic_load(&mts_cnt);
}

uint32_t bsim_observer_get_event_seq(void)
{
	return atomic_load(&event_seq);
}

uint32_t bsim_observer_get_release_sink_stop_seq(void)
{
	return atomic_load(&rel_ss_seq);
}

uint32_t bsim_observer_get_disconnect_seq(void)
{
	return atomic_load(&disc_seq);
}
```

## src/bsim_observer.h
```c
/*
 * Copyright (c) 2025
 * SPDX-License-Identifier: Apache-2.0
 *
 * BSIM-only passive observer of the production BAP flow.
 *
 * The observer is compiled only into the BSim receiver build
 * (CONFIG_BSIM_OBSERVER).  It emits deterministic event records and
 * counts events from real production code paths; it never drives
 * production state.  Production firmware builds contain no observer
 * symbols.
 */

#ifndef BSIM_OBSERVER_H
#define BSIM_OBSERVER_H

#include <stdbool.h>
#include <stddef.h>
#include <stdint.h>

#include <zephyr/bluetooth/audio/audio.h>
#include <zephyr/bluetooth/audio/bap.h>

/** ASE Config accepted/rejected with direction/code/reason. */
void bsim_observer_config(bool accepted, enum bt_audio_dir dir, enum bt_bap_ascs_rsp_code code,
			  enum bt_bap_ascs_reason reason);

/** Audio-path gate opened (all required ASEs started). */
void bsim_observer_gate_open(void);

/** Audio-path gate closed (first close of an open gate). */
void bsim_observer_gate_close(void);

/** Valid-flag SDU rejected before decode (length mismatch). */
void bsim_observer_malformed_sdu(void);

/** Valid SDU received while the audio-path gate is closed. */
void bsim_observer_recv_gate_blocked(void);

/** Mode A older unmatched half discarded. */
void bsim_observer_stale_half(void);

/** Release cleanup completed for a sink slot. */
void bsim_observer_cleanup_release(unsigned int slot);

/** Disconnect cleanup completed. */
void bsim_observer_cleanup_disconnect(void);

/** Release closed an open audio path and stopped the sink immediately. */
void bsim_observer_release_sink_stop(void);

/** Mode A SDU arrived without the ISO TS flag (half skipped). */
void bsim_observer_missing_ts(void);

#define BSIM_OBSERVER_MAX_PAYLOAD_BYTES 120U

struct bsim_observer_push_half {
	bool source_valid;
	uint16_t payload_len;
	uint8_t payload[BSIM_OBSERVER_MAX_PAYLOAD_BYTES];
};

struct bsim_observer_push {
	struct bsim_observer_push_half left;
	struct bsim_observer_push_half right;
};

/* Copy source-validity and exact compressed payload bytes immediately before
 * a sink push. Valid halves require a non-null 1..120-byte payload; invalid
 * halves require NULL/zero. The snapshot is consumed by the immediate sink
 * call and never retains caller storage. */
void bsim_observer_pre_push(bool l_valid, const uint8_t *l_payload, size_t l_payload_len,
			    bool r_valid, const uint8_t *r_payload, size_t r_payload_len);

/* Copy and consume the one fresh pre-push snapshot. False means absent,
 * malformed, or already consumed metadata. */
bool bsim_observer_take_push(struct bsim_observer_push *out);

/* ── queries for the receiver scenario driver ────────────────────── */

uint32_t bsim_observer_get_config_accepted(void);
uint32_t bsim_observer_get_config_rejected(void);
int bsim_observer_get_last_config_dir(void);
int bsim_observer_get_last_config_code(void);
int bsim_observer_get_last_config_reason(void);
/* Last REJECTED config (the last config overall may be a success). */
int bsim_observer_get_last_rej_dir(void);
int bsim_observer_get_last_rej_code(void);
int bsim_observer_get_last_rej_reason(void);
uint32_t bsim_observer_get_gate_open(void);
uint32_t bsim_observer_get_gate_close(void);
uint32_t bsim_observer_get_malformed_sdu(void);
uint32_t bsim_observer_get_recv_gate_blocked(void);
uint32_t bsim_observer_get_stale_half(void);
uint32_t bsim_observer_get_release_cleanup(void);
uint32_t bsim_observer_get_disconnect_cleanup(void);
uint32_t bsim_observer_get_release_sink_stop(void);
uint32_t bsim_observer_get_missing_ts(void);

/* Monotonic event sequence numbers for ordering proofs. */
uint32_t bsim_observer_get_event_seq(void);
uint32_t bsim_observer_get_release_sink_stop_seq(void);
uint32_t bsim_observer_get_disconnect_seq(void);

#endif /* BSIM_OBSERVER_H */
```

## src/bsim_sink_oracle.h
```c
/*
 * Copyright (c) 2025
 * SPDX-License-Identifier: Apache-2.0
 *
 * BSIM-only scenario-aware strict sink oracle — test-side interface.
 *
 * The public audio_sink.h API is unchanged; these test-only functions
 * configure the oracle and query its records.  Production firmware builds
 * contain no oracle symbols.
 */

#ifndef BSIM_SINK_ORACLE_H
#define BSIM_SINK_ORACLE_H

#include <stdbool.h>
#include <stdint.h>

#include "pcm_oracle.h"

#define BSIM_SINK_MAX_SEGMENTS 4

/* Scenario ids — mirror the client test ids and the runner. */
enum bsim_sink_scenario {
	BSIM_SCN_MONO_10MS = 1,
	BSIM_SCN_MONO_7P5MS,
	BSIM_SCN_MODEA_10MS,
	BSIM_SCN_MODEA_7P5MS,
	BSIM_SCN_MODEA_REVERSE_START_10MS,
	BSIM_SCN_MODEB_10MS,
	BSIM_SCN_MODEB_7P5MS,
	BSIM_SCN_INVALID_SDU_RESUME_10MS,
	BSIM_SCN_MODEA_FIRST_STOP_10MS,
	BSIM_SCN_RELEASE_WITHOUT_DISABLE_10MS,
	BSIM_SCN_DISCONNECT_STREAMING_10MS,
	BSIM_SCN_RECONNECT_SECOND_STREAM_10MS,
	BSIM_SCN_UNSUPPORTED_SOURCE_DIRECTION,
	BSIM_SCN_NO_FREE_SINK_SLOT,
	BSIM_SCN_INVALID_CODEC_FIELDS,
	BSIM_SCN_MODEA_ONE_CIS_LOSS_10MS,
	BSIM_SCN_DUPLICATE_RELEASE_10MS,
};

/* Scheduled single-CIS losses in the Mode A one-CIS-loss scenario
 * (client side pauses the right stream mid-stream for a bounded
 * window, so its CIS loses those events).  The oracle uses this exact
 * count for the post-start concealed-push and post-start PLC
 * accounting. */
#define BSIM_MODEA_LOSS_COUNT 18

/** Per-segment strict record. */
struct bsim_sink_segment {
	uint32_t pushes;            /* post-boundary nonzero source-valid pushes */
	uint32_t transients;        /* pushes before the source-valid boundary */
	uint32_t startup_zero;      /* zero-energy pushes (subset of transients) */
	uint32_t startup_plc;       /* audio_stats plc at the last startup transient */
	uint32_t total_frames;      /* audio_stats total_frames at finalize */
	uint32_t plc_frames;        /* audio_stats plc_frames at finalize */
	uint32_t decode_errors;     /* audio_stats decode_errors at finalize */
	uint32_t malformed_samples; /* pushes with a wrong sample count */
	int32_t l_energy_min;
	int32_t l_energy_max;
	int32_t r_energy_min;
	int32_t r_energy_max;
	uint32_t configured_samples; /* expected int16 values per push */
	uint32_t samples_per_channel;
	const char *l_recipe_id;
	const char *r_recipe_id;
	uint32_t l_recipe_actions;
	uint32_t l_recipe_valid;
	uint32_t l_recipe_plc;
	uint32_t r_recipe_actions;
	uint32_t r_recipe_valid;
	uint32_t r_recipe_plc;
	uint32_t l_excluded_frames;
	uint32_t r_excluded_frames;
	uint32_t differing_samples;
	struct pcm_oracle_metrics l_metrics;
	struct pcm_oracle_metrics r_metrics;
	enum pcm_oracle_result l_evaluation;
	enum pcm_oracle_result r_evaluation;
	bool finalized;
};

/* Validate immutable stateful recipe table and its BSim corpus/reference
 * bindings before any scenario starts. */
bool audio_sink_test_recipes_validate(void);

/**
 * Configure the oracle for one scenario.
 *
 * @param scenario  Scenario id.
 * @param dec_calls Decoder invocations per pushed SDU (mono = 1,
 *                  Mode A / Mode B = 2).
 */
void audio_sink_test_begin(enum bsim_sink_scenario scenario, int dec_calls);

/**
 * True when the scenario's end condition is met and all invariants hold.
 * Never true after a fault (faults FAIL immediately instead).
 */
bool audio_sink_test_goal_reached(void);

/**
 * Re-check all per-segment invariants (decode errors, PLC placement,
 * total-frame accounting, numerical PCM evaluation, routing evidence, energy
 * bounds, PACS contexts). FAILs immediately on first violation.
 *
 * @return true when all invariants hold.
 */
bool audio_sink_test_validate(void);

/** Number of finalized segments so far. */
int audio_sink_test_segment_count(void);

/** Copy one finalized segment record.  Returns false if not finalized. */
bool audio_sink_test_get_segment(int idx, struct bsim_sink_segment *out);

/** Cumulative pushes-after-stop across all segments (never hidden). */
uint32_t audio_sink_test_after_stop_total(void);

#endif /* BSIM_SINK_ORACLE_H */
```

## src/bsim_test_helpers.h
```c
/*
 * Copyright (c) 2025
 * SPDX-License-Identifier: Apache-2.0
 *
 * Shared BSIM test helpers — PASS/FAIL macros and bst_result extern.
 */
#ifndef BSIM_TEST_HELPERS_H
#define BSIM_TEST_HELPERS_H

#include <bs_tracing.h>
#include <bstests.h>

extern enum bst_result_t bst_result;

#define FAIL(...)                                                                                  \
	do {                                                                                       \
		bst_result = Failed;                                                               \
		bs_trace_error_time_line(__VA_ARGS__);                                             \
	} while (0)

#define PASS(...)                                                                                  \
	do {                                                                                       \
		bst_result = Passed;                                                               \
		bs_trace_info_time(1, __VA_ARGS__);                                                \
	} while (0)

#endif /* BSIM_TEST_HELPERS_H */
```

## src/bsim_test_main.c
```c
/*
 * Copyright (c) 2025
 * SPDX-License-Identifier: Apache-2.0
 *
 * BSIM receiver test — BT init, BAP, scenario driver, and PASS
 * composition.  One BST test ID per T4 scenario; the runner selects the
 * scenario with -testid.
 *
 * The BAP callbacks (bt_bap.c) handle incoming streams and push decoded
 * PCM to the audio sink oracle (audio_sink_stub.c).  For the disconnect
 * scenarios the driver mirrors the production main ownership: wait for
 * disconnect, restart advertising, keep serving.
 */

#include <errno.h>
#include <zephyr/bluetooth/bluetooth.h>
#include <zephyr/settings/settings.h>
#include <zephyr/kernel.h>

#include <bstests.h>
#include "bsim_test_helpers.h"
#include "bsim_sink_oracle.h"
#include "bsim_observer.h"
#include "bsim_pcm_limits.h"
#include "audio_sink.h"
#include "bt_bap.h"

#define TEST_TIMEOUT_US (60 * 1000000) /* 60 seconds */

static const char *scenario_names[] = {
	"",                             /* 0 */
	"mono_10ms",                    /* 1 */
	"mono_7p5ms",                   /* 2 */
	"modea_10ms",                   /* 3 */
	"modea_7p5ms",                  /* 4 */
	"modea_reverse_start_10ms",     /* 5 */
	"modeb_10ms",                   /* 6 */
	"modeb_7p5ms",                  /* 7 */
	"invalid_sdu_resume_10ms",      /* 8 */
	"modea_first_stop_10ms",        /* 9 */
	"release_without_disable_10ms", /* 10 */
	"disconnect_streaming_10ms",    /* 11 */
	"reconnect_second_stream_10ms", /* 12 */
	"unsupported_source_direction", /* 13 */
	"no_free_sink_slot",            /* 14 */
	"invalid_codec_fields",         /* 15 */
	"modea_one_cis_loss_10ms",      /* 16 */
	"duplicate_release_10ms",       /* 17 */
};

static int bsim_volatile_settings_load(struct settings_store *cs,
				       const struct settings_load_arg *arg)
{
	(void)cs;
	(void)arg;

	return 0;
}

static int bsim_volatile_settings_save(struct settings_store *cs, const char *name,
				       const char *value, size_t val_len)
{
	(void)cs;
	(void)name;
	(void)value;
	(void)val_len;

	return 0;
}

static const struct settings_store_itf bsim_volatile_settings_itf = {
	.csi_load = bsim_volatile_settings_load,
	.csi_save = bsim_volatile_settings_save,
};

static struct settings_store bsim_volatile_settings_store = {
	.cs_itf = &bsim_volatile_settings_itf,
};

static bool bsim_volatile_settings_registered;

static void bsim_volatile_settings_register(void)
{
	if (bsim_volatile_settings_registered) {
		return;
	}

	settings_src_register(&bsim_volatile_settings_store);
	settings_dst_register(&bsim_volatile_settings_store);
	bsim_volatile_settings_registered = true;
}

static void test_init_f(void)
{
	bst_ticker_set_next_tick_absolute(TEST_TIMEOUT_US);
	bst_result = In_progress;
}

static void test_tick_f(bs_time_t HW_device_time)
{
	if (bst_result != Passed) {
		FAIL("le_audio_receiver: timeout after 60 s — no PASS\n");
	}
}

static bool scenario_observer_ok(enum bsim_sink_scenario scn)
{
	switch (scn) {
	case BSIM_SCN_MODEA_FIRST_STOP_10MS:
		/* The first Disable closed the gate exactly once; BOTH
		 * slot cleanups complete (the second runs while the gate is
		 * already closed) and no Release caused the first edge.  The
		 * receiver PASSes only after the second cleanup so the
		 * record proves the full Mode A release sequence. */
		return bsim_observer_get_gate_close() == 1U &&
		       bsim_observer_get_release_cleanup() == 2U &&
		       bsim_observer_get_release_sink_stop() == 0U;
	case BSIM_SCN_RELEASE_WITHOUT_DISABLE_10MS:
		/* The ordering proof needs the disconnect event sequence too:
		 * PASS only after the client's ACL disconnect, so
		 * rel_ss_seq < disc_seq is observable in the record. */
		return bsim_observer_get_release_cleanup() == 1U &&
		       bsim_observer_get_release_sink_stop() == 1U &&
		       bsim_observer_get_disconnect_cleanup() == 1U;
	case BSIM_SCN_UNSUPPORTED_SOURCE_DIRECTION:
		return bsim_observer_get_config_rejected() >= 1U &&
		       bsim_observer_get_last_config_dir() == (int)BT_AUDIO_DIR_SOURCE &&
		       bsim_observer_get_last_config_code() ==
			       (int)BT_BAP_ASCS_RSP_CODE_CONF_UNSUPPORTED &&
		       bsim_observer_get_last_config_reason() == (int)BT_BAP_ASCS_REASON_NONE &&
		       bsim_observer_get_config_accepted() == 0U;
	case BSIM_SCN_NO_FREE_SINK_SLOT:
		/* Exactly three first-time slot cleanups (2 initial +
		 * 1 reuse); the NO_MEM failure consumed no slot. */
		return bsim_observer_get_config_accepted() >= 3U &&
		       bsim_observer_get_config_rejected() == 1U &&
		       bsim_observer_get_last_rej_code() == (int)BT_BAP_ASCS_RSP_CODE_NO_MEM &&
		       bsim_observer_get_last_rej_reason() == (int)BT_BAP_ASCS_REASON_NONE &&
		       bsim_observer_get_release_cleanup() == 3U;
	case BSIM_SCN_INVALID_CODEC_FIELDS:
		/* Two accepted configs overall (valid mono + missing-frame-
		 * blocks fallback); the last rejection is CONF_REJECTED.
		 * Both post-config releases complete before PASS so the
		 * record proves every accepted config's slot was cleaned. */
		return bsim_observer_get_config_rejected() >= 9U &&
		       bsim_observer_get_config_accepted() >= 2U &&
		       bsim_observer_get_last_rej_code() ==
			       (int)BT_BAP_ASCS_RSP_CODE_CONF_REJECTED &&
		       bsim_observer_get_last_rej_reason() == (int)BT_BAP_ASCS_REASON_CODEC_DATA &&
		       bsim_observer_get_release_cleanup() == 2U;
	case BSIM_SCN_DUPLICATE_RELEASE_10MS:
		/* R7 exact duplicate-release oracle: exactly two first-time
		 * slot cleanups (streaming release + reused-slot release),
		 * exactly one release sink-stop (only the streaming release
		 * closed the gate), one gate close, then the disconnect
		 * cleanup.  The duplicate same-slot release was rejected by
		 * the transport, so the cleanup count stays at two. */
		return bsim_observer_get_release_cleanup() == 2U &&
		       bsim_observer_get_release_sink_stop() == 1U &&
		       bsim_observer_get_gate_close() == 1U &&
		       bsim_observer_get_disconnect_cleanup() >= 1U;
	default:
		return true;
	}
}

static void receiver_pass(enum bsim_sink_scenario scn, bool adv_restarted)
{
	struct bsim_sink_segment s0;
	struct bsim_sink_segment s1;
	const struct bsim_sink_segment no_segment = {
		.l_recipe_id = "none",
		.r_recipe_id = "none",
		.l_evaluation = PCM_ORACLE_RESULT_INSUFFICIENT_SAMPLES,
		.r_evaluation = PCM_ORACLE_RESULT_INSUFFICIENT_SAMPLES,
	};
	bool have_s0 = audio_sink_test_get_segment(0, &s0);
	bool have_s1 = audio_sink_test_get_segment(1, &s1);
	const struct bsim_sink_segment *seg1 = have_s0 ? &s0 : &no_segment;
	const struct bsim_sink_segment *seg2 = have_s1 ? &s1 : &no_segment;

	PASS("le_audio_receiver: scenario=%s seg=%u after=%u adv_restart=%u pacs=1 "
	     "obs_ok=%u obs_rej=%u obs_dir=%d obs_code=%d obs_reason=%d "
	     "obs_gate_o=%u obs_gate_c=%u obs_mal=%u obs_blk=%u obs_stale=%u "
	     "obs_rel=%u obs_disc=%u obs_rej_code=%d obs_rej_reason=%d "
	     "obs_mts=%u obs_rel_ss=%u rel_ss_seq=%u disc_seq=%u "
	     "limmax=%u limrms=%u limcorr=%d "
	     "pushes1=%u trans1=%u szero1=%u splc1=%u plc1=%u total1=%u derr1=%u mal1=%u "
	     "samples1=%u spc1=%u diff1=%u lemin1=%d lemax1=%d remin1=%d remax1=%d "
	     "lrid1=%s lact1=%u lval1=%u lplc1=%u rrid1=%s ract1=%u rval1=%u rplc1=%u "
	     "lfr1=%u lsm1=%u lex1=%u lmax1=%u lsse1=%llu lrms1=%u lcorr1=%d lres1=%u "
	     "rfr1=%u rsm1=%u rex1=%u rmax1=%u rsse1=%llu rrms1=%u rcorr1=%d rres1=%u "
	     "pushes2=%u trans2=%u szero2=%u splc2=%u plc2=%u total2=%u derr2=%u mal2=%u "
	     "samples2=%u spc2=%u diff2=%u lemin2=%d lemax2=%d remin2=%d remax2=%d "
	     "lrid2=%s lact2=%u lval2=%u lplc2=%u rrid2=%s ract2=%u rval2=%u rplc2=%u "
	     "lfr2=%u lsm2=%u lex2=%u lmax2=%u lsse2=%llu lrms2=%u lcorr2=%d lres2=%u "
	     "rfr2=%u rsm2=%u rex2=%u rmax2=%u rsse2=%llu rrms2=%u rcorr2=%d rres2=%u\n",
	     scenario_names[scn], audio_sink_test_segment_count(),
	     audio_sink_test_after_stop_total(), adv_restarted ? 1U : 0U,
	     bsim_observer_get_config_accepted(), bsim_observer_get_config_rejected(),
	     bsim_observer_get_last_config_dir(), bsim_observer_get_last_config_code(),
	     bsim_observer_get_last_config_reason(), bsim_observer_get_gate_open(),
	     bsim_observer_get_gate_close(), bsim_observer_get_malformed_sdu(),
	     bsim_observer_get_recv_gate_blocked(), bsim_observer_get_stale_half(),
	     bsim_observer_get_release_cleanup(), bsim_observer_get_disconnect_cleanup(),
	     bsim_observer_get_last_rej_code(), bsim_observer_get_last_rej_reason(),
	     bsim_observer_get_missing_ts(), bsim_observer_get_release_sink_stop(),
	     bsim_observer_get_release_sink_stop_seq(), bsim_observer_get_disconnect_seq(),
	     BSIM_PCM_MAX_ABS_ERROR, BSIM_PCM_MAX_RMS_ERROR, BSIM_PCM_MIN_CORRELATION_Q15,
	     seg1->pushes, seg1->transients, seg1->startup_zero, seg1->startup_plc,
	     seg1->plc_frames, seg1->total_frames, seg1->decode_errors, seg1->malformed_samples,
	     seg1->configured_samples, seg1->samples_per_channel, seg1->differing_samples,
	     seg1->l_energy_min, seg1->l_energy_max, seg1->r_energy_min, seg1->r_energy_max,
	     seg1->l_recipe_id, seg1->l_recipe_actions, seg1->l_recipe_valid, seg1->l_recipe_plc,
	     seg1->r_recipe_id, seg1->r_recipe_actions, seg1->r_recipe_valid, seg1->r_recipe_plc,
	     seg1->l_metrics.frames, seg1->l_metrics.samples, seg1->l_excluded_frames,
	     seg1->l_metrics.max_abs_error, (unsigned long long)seg1->l_metrics.squared_error,
	     seg1->l_metrics.rms_error, seg1->l_metrics.correlation_q15,
	     (unsigned int)seg1->l_evaluation, seg1->r_metrics.frames, seg1->r_metrics.samples,
	     seg1->r_excluded_frames, seg1->r_metrics.max_abs_error,
	     (unsigned long long)seg1->r_metrics.squared_error, seg1->r_metrics.rms_error,
	     seg1->r_metrics.correlation_q15, (unsigned int)seg1->r_evaluation, seg2->pushes,
	     seg2->transients, seg2->startup_zero, seg2->startup_plc, seg2->plc_frames,
	     seg2->total_frames, seg2->decode_errors, seg2->malformed_samples,
	     seg2->configured_samples, seg2->samples_per_channel, seg2->differing_samples,
	     seg2->l_energy_min, seg2->l_energy_max, seg2->r_energy_min, seg2->r_energy_max,
	     seg2->l_recipe_id, seg2->l_recipe_actions, seg2->l_recipe_valid, seg2->l_recipe_plc,
	     seg2->r_recipe_id, seg2->r_recipe_actions, seg2->r_recipe_valid, seg2->r_recipe_plc,
	     seg2->l_metrics.frames, seg2->l_metrics.samples, seg2->l_excluded_frames,
	     seg2->l_metrics.max_abs_error, (unsigned long long)seg2->l_metrics.squared_error,
	     seg2->l_metrics.rms_error, seg2->l_metrics.correlation_q15,
	     (unsigned int)seg2->l_evaluation, seg2->r_metrics.frames, seg2->r_metrics.samples,
	     seg2->r_excluded_frames, seg2->r_metrics.max_abs_error,
	     (unsigned long long)seg2->r_metrics.squared_error, seg2->r_metrics.rms_error,
	     seg2->r_metrics.correlation_q15, (unsigned int)seg2->r_evaluation);
}

static void scenario_main(enum bsim_sink_scenario scn, int dec_calls)
{
	bt_addr_le_t identity = {
		.type = BT_ADDR_LE_RANDOM,
		.a = {.val = {0x00, 0x00, 0x00, 0x00, 0x00, 0xC0}},
	};
	int err;
	bool disc_handled = false;
	uint32_t last_disc = 0U;

	printk("=== LE Audio Receiver BSIM Test — scenario %s ===\n", scenario_names[scn]);
	if (!audio_sink_test_recipes_validate()) {
		FAIL("le_audio_receiver: stateful recipe table/binding validation failed\n");
		return;
	}

	bsim_volatile_settings_register();
	err = bt_id_create(&identity, NULL);
	if (err != BT_ID_DEFAULT) {
		FAIL("le_audio_receiver: identity create failed: %d\n", err);
		return;
	}

	err = bt_enable(NULL);
	if (err) {
		FAIL("le_audio_receiver: Bluetooth init failed: %d\n", err);
		return;
	}
	printk("BLE ready\n");

	/* settings_load required for dynamic PACS/ASCS registration. The test-local
	 * volatile backend returns success without loading or retaining entries. */
	err = settings_load();
	if (err) {
		FAIL("le_audio_receiver: settings_load failed: %d\n", err);
		return;
	}
	printk("settings_load OK\n");

	err = bt_bap_init();
	if (err) {
		FAIL("le_audio_receiver: BAP init failed: %d\n", err);
		return;
	}

	err = audio_sink_init();
	if (err) {
		FAIL("le_audio_receiver: audio sink init failed: %d\n", err);
		return;
	}

	audio_sink_test_begin(scn, dec_calls);

	err = bt_bap_restart_advertising();
	if (err) {
		FAIL("le_audio_receiver: advertising start failed: %d\n", err);
		return;
	}

	printk("Advertising as \"%s\"\n", CONFIG_BT_DEVICE_NAME);

	while (bst_result == In_progress) {
		if (audio_sink_test_goal_reached() && scenario_observer_ok(scn) &&
		    audio_sink_test_validate()) {
			receiver_pass(scn, disc_handled);
			return;
		}

		if (scn == BSIM_SCN_DISCONNECT_STREAMING_10MS ||
		    scn == BSIM_SCN_RECONNECT_SECOND_STREAM_10MS) {
			if (!disc_handled) {
				/* Production main ownership: wait for the ACL
				 * disconnect, then restart advertising. */
				bt_bap_wait_disconnect();
				err = bt_bap_restart_advertising();
				if (err) {
					FAIL("le_audio_receiver: advertising restart failed: %d\n",
					     err);
					return;
				}
				printk("Advertising restarted after disconnect\n");
				disc_handled = true;
			}
		} else if (bsim_observer_get_disconnect_cleanup() > last_disc) {
			/* Multi-connection scenarios (reconnect, source rejection,
			 * NO_MEM, invalid codec fields): the client disconnects
			 * between rounds — restart advertising exactly like the
			 * production main loop so the next round can reconnect. */
			last_disc = bsim_observer_get_disconnect_cleanup();
			err = bt_bap_restart_advertising();
			if (err) {
				FAIL("le_audio_receiver: advertising restart failed: %d\n", err);
				return;
			}
			printk("Advertising restarted after disconnect\n");
		}
		k_sleep(K_MSEC(100));
	}

	/* If we reach here without PASS, the tick timeout will FAIL */
}

#define SCENARIO_MAIN(_scn, _dec)                                                                  \
	static void test_main_##_scn(void)                                                         \
	{                                                                                          \
		scenario_main(_scn, _dec);                                                         \
	}

SCENARIO_MAIN(BSIM_SCN_MONO_10MS, 1)
SCENARIO_MAIN(BSIM_SCN_MONO_7P5MS, 1)
SCENARIO_MAIN(BSIM_SCN_MODEA_10MS, 2)
SCENARIO_MAIN(BSIM_SCN_MODEA_7P5MS, 2)
SCENARIO_MAIN(BSIM_SCN_MODEA_REVERSE_START_10MS, 2)
SCENARIO_MAIN(BSIM_SCN_MODEB_10MS, 2)
SCENARIO_MAIN(BSIM_SCN_MODEB_7P5MS, 2)
SCENARIO_MAIN(BSIM_SCN_INVALID_SDU_RESUME_10MS, 1)
SCENARIO_MAIN(BSIM_SCN_MODEA_FIRST_STOP_10MS, 2)
SCENARIO_MAIN(BSIM_SCN_RELEASE_WITHOUT_DISABLE_10MS, 1)
SCENARIO_MAIN(BSIM_SCN_DISCONNECT_STREAMING_10MS, 1)
SCENARIO_MAIN(BSIM_SCN_RECONNECT_SECOND_STREAM_10MS, 1)
SCENARIO_MAIN(BSIM_SCN_UNSUPPORTED_SOURCE_DIRECTION, 1)
SCENARIO_MAIN(BSIM_SCN_NO_FREE_SINK_SLOT, 1)
SCENARIO_MAIN(BSIM_SCN_INVALID_CODEC_FIELDS, 1)
SCENARIO_MAIN(BSIM_SCN_MODEA_ONE_CIS_LOSS_10MS, 2)
SCENARIO_MAIN(BSIM_SCN_DUPLICATE_RELEASE_10MS, 1)

static const struct bst_test_instance test_def[] = {
	{
		.test_id = "mono_10ms",
		.test_descr = "T4 mono 10 ms — strict oracle",
		.test_pre_init_f = test_init_f,
		.test_main_f = test_main_BSIM_SCN_MONO_10MS,
		.test_tick_f = test_tick_f,
	},
	{
		.test_id = "mono_7p5ms",
		.test_descr = "T4 mono 7.5 ms — strict oracle",
		.test_pre_init_f = test_init_f,
		.test_main_f = test_main_BSIM_SCN_MONO_7P5MS,
		.test_tick_f = test_tick_f,
	},
	{
		.test_id = "modea_10ms",
		.test_descr = "T4 Mode A 10 ms — strict oracle",
		.test_pre_init_f = test_init_f,
		.test_main_f = test_main_BSIM_SCN_MODEA_10MS,
		.test_tick_f = test_tick_f,
	},
	{
		.test_id = "modea_7p5ms",
		.test_descr = "T4 Mode A 7.5 ms — strict oracle",
		.test_pre_init_f = test_init_f,
		.test_main_f = test_main_BSIM_SCN_MODEA_7P5MS,
		.test_tick_f = test_tick_f,
	},
	{
		.test_id = "modea_reverse_start_10ms",
		.test_descr = "T4 Mode A 10 ms reverse start",
		.test_pre_init_f = test_init_f,
		.test_main_f = test_main_BSIM_SCN_MODEA_REVERSE_START_10MS,
		.test_tick_f = test_tick_f,
	},
	{
		.test_id = "modea_one_cis_loss_10ms",
		.test_descr = "T4 Mode A 10 ms with 3 scheduled right-CIS losses",
		.test_pre_init_f = test_init_f,
		.test_main_f = test_main_BSIM_SCN_MODEA_ONE_CIS_LOSS_10MS,
		.test_tick_f = test_tick_f,
	},
	{
		.test_id = "modeb_10ms",
		.test_descr = "T4 Mode B 10 ms — strict oracle",
		.test_pre_init_f = test_init_f,
		.test_main_f = test_main_BSIM_SCN_MODEB_10MS,
		.test_tick_f = test_tick_f,
	},
	{
		.test_id = "modeb_7p5ms",
		.test_descr = "T4 Mode B 7.5 ms — strict oracle",
		.test_pre_init_f = test_init_f,
		.test_main_f = test_main_BSIM_SCN_MODEB_7P5MS,
		.test_tick_f = test_tick_f,
	},
	{
		.test_id = "invalid_sdu_resume_10ms",
		.test_descr = "T4 malformed SDU then resume",
		.test_pre_init_f = test_init_f,
		.test_main_f = test_main_BSIM_SCN_INVALID_SDU_RESUME_10MS,
		.test_tick_f = test_tick_f,
	},
	{
		.test_id = "modea_first_stop_10ms",
		.test_descr = "T4 first Mode A ASE stops",
		.test_pre_init_f = test_init_f,
		.test_main_f = test_main_BSIM_SCN_MODEA_FIRST_STOP_10MS,
		.test_tick_f = test_tick_f,
	},
	{
		.test_id = "release_without_disable_10ms",
		.test_descr = "T4 release without disable",
		.test_pre_init_f = test_init_f,
		.test_main_f = test_main_BSIM_SCN_RELEASE_WITHOUT_DISABLE_10MS,
		.test_tick_f = test_tick_f,
	},
	{
		.test_id = "disconnect_streaming_10ms",
		.test_descr = "T4 disconnect while streaming",
		.test_pre_init_f = test_init_f,
		.test_main_f = test_main_BSIM_SCN_DISCONNECT_STREAMING_10MS,
		.test_tick_f = test_tick_f,
	},
	{
		.test_id = "reconnect_second_stream_10ms",
		.test_descr = "T4 reconnect and second stream",
		.test_pre_init_f = test_init_f,
		.test_main_f = test_main_BSIM_SCN_RECONNECT_SECOND_STREAM_10MS,
		.test_tick_f = test_tick_f,
	},
	{
		.test_id = "unsupported_source_direction",
		.test_descr = "T4 source-direction rejection",
		.test_pre_init_f = test_init_f,
		.test_main_f = test_main_BSIM_SCN_UNSUPPORTED_SOURCE_DIRECTION,
		.test_tick_f = test_tick_f,
	},
	{
		.test_id = "no_free_sink_slot",
		.test_descr = "T4 NO_MEM on third sink",
		.test_pre_init_f = test_init_f,
		.test_main_f = test_main_BSIM_SCN_NO_FREE_SINK_SLOT,
		.test_tick_f = test_tick_f,
	},
	{
		.test_id = "invalid_codec_fields",
		.test_descr = "T4 invalid codec field variants",
		.test_pre_init_f = test_init_f,
		.test_main_f = test_main_BSIM_SCN_INVALID_CODEC_FIELDS,
		.test_tick_f = test_tick_f,
	},
	{
		.test_id = "modea_one_cis_loss_10ms",
		.test_descr = "T4 Mode A 10 ms with 3 scheduled right-CIS losses",
		.test_pre_init_f = test_init_f,
		.test_main_f = test_main_BSIM_SCN_MODEA_ONE_CIS_LOSS_10MS,
		.test_tick_f = test_tick_f,
	},
	{
		.test_id = "duplicate_release_10ms",
		.test_descr = "R7 duplicate same-slot release rejected + slot reuse",
		.test_pre_init_f = test_init_f,
		.test_main_f = test_main_BSIM_SCN_DUPLICATE_RELEASE_10MS,
		.test_tick_f = test_tick_f,
	},
	BSTEST_END_MARKER,
};

struct bst_test_list *test_le_audio_receiver_install(struct bst_test_list *tests)
{
	return bst_add_tests(tests, test_def);
}

bst_test_install_t test_installers[] = {
	test_le_audio_receiver_install,
	NULL,
};
```
