## tests/unit/bt_shell_pairing/testcase.yaml
```yaml
tests:
  unit.bt_shell_pairing:
    platform_allow: native_sim/native/64
    tags: audio pairing shell diagnostics
```

## tests/unit/clock_loop/Kconfig
```kconfig
source "Kconfig.zephyr"
config AUDIO_DRIFT_OUTPUT_CLAMP
    int "Model uses production output clamp"
config AUDIO_DRIFT_PHASE_INTEGRAL_CLAMP
    int "Model uses production phase integral clamp"
```

## tests/unit/drift/testcase.yaml
```yaml
tests:
  unit.drift:
    platform_allow: native_sim/native/64
    tags: audio drift apll
```

## tests/unit/flpr_acceptance/testcase.yaml
```yaml
tests:
  unit.flpr_acceptance:
    tags: flpr acceptance
    platform_allow: native_sim
    integration_platforms:
      - native_sim
```

## tests/unit/flpr_acceptance_flpr/testcase.yaml
```yaml
tests:
  unit.flpr_acceptance_flpr:
    tags: flpr acceptance flpr_image
    platform_allow: native_sim
    integration_platforms:
      - native_sim
```

## tests/unit/flpr_handshake/testcase.yaml
```yaml
tests:
  unit.flpr_handshake:
    tags: flpr
    platform_allow: native_sim
    integration_platforms:
      - native_sim
```

## tests/unit/flpr_protocol/testcase.yaml
```yaml
tests:
  unit.flpr_protocol:
    platform_allow: native_sim/native/64
    tags: flpr protocol unit
```

## tests/unit/flpr_ring_mgr/testcase.yaml
```yaml
tests:
  unit.flpr_ring_mgr:
    tags: flpr ring_mgr
    platform_allow: native_sim
    integration_platforms:
      - native_sim
```

## tests/unit/flpr_runtime/testcase.yaml
```yaml
tests:
  unit.flpr_runtime:
    tags: flpr runtime
    platform_allow: native_sim
    integration_platforms:
      - native_sim
```

## tests/unit/hci_remove_iso_path_trace/testcase.yaml
```yaml
tests:
  unit.hci_remove_iso_path_trace:
    platform_allow: native_sim/native/64
    tags: hci trace
```

## tests/unit/hil_source_signal/testcase.yaml
```yaml
tests:
  hil.source_signal:
    platform_allow: native_sim/native/64
    integration_platforms:
      - native_sim/native/64
```

## tests/unit/iso_seq/testcase.yaml
```yaml
tests:
  audio.iso_seq:
    platform_allow: native_sim/native/64
    integration_platforms:
      - native_sim/native/64
```

## tests/unit/lifecycle/testcase.yaml
```yaml
tests:
  unit.lifecycle:
    platform_allow: native_sim/native/64
    tags: audio lifecycle
```

## tests/unit/pairing_mode/testcase.yaml
```yaml
tests:
  unit.pairing_mode:
    platform_allow: native_sim/native/64
    tags: audio pairing mode
```

## tests/unit/perf/testcase.yaml
```yaml
tests:
  unit.perf:
    platform_allow: native_sim/native/64
    tags: audio perf instrumentation
```

## tests/unit/rate_convert/testcase.yaml
```yaml
tests:
  audio.rate_convert:
    platform_allow: native_sim/native/64
    integration_platforms:
      - native_sim/native/64
```

## tests/unit/sdc_hci_remove_iso_path_trace/testcase.yaml
```yaml
tests:
  unit.sdc_hci_remove_iso_path_trace:
    platform_allow: native_sim/native/64
    tags: sdc trace
```

## tests/unit/timing/testcase.yaml
```yaml
tests:
  unit.timing:
    platform_allow: native_sim/native/64
    tags: audio timing grtc
```

## tests/unit/timing_none/testcase.yaml
```yaml
tests:
  unit.timing_none:
    platform_allow: native_sim/native/64
    tags: audio timing
```

## tests/unit/timing_nrf54/testcase.yaml
```yaml
tests:
  unit.timing_nrf54:
    platform_allow: native_sim/native/64
    tags: audio timing nrf54 grtc gppi
```

## tests/unit/user_pairing_io/testcase.yaml
```yaml
tests:
  unit.user_pairing_io:
    platform_allow: native_sim/native/64
    tags: audio pairing io input
```
