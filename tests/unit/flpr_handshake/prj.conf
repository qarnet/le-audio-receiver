## CMakeLists.txt
```
cmake_minimum_required(VERSION 3.20.0)

# The boards/<board>.overlay auto-discovery does not match the
# native_sim/native/64 variant board string, so apply the fake-backend
# overlay explicitly.
set(DTC_OVERLAY_FILE ${CMAKE_CURRENT_SOURCE_DIR}/boards/native_sim.overlay
    CACHE STRING "Devicetree overlay for the fake IPC backend" FORCE)

find_package(Zephyr REQUIRED HINTS $ENV{ZEPHYR_BASE})
project(test_flpr_handshake)

# T1C: execute the REAL handshake implementation on native_sim against a
# fake IPC service backend (patterned on the NCS v3.3.0 ipc_service test
# backend).  Production src/flpr_handshake.c uses the real Zephyr
# ipc_service_* APIs; the fake backend captures the endpoint config,
# invokes the production callbacks, records sent messages, and exposes
# test controls.  FLPR_HANDSHAKE_NATIVE_TEST adds the test-only hooks.
target_sources(app PRIVATE
  src/test_flpr_handshake.c
  src/fake_ipc_backend.c
  ${CMAKE_CURRENT_SOURCE_DIR}/../../../src/flpr_handshake.c
)

target_include_directories(app PRIVATE
  src
  ${CMAKE_CURRENT_SOURCE_DIR}/../../../src
)

target_compile_definitions(app PRIVATE FLPR_HANDSHAKE_NATIVE_TEST)
```

## prj.conf
```kconfig
CONFIG_ZTEST=y
CONFIG_IPC_SERVICE=y
CONFIG_MBOX=y
CONFIG_HEAP_MEM_POOL_SIZE=4096
CONFIG_LOG=y
CONFIG_LOG_MODE_MINIMAL=y
```

## boards/native_sim.overlay
```dts
/*
 * Copyright (c) 2025
 * SPDX-License-Identifier: Apache-2.0
 *
 * Overlay defining the fake IPC backend instance (ipc0) for the FLPR
 * handshake suite on native_sim.  The production flpr_handshake.c uses
 * DEVICE_DT_GET(DT_NODELABEL(ipc0)).
 */

/ {
	ipc0: ipc0 {
		compatible = "fake-ipc-backend";
		status = "okay";
	};
};
```

## dts/bindings/ipc/fake-ipc-backend.yaml
```yaml
# Copyright (c) 2025
# SPDX-License-Identifier: Apache-2.0
#
# Test-local devicetree binding for the fake IPC backend used by the
# FLPR handshake suite (native_sim).  Mirrors the NCS v3.3.0 pattern
# from zephyr/tests/subsys/ipc/ipc_service/.
description: Fake IPC backend for the FLPR handshake test

compatible: "fake-ipc-backend"
```

## src/fake_ipc_backend.c
```c
/*
 * Copyright (c) 2025
 * SPDX-License-Identifier: Apache-2.0
 *
 * Fake IPC service backend implementation.  See fake_ipc_backend.h.
 */
#include "fake_ipc_backend.h"

#include <errno.h>
#include <string.h>

#include <zephyr/ipc/ipc_service_backend.h>
#include <zephyr/device.h>
#include <zephyr/kernel.h>

#define DT_DRV_COMPAT fake_ipc_backend

/* ── Test controls ───────────────────────────────────────────── */

static int fake_open_ret;
static int fake_register_ret;
static int fake_deregister_ret;
static int fake_send_ret;
static bool fake_auto_bound = true;
static bool fake_send_block;
static struct k_sem fake_send_block_sem;
static bool fake_sem_initialized;

static uint32_t fake_send_calls;
static struct flpr_msg fake_sent[FAKE_IPC_MAX_SENT];
static uint32_t fake_sent_count;

/* ── Backend data ─────────────────────────────────────────────── */

struct fake_ipc_backend_data {
	const struct ipc_ept_cfg *cfg; /* captured endpoint config */
};

static struct fake_ipc_backend_data fake_data;

static void fake_ensure_sem(void)
{
	if (!fake_sem_initialized) {
		k_sem_init(&fake_send_block_sem, 0, 1);
		fake_sem_initialized = true;
	}
}

static uint32_t register_ready_epoch;
static int register_post_callback_error;
static bool heartbeat_block;
static K_SEM_DEFINE(heartbeat_entered, 0, 1);

static int fake_open_instance(const struct device *instance)
{
	(void)instance;
	return fake_open_ret;
}

static int fake_register_ept(const struct device *instance, void **token,
			     const struct ipc_ept_cfg *cfg)
{
	(void)instance;
	(void)token;
	if (fake_register_ret < 0) {
		return fake_register_ret;
	}
	fake_data.cfg = cfg;
	if (fake_auto_bound && cfg && cfg->cb.bound) {
		cfg->cb.bound(cfg->priv);
	}
	if (register_ready_epoch && cfg && cfg->cb.received) {
		struct flpr_msg ready = {.type = FLPR_MSG_READY,
					 .version = FLPR_PROTOCOL_VERSION,
					 .seq = 0,
					 .data = register_ready_epoch};
		cfg->cb.received(&ready, sizeof(ready), cfg->priv);
	}
	if (register_post_callback_error != 0) {
		fake_data.cfg = NULL;
		return register_post_callback_error;
	}
	return 0;
}

static int fake_deregister_ept(const struct device *instance, void *token)
{
	(void)instance;
	(void)token;
	if (fake_deregister_ret < 0) {
		return fake_deregister_ret;
	}
	fake_data.cfg = NULL;
	return 0;
}

static int fake_send(const struct device *instance, void *token, const void *data, size_t len)
{
	(void)instance;
	(void)token;
	(void)len;

	fake_send_calls++;
	if (heartbeat_block && len >= sizeof(struct flpr_msg) &&
	    ((const struct flpr_msg *)data)->type == FLPR_MSG_HEARTBEAT) {
		k_sem_give(&heartbeat_entered);
		k_sem_take(&fake_send_block_sem, K_FOREVER);
	}

	if (fake_send_block) {
		/* Park the caller until the test releases the worker. */
		k_sem_take(&fake_send_block_sem, K_FOREVER);
	}

	if (fake_send_ret < 0) {
		fake_sent_count++;
		return fake_send_ret;
	}

	if (fake_sent_count < FAKE_IPC_MAX_SENT && len >= sizeof(struct flpr_msg)) {
		memcpy(&fake_sent[fake_sent_count], data, sizeof(struct flpr_msg));
	}
	fake_sent_count++;
	return 0;
}

static const struct ipc_service_backend fake_backend_ops = {
	.open_instance = fake_open_instance,
	.register_endpoint = fake_register_ept,
	.deregister_endpoint = fake_deregister_ept,
	.send = fake_send,
};

#define DEFINE_FAKE_BACKEND(i)                                                                     \
	DEVICE_DT_INST_DEFINE(i, NULL, NULL, &fake_data, NULL, POST_KERNEL,                        \
			      CONFIG_IPC_SERVICE_REG_BACKEND_PRIORITY, &fake_backend_ops);

DT_INST_FOREACH_STATUS_OKAY(DEFINE_FAKE_BACKEND)

/* ── Test controls ───────────────────────────────────────────── */

void fake_ipc_reset(void)
{
	register_ready_epoch = 0U;
	register_post_callback_error = 0;
	heartbeat_block = false;
	k_sem_reset(&heartbeat_entered);
	fake_ensure_sem();
	fake_open_ret = 0;
	fake_register_ret = 0;
	fake_deregister_ret = 0;
	fake_send_ret = 0;
	fake_auto_bound = true;
	fake_send_block = false;
	fake_send_calls = 0;
	fake_sent_count = 0;
	memset(fake_sent, 0, sizeof(fake_sent));
	fake_data.cfg = NULL;
}

void fake_ipc_ready_during_register(uint32_t epoch)
{
	register_ready_epoch = epoch;
}

void fake_ipc_register_error_after_callbacks(int error)
{
	register_post_callback_error = error;
}

void fake_ipc_block_heartbeat(bool enable)
{
	fake_ensure_sem();
	heartbeat_block = enable;
	if (enable) {
		k_sem_reset(&fake_send_block_sem);
		k_sem_reset(&heartbeat_entered);
	}
}

int fake_ipc_wait_heartbeat_entered(k_timeout_t timeout)
{
	return k_sem_take(&heartbeat_entered, timeout);
}

void fake_ipc_release_heartbeat(void)
{
	heartbeat_block = false;
	k_sem_give(&fake_send_block_sem);
}

void fake_ipc_set_open_result(int ret)
{
	fake_open_ret = ret;
}

void fake_ipc_set_register_result(int ret)
{
	fake_register_ret = ret;
}

void fake_ipc_set_deregister_result(int ret)
{
	fake_deregister_ret = ret;
}

void fake_ipc_set_send_result(int ret)
{
	fake_send_ret = ret;
}

void fake_ipc_set_auto_bound(bool enable)
{
	fake_auto_bound = enable;
}

void fake_ipc_set_send_block(bool enable)
{
	fake_ensure_sem();
	fake_send_block = enable;
}

void fake_ipc_receive(const void *data, size_t len)
{
	if (fake_data.cfg && fake_data.cfg->cb.received) {
		fake_data.cfg->cb.received(data, len, fake_data.cfg->priv);
	}
}

void fake_ipc_unbind(void)
{
	if (fake_data.cfg && fake_data.cfg->cb.unbound) {
		fake_data.cfg->cb.unbound(fake_data.cfg->priv);
	}
}

void fake_ipc_error(const char *message)
{
	if (fake_data.cfg && fake_data.cfg->cb.error) {
		fake_data.cfg->cb.error(message, fake_data.cfg->priv);
	}
}

uint32_t fake_ipc_sent_count(void)
{
	return fake_sent_count;
}

const struct flpr_msg *fake_ipc_sent_at(uint32_t i)
{
	return (i < fake_sent_count) ? &fake_sent[i] : NULL;
}

uint32_t fake_ipc_sent_type_count(uint8_t type)
{
	uint32_t n = 0;

	for (uint32_t i = 0; i < fake_sent_count; i++) {
		if (fake_sent[i].type == type) {
			n++;
		}
	}
	return n;
}

uint32_t fake_ipc_send_calls(void)
{
	return fake_send_calls;
}

bool fake_ipc_endpoint_registered(void)
{
	return fake_data.cfg != NULL;
}
```

## src/fake_ipc_backend.h
```c
/*
 * Copyright (c) 2025
 * SPDX-License-Identifier: Apache-2.0
 *
 * Fake IPC service backend for the FLPR handshake suite (native_sim).
 *
 * Follows the NCS v3.3.0 pattern from
 * zephyr/tests/subsys/ipc/ipc_service/: a test-local devicetree binding
 * (fake-ipc-backend), a struct ipc_service_backend registered via
 * DEVICE_DT_INST_DEFINE, and the real Zephyr ipc_service_* APIs used by
 * production src/flpr_handshake.c.
 *
 * The backend captures the registered endpoint config and invokes its
 * real callbacks (bound/unbound/received/error).  Test controls expose
 * open/register/deregister/send return values, optional automatic bound
 * callback at register, sent-message history, arbitrary incoming
 * messages, and an optional send-block mode (for stress clamp tests).
 */
#ifndef FAKE_IPC_BACKEND_H_
#define FAKE_IPC_BACKEND_H_

#include <stdint.h>
#include <stdbool.h>
#include <stddef.h>
#include <zephyr/kernel.h>

#include "flpr_protocol.h" /* struct flpr_msg */

#ifdef __cplusplus
extern "C" {
#endif

#define FAKE_IPC_MAX_SENT 256U

/* Reset all backend controls (results ok, auto-bound on, block off). */
void fake_ipc_reset(void);

/* Return-value controls. */
void fake_ipc_set_open_result(int ret);
void fake_ipc_set_register_result(int ret);
void fake_ipc_set_deregister_result(int ret);
void fake_ipc_set_send_result(int ret);

/* When true (default), register_endpoint invokes cfg->cb.bound. */
void fake_ipc_set_auto_bound(bool enable);

/* When true, sends block forever on an internal semaphore (used to park
 * a stress worker mid-send while observing clamped state). */
void fake_ipc_set_send_block(bool enable);
void fake_ipc_ready_during_register(uint32_t epoch);
void fake_ipc_register_error_after_callbacks(int error);
void fake_ipc_block_heartbeat(bool enable);
int fake_ipc_wait_heartbeat_entered(k_timeout_t timeout);
void fake_ipc_release_heartbeat(void);

/* Incoming-message injection: invokes the captured received callback. */
void fake_ipc_receive(const void *data, size_t len);

/* Unbind / error injection: invoke the captured callbacks. */
void fake_ipc_unbind(void);
void fake_ipc_error(const char *message);

/* Observation. */
uint32_t fake_ipc_sent_count(void);
const struct flpr_msg *fake_ipc_sent_at(uint32_t i);
uint32_t fake_ipc_sent_type_count(uint8_t type);
uint32_t fake_ipc_send_calls(void);
bool fake_ipc_endpoint_registered(void);

#ifdef __cplusplus
}
#endif

#endif /* FAKE_IPC_BACKEND_H_ */
```

## src/flpr_handshake_hooks.h
```c
/*
 * Copyright (c) 2025
 * SPDX-License-Identifier: Apache-2.0
 *
 * Test-owned hook interface for the FLPR handshake suite.
 *
 * Compiled into src/flpr_handshake.c ONLY under FLPR_HANDSHAKE_NATIVE_TEST
 * (native_sim).  Production builds never include this header and contain
 * no test symbols.
 *
 * Hooks cover: heartbeat work lifecycle (cancel/reset, one synchronous
 * iteration, record-only async start), peer health/timestamp arrangement
 * (so the healthy→unhealthy transition is testable without a five-second
 * wall-clock wait), and semaphore observability.
 */
#ifndef FLPR_HANDSHAKE_HOOKS_H_
#define FLPR_HANDSHAKE_HOOKS_H_

#include <stdint.h>
#include <stdbool.h>

#ifdef __cplusplus
extern "C" {
#endif

/* Cancel heartbeat work and reset ALL module-static state, semaphores,
 * and registered callbacks for a clean test. */
void flpr_handshake_test_reset(void);

/* Invoke one heartbeat work iteration synchronously in the calling
 * thread.  The handler reschedules; teardown cancels the pending work. */
void flpr_handshake_test_heartbeat_once(void);

/* Arrange peer health/timestamp state (bound/ready/acked/healthy and the
 * last remote heartbeat time) so transition tests need no wall-clock
 * wait.  State transitions still run through production helpers. */
void flpr_handshake_test_set_peer_state(bool bound, bool ready, bool acked, bool healthy,
					uint32_t rx_last_ms);

/* Heartbeat scheduling hooks (invoked by production code in test mode):
 * the READY-triggered async start is record-only unless explicitly enabled; the
 * per-iteration reschedule is submitted for real and canceled at
 * teardown. */
void flpr_handshake_test_work_start(void);
void flpr_handshake_test_work_reschedule(void);
/* Real kernel work for encoded local-close/reopen lifecycle verification. */
void flpr_handshake_test_enable_automatic_hb(void);
void flpr_handshake_test_finish_hb_iteration(void);

uint32_t flpr_handshake_test_hb_start_requests(void);
uint32_t flpr_handshake_test_hb_reschedules(void);
bool flpr_handshake_test_work_pending(void);

/* Semaphore observability. */
uint32_t flpr_handshake_test_bound_sem_count(void);
uint32_t flpr_handshake_test_new_ready_sem_count(void);
uint32_t flpr_handshake_test_stress_sem_count(void);
uint32_t flpr_handshake_test_hang_ack_sem_count(void);

#ifdef __cplusplus
}
#endif

#endif /* FLPR_HANDSHAKE_HOOKS_H_ */
```
