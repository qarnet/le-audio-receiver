## CMakeLists.txt
```
cmake_minimum_required(VERSION 3.20.0)
find_package(Zephyr REQUIRED HINTS $ENV{ZEPHYR_BASE})
project(test_flpr_runtime)

# T1A: execute the REAL nRF54 restart body on native_sim.
#
# FLPR_RUNTIME_NATIVE_TEST switches src/flpr_runtime.c from the DT-derived
# production constants to test-provided VPR register storage, source and
# execution arrays, and time/cache/barrier hooks.  The real production
# restart function runs; the mock handshake + shadow VPR HAL only inject
# transport and register-file behavior.
target_sources(app PRIVATE
  src/test_flpr_runtime.c
  src/flpr_runtime_hooks.c
  src/mock_flpr_handshake.c
  src/mock_nrf_vpr.c
  ${CMAKE_CURRENT_SOURCE_DIR}/../../../src/flpr_runtime.c
  ${CMAKE_CURRENT_SOURCE_DIR}/../../../src/flpr_ring.c   # real flpr_ring_crc32
  ${CMAKE_CURRENT_SOURCE_DIR}/../../../src/flpr_cache.c  # native barrier hooks
)

target_include_directories(app PRIVATE
  src
  ${CMAKE_CURRENT_SOURCE_DIR}/../../../src
)

target_compile_definitions(app PRIVATE FLPR_RUNTIME_NATIVE_TEST)
```

## prj.conf
```kconfig
CONFIG_ZTEST=y
CONFIG_IPC_SERVICE=y
CONFIG_HEAP_MEM_POOL_SIZE=4096
CONFIG_LOG=y
CONFIG_LOG_MODE_MINIMAL=y
```

## src/flpr_runtime_hooks.c
```c
/*
 * Copyright (c) 2025
 * SPDX-License-Identifier: Apache-2.0
 *
 * Test-owned hook implementation for the FLPR runtime restart suite.
 * Provides host arrays, the event log, and time/cache/barrier hooks used
 * by the production restart body under FLPR_RUNTIME_NATIVE_TEST.
 */
#include "flpr_runtime_hooks.h"

#include <string.h>

/* ── Test storage ─────────────────────────────────────────────── */

NRF_VPR_Type flpr_rt_test_vpr;
uint8_t flpr_rt_test_source[FLPR_RT_TEST_IMAGE_SIZE];
uint8_t flpr_rt_test_exec[FLPR_RT_TEST_IMAGE_SIZE];

/* ── Event log ────────────────────────────────────────────────── */

#define FLPR_RT_TEST_MAX_EVENTS 64U

static uint32_t ev_count;
static enum flpr_rt_test_event ev_log[FLPR_RT_TEST_MAX_EVENTS];

void flpr_rt_emit_event(enum flpr_rt_test_event ev)
{
	if (ev_count < FLPR_RT_TEST_MAX_EVENTS) {
		ev_log[ev_count] = ev;
	}
	ev_count++;
}

/* ── Hook counters and time state ─────────────────────────────── */

static uint32_t cache_flush_count;
static uint32_t barrier_counts[2];
static uint32_t busy_wait_count;
static uint32_t sleep_count;
static uint32_t test_uptime_ms;
static uint32_t sleep_advance_override;
static bool corrupt_after_copy;

void flpr_rt_hook_busy_wait(uint32_t usec)
{
	(void)usec;
	busy_wait_count++;
}

void flpr_rt_hook_sleep(uint32_t ms)
{
	sleep_count++;
	test_uptime_ms += (sleep_advance_override != 0U) ? sleep_advance_override : ms;
}

uint32_t flpr_rt_hook_uptime_ms(void)
{
	return test_uptime_ms;
}

void flpr_rt_hook_cache_flush(const void *addr, size_t size)
{
	(void)addr;
	(void)size;
	cache_flush_count++;
}

void flpr_rt_hook_barrier(enum flpr_rt_test_barrier kind)
{
	if (kind == FLPR_RT_BARRIER_DSB || kind == FLPR_RT_BARRIER_ISB) {
		barrier_counts[kind]++;
	}
}

void flpr_rt_hook_after_copy(void)
{
	if (corrupt_after_copy) {
		flpr_rt_test_exec[0] ^= 0xFFU;
	}
}

/* ── Test controls ────────────────────────────────────────────── */

void flpr_rt_test_reset_all(void)
{
	ev_count = 0;
	cache_flush_count = 0;
	barrier_counts[0] = 0;
	barrier_counts[1] = 0;
	busy_wait_count = 0;
	sleep_count = 0;
	test_uptime_ms = 0;
	sleep_advance_override = 0;
	corrupt_after_copy = false;

	memset(&flpr_rt_test_vpr, 0, sizeof(flpr_rt_test_vpr));
	memset(flpr_rt_test_source, 0, sizeof(flpr_rt_test_source));
	memset(flpr_rt_test_exec, 0, sizeof(flpr_rt_test_exec));

	flpr_runtime_test_reset();
}

/* ── Observation accessors ────────────────────────────────────── */

uint32_t flpr_rt_test_event_count(void)
{
	return ev_count;
}

enum flpr_rt_test_event flpr_rt_test_event_at(uint32_t i)
{
	return (i < ev_count) ? ev_log[i] : (enum flpr_rt_test_event) - 1;
}

uint32_t flpr_rt_test_cache_flush_count(void)
{
	return cache_flush_count;
}

uint32_t flpr_rt_test_barrier_count(enum flpr_rt_test_barrier kind)
{
	return (kind == FLPR_RT_BARRIER_DSB || kind == FLPR_RT_BARRIER_ISB) ? barrier_counts[kind]
									    : 0U;
}

uint32_t flpr_rt_test_busy_wait_count(void)
{
	return busy_wait_count;
}

uint32_t flpr_rt_test_sleep_count(void)
{
	return sleep_count;
}

void flpr_rt_test_set_uptime(uint32_t ms)
{
	test_uptime_ms = ms;
}

void flpr_rt_test_set_sleep_advance(uint32_t ms)
{
	sleep_advance_override = ms;
}

void flpr_rt_test_set_corrupt_after_copy(bool corrupt)
{
	corrupt_after_copy = corrupt;
}
```

## src/flpr_runtime_hooks.h
```c
/*
 * Copyright (c) 2025
 * SPDX-License-Identifier: Apache-2.0
 *
 * Test-owned hook interface for the FLPR runtime restart suite.
 *
 * Compiled into src/flpr_runtime.c ONLY under FLPR_RUNTIME_NATIVE_TEST
 * (native_sim).  Production builds never include this header and contain
 * no test symbols.
 *
 * native_sim has no MMU/address translation, so the fixed devicetree reg
 * addresses (VPR 0x21000000-ish, execution SRAM 0x20030000) cannot be
 * dereferenced.  This hook header replaces them with host storage:
 *   - an NRF_VPR_Type register file (shadow-HAL pattern),
 *   - source and execution byte arrays of equal fixed size,
 *   - hooks for busy wait, sleep, uptime, cache flush, barriers, and
 *     after-copy fault injection,
 *   - an ordered event log emitted by the production restart body.
 */
#ifndef FLPR_RUNTIME_HOOKS_H_
#define FLPR_RUNTIME_HOOKS_H_

#include <stdint.h>
#include <stdbool.h>
#include <stddef.h>

#include <hal/nrf_vpr.h> /* shadow mock HAL type */

#ifdef __cplusplus
extern "C" {
#endif

/* Fixed image size shared by the source and execution arrays. */
#define FLPR_RT_TEST_IMAGE_SIZE 4096U

/* Test-provided VPR register storage. */
extern NRF_VPR_Type flpr_rt_test_vpr;

/* Test-provided source and execution byte arrays (equal fixed size). */
extern uint8_t flpr_rt_test_source[FLPR_RT_TEST_IMAGE_SIZE];
extern uint8_t flpr_rt_test_exec[FLPR_RT_TEST_IMAGE_SIZE];

/* ── Ordered restart events ─────────────────────────────────────────
 * Emitted by the actual production restart function (test mode only).
 * Events observe real control flow; they never drive it. */

enum flpr_rt_test_event {
	FLPR_RT_EV_SNAPSHOT = 0,         /* 1: snapshot status/epoch */
	FLPR_RT_EV_SRC_CRC,              /* 2: source CRC */
	FLPR_RT_EV_DISCONNECT,           /* 3: disconnect (stage reached) */
	FLPR_RT_EV_STOP_CPURUN,          /* 4: stop CPURUN */
	FLPR_RT_EV_ASSERT_RESET,         /* 5: assert reset */
	FLPR_RT_EV_COPY,                 /* 6: copy */
	FLPR_RT_EV_CACHE_FLUSH_BARRIERS, /* 7: cache flush + barriers */
	FLPR_RT_EV_EXEC_CRC,             /* 8: execution CRC */
	FLPR_RT_EV_INITPC,               /* 9: INITPC */
	FLPR_RT_EV_RECONNECT,            /* 10: reconnect (stage reached) */
	FLPR_RT_EV_SET_CPURUN,           /* 11: set CPURUN */
	FLPR_RT_EV_RELEASE_RESET,        /* 12: release reset */
	FLPR_RT_EV_WAIT_BOUND,           /* 13: wait bound (stage reached) */
	FLPR_RT_EV_WAIT_READY,           /* 14: wait new READY (stage reached) */
	FLPR_RT_EV_SUCCESS,              /* 15: success */
	FLPR_RT_EV_FAILURE_STOP,         /* 16: failure stop */
};

/* Barrier kinds routed through the hook. */
enum flpr_rt_test_barrier {
	FLPR_RT_BARRIER_DSB = 0,
	FLPR_RT_BARRIER_ISB,
};

/* ── Hooks invoked by the production restart body (test mode) ────── */

void flpr_rt_emit_event(enum flpr_rt_test_event ev);
void flpr_rt_hook_busy_wait(uint32_t usec);
void flpr_rt_hook_sleep(uint32_t ms);
uint32_t flpr_rt_hook_uptime_ms(void);
void flpr_rt_hook_cache_flush(const void *addr, size_t size);
void flpr_rt_hook_barrier(enum flpr_rt_test_barrier kind);
void flpr_rt_hook_after_copy(void);

/* ── Test controls ───────────────────────────────────────────────── */

/* Full cleanup: event log, hook counters, VPR storage, arrays, and
 * production-side state (via flpr_runtime_test_reset()). */
void flpr_rt_test_reset_all(void);

/* Production-side reset + mutex-busy simulation.  Implemented inside
 * src/flpr_runtime.c under FLPR_RUNTIME_NATIVE_TEST (module statics). */
void flpr_runtime_test_reset(void);
void flpr_runtime_test_hold_mutex(void);
void flpr_runtime_test_release_mutex(void);

/* ── Observation accessors ───────────────────────────────────────── */

uint32_t flpr_rt_test_event_count(void);
enum flpr_rt_test_event flpr_rt_test_event_at(uint32_t i);
uint32_t flpr_rt_test_cache_flush_count(void);
uint32_t flpr_rt_test_barrier_count(enum flpr_rt_test_barrier kind);
uint32_t flpr_rt_test_busy_wait_count(void);
uint32_t flpr_rt_test_sleep_count(void);

/* Uptime control: sets the current test uptime.  The sleep hook advances
 * it by its (possibly overridden) amount. */
void flpr_rt_test_set_uptime(uint32_t ms);
void flpr_rt_test_set_sleep_advance(uint32_t ms); /* 0 = advance by requested amount */

/* After-copy fault injection: when enabled the after-copy hook corrupts
 * the execution image so the execution CRC mismatches. */
void flpr_rt_test_set_corrupt_after_copy(bool corrupt);

#ifdef __cplusplus
}
#endif

#endif /* FLPR_RUNTIME_HOOKS_H_ */
```

## src/mock_flpr_deps.c
```c
/*
 * Copyright (c) 2025
 * SPDX-License-Identifier: Apache-2.0
 *
 * Mock implementations for flpr_handshake, flpr_ring, audio_offload.
 * Controllable via mock_set_* functions.
 */
#include "mock_flpr_deps.h"

/* ── Internal mock state ─────────────────────────────────── */

static uint32_t mock_epoch;
static int mock_disconnect_ret;
static int mock_reconnect_ret;
static int mock_bound_ret;
static int mock_ready_ret;
static bool mock_crc_match;
static bool mock_healthy;

/* ── flpr_handshake ──────────────────────────────────────── */

void flpr_handshake_get_status(struct flpr_status *out)
{
	if (out) {
		out->epoch = mock_epoch;
	}
}

int flpr_handshake_disconnect(void)
{
	return mock_disconnect_ret;
}

int flpr_handshake_reconnect(void)
{
	return mock_reconnect_ret;
}

int flpr_handshake_wait_bound(int timeout)
{
	(void)timeout;
	return mock_bound_ret;
}

int flpr_handshake_wait_new_ready(uint32_t old_epoch, int timeout)
{
	(void)old_epoch;
	(void)timeout;
	return mock_ready_ret;
}

/* ── flpr_ring.crc32 ─────────────────────────────────────── */

uint32_t flpr_ring_crc32(const uint8_t *data, size_t len)
{
	(void)data;
	(void)len;
	return mock_crc_match ? 0xDEADBEEF : 0xCAFEBABE;
}

/* ── audio_offload ───────────────────────────────────────── */

bool audio_offload_is_healthy(void)
{
	return mock_healthy;
}

/* ── Mock control API ────────────────────────────────────── */

void mock_set_handshake_epoch(uint32_t epoch)
{
	mock_epoch = epoch;
}

void mock_set_disconnect_result(int ret)
{
	mock_disconnect_ret = ret;
}

void mock_set_reconnect_result(int ret)
{
	mock_reconnect_ret = ret;
}

void mock_set_wait_bound_result(int ret)
{
	mock_bound_ret = ret;
}

void mock_set_wait_ready_result(int ret)
{
	mock_ready_ret = ret;
}

void mock_set_crc_match(bool match)
{
	mock_crc_match = match;
}

void mock_set_offload_healthy(bool healthy)
{
	mock_healthy = healthy;
}
```

## src/mock_flpr_deps.h
```c
/*
 * Copyright (c) 2025
 * SPDX-License-Identifier: Apache-2.0
 *
 * Mock for flpr_handshake.h, flpr_ring.h, audio_offload.h.
 * All in one file to keep test module simple.
 */
#ifndef MOCK_FLPR_DEPS_H_
#define MOCK_FLPR_DEPS_H_

#include <stdint.h>
#include <stdbool.h>
#include <stddef.h>

#ifdef __cplusplus
extern "C" {
#endif

/* ── flpr_handshake.h mock ──────────────────────────────── */

struct flpr_status {
	uint32_t epoch;
};

void flpr_handshake_get_status(struct flpr_status *out);
int flpr_handshake_disconnect(void);
int flpr_handshake_reconnect(void);
int flpr_handshake_wait_bound(int timeout);
int flpr_handshake_wait_new_ready(uint32_t old_epoch, int timeout);

/* ── flpr_ring.h mock ───────────────────────────────────── */

uint32_t flpr_ring_crc32(const uint8_t *data, size_t len);

/* ── audio_offload.h mock ───────────────────────────────── */

bool audio_offload_is_healthy(void);

/* ── Mock control interface (called from tests) ─────────── */

/* Set the return values for next restart call. */
void mock_set_handshake_epoch(uint32_t epoch);
void mock_set_disconnect_result(int ret);
void mock_set_reconnect_result(int ret);
void mock_set_wait_bound_result(int ret);
void mock_set_wait_ready_result(int ret);
void mock_set_crc_match(bool match);
void mock_set_offload_healthy(bool healthy);

#ifdef __cplusplus
}
#endif

#endif /* MOCK_FLPR_DEPS_H_ */
```

## src/mock_flpr_handshake.c
```c
/*
 * Copyright (c) 2025
 * SPDX-License-Identifier: Apache-2.0
 *
 * Mock implementation of the flpr_handshake API surface consumed by
 * flpr_runtime_restart().  See mock_flpr_handshake.h for controls.
 */
#include "mock_flpr_handshake.h"

#include <string.h>
#include <errno.h>

#include "flpr_handshake.h" /* real production header */
#include "mock_nrf_vpr.h"
#include "flpr_runtime_hooks.h"

/* ── Mock state ─────────────────────────────────────────────── */

static uint32_t mock_epoch;
static int mock_disconnect_ret;
static int mock_reconnect_ret;
static bool mock_wait_bound_override;
static int mock_wait_bound_ret;
static bool mock_wait_ready_override;
static int mock_wait_ready_ret;
static bool mock_reboot_on_disconnect = true;
static bool mock_reboot_pending;

static uint32_t mock_wait_ready_calls;
static uint32_t mock_last_prev_epoch;
static uint32_t mock_disconnect_calls;
static uint32_t mock_reconnect_calls;
static uint32_t mock_get_status_calls;

/* ── flpr_handshake API ─────────────────────────────────────── */

void flpr_handshake_get_status(struct flpr_status *out)
{
	mock_get_status_calls++;
	if (out) {
		memset(out, 0, sizeof(*out));
		out->epoch = mock_epoch;
	}
}

int flpr_handshake_disconnect(void)
{
	mock_disconnect_calls++;
	if (mock_disconnect_ret < 0) {
		return mock_disconnect_ret;
	}
	if (mock_reboot_on_disconnect) {
		/* FLPR is being stopped; its next boot uses a fresh nonce. */
		mock_reboot_pending = true;
	}
	return 0;
}

int flpr_handshake_reconnect(void)
{
	mock_reconnect_calls++;
	return mock_reconnect_ret;
}

int flpr_handshake_wait_bound(k_timeout_t timeout)
{
	(void)timeout;
	if (mock_wait_bound_override) {
		return mock_wait_bound_ret;
	}
	if (!mock_vpr_fresh_boot_running() ||
	    nrf_vpr_int_enable_check(&flpr_rt_test_vpr, 1U << 20) == 0U) {
		return -EAGAIN;
	}
	return 0;
}

int flpr_handshake_wait_new_ready(uint32_t previous_epoch, k_timeout_t timeout)
{
	(void)timeout;
	mock_wait_ready_calls++;
	mock_last_prev_epoch = previous_epoch;

	if (mock_wait_ready_override) {
		return mock_wait_ready_ret;
	}

	if (mock_reboot_pending) {
		/* FLPR rebooted: new epoch differs from the snapshot. */
		mock_reboot_pending = false;
		mock_epoch = previous_epoch + 1;
		return 0;
	}

	/* No reboot: success requires a changed epoch. */
	return (mock_epoch != previous_epoch) ? 0 : -EAGAIN;
}

/* ── Test controls ──────────────────────────────────────────── */

void mock_hs_reset(void)
{
	mock_epoch = 0;
	mock_disconnect_ret = 0;
	mock_reconnect_ret = 0;
	mock_wait_bound_override = false;
	mock_wait_bound_ret = 0;
	mock_wait_ready_override = false;
	mock_wait_ready_ret = 0;
	mock_reboot_on_disconnect = true;
	mock_reboot_pending = false;
	mock_wait_ready_calls = 0;
	mock_last_prev_epoch = 0;
	mock_disconnect_calls = 0;
	mock_reconnect_calls = 0;
	mock_get_status_calls = 0;
}

void mock_hs_set_epoch(uint32_t epoch)
{
	mock_epoch = epoch;
}

void mock_hs_set_disconnect_result(int ret)
{
	mock_disconnect_ret = ret;
}

void mock_hs_set_reconnect_result(int ret)
{
	mock_reconnect_ret = ret;
}

void mock_hs_set_wait_bound_result(int ret)
{
	mock_wait_bound_override = true;
	mock_wait_bound_ret = ret;
}

void mock_hs_clear_wait_bound_result(void)
{
	mock_wait_bound_override = false;
}

void mock_hs_set_wait_ready_result(int ret)
{
	mock_wait_ready_override = true;
	mock_wait_ready_ret = ret;
}

void mock_hs_clear_wait_ready_result(void)
{
	mock_wait_ready_override = false;
}

void mock_hs_set_reboot_on_disconnect(bool enable)
{
	mock_reboot_on_disconnect = enable;
	mock_reboot_pending = false;
}

uint32_t mock_hs_last_prev_epoch(void)
{
	return mock_last_prev_epoch;
}

uint32_t mock_hs_wait_ready_calls(void)
{
	return mock_wait_ready_calls;
}

uint32_t mock_hs_disconnect_calls(void)
{
	return mock_disconnect_calls;
}

uint32_t mock_hs_reconnect_calls(void)
{
	return mock_reconnect_calls;
}

uint32_t mock_hs_get_status_calls(void)
{
	return mock_get_status_calls;
}
```

## src/mock_flpr_handshake.h
```c
/*
 * Copyright (c) 2025
 * SPDX-License-Identifier: Apache-2.0
 *
 * Test-owned mock of the flpr_handshake API surface used by
 * flpr_runtime_restart(): get_status / disconnect / reconnect /
 * wait_bound / wait_new_ready.
 *
 * The mock models FLPR reboot semantics: a successful disconnect arms a
 * reboot, and wait_new_ready() only succeeds once the mock FLPR epoch
 * differs from the snapshot epoch (the real FLPR boots with a fresh
 * nonce).  Return values for every call are individually controllable.
 */
#ifndef MOCK_FLPR_HANDSHAKE_H_
#define MOCK_FLPR_HANDSHAKE_H_

#include <stdint.h>
#include <stdbool.h>

#ifdef __cplusplus
extern "C" {
#endif

/* Reset all mock state to defaults:
 *   epoch 0, all results success, reboot-on-disconnect enabled. */
void mock_hs_reset(void);

void mock_hs_set_epoch(uint32_t epoch);
void mock_hs_set_disconnect_result(int ret); /* <0 fails */
void mock_hs_set_reconnect_result(int ret);  /* <0 fails */

/* Wait-result overrides.  When set, wait_bound/wait_new_ready return the
 * given value unconditionally.  Clear to restore default behaviour. */
void mock_hs_set_wait_bound_result(int ret);
void mock_hs_clear_wait_bound_result(void);
void mock_hs_set_wait_ready_result(int ret);
void mock_hs_clear_wait_ready_result(void);

/* When enabled (default), a successful disconnect arms a mock FLPR reboot
 * so wait_new_ready sees a changed epoch.  Disable to force the
 * same-epoch failure path. */
void mock_hs_set_reboot_on_disconnect(bool enable);

/* Observation. */
uint32_t mock_hs_last_prev_epoch(void); /* epoch passed to wait_new_ready */
uint32_t mock_hs_wait_ready_calls(void);
uint32_t mock_hs_disconnect_calls(void);
uint32_t mock_hs_reconnect_calls(void);
uint32_t mock_hs_get_status_calls(void);

#ifdef __cplusplus
}
#endif

#endif /* MOCK_FLPR_HANDSHAKE_H_ */
```

## src/mock_nrf_vpr.c
```c
/*
 * Copyright (c) 2025
 * SPDX-License-Identifier: Apache-2.0
 *
 * Shadow nRF VPR HAL for the FLPR runtime restart suite (native_sim).
 *
 * Mirrors the register-file layout and field constants of the real
 * nrfx hal/nrf_vpr.h + mdk nrf_vpr.h so the production restart body
 * compiles unchanged.  HAL calls write THROUGH to the passed register
 * struct (the test-owned NRF_VPR_Type storage) so production readbacks
 * (DMCONTROL, CPURUN, INITPC) observe consistent state, and record
 * call counts/write history for verification.
 */
#include "mock_nrf_vpr.h"

#include <string.h>
#include "mock_state.h"
#include "flpr_runtime_hooks.h"
#include <hal/nrf_memconf.h>

/* ── Public mock state ──────────────────────────────────────── */

mock_vpr_state_t mock_vpr;
NRF_MEMCONF_Type flpr_rt_test_memconf;
static bool restoring_context;
static bool rtperiph_up;
static bool fail_interrupt_rearm;
static bool fail_context_selection;

void mock_reset(void)
{
	memset(&mock_vpr, 0, sizeof(mock_vpr));
	memset(&flpr_rt_test_memconf, 0xff, sizeof(flpr_rt_test_memconf));
	flpr_rt_test_vpr.INTENSET = 1U << 20;
	restoring_context = false;
	rtperiph_up = true;
	fail_interrupt_rearm = false;
	fail_context_selection = false;
}

void nrf_vpr_cpurun_set(NRF_VPR_Type *p_reg, bool enable)
{
	if (enable) {
		p_reg->CPURUN |= VPR_CPURUN_EN_Msk;
	} else {
		p_reg->CPURUN &= ~VPR_CPURUN_EN_Msk;
	}
	mock_vpr.cpurun = enable;
	mock_vpr.cpurun_set_count++;
}

bool nrf_vpr_cpurun_get(NRF_VPR_Type const *p_reg)
{
	mock_vpr.cpurun_get_count++;
	return (p_reg->CPURUN & VPR_CPURUN_EN_Msk) != 0;
}

void nrf_vpr_initpc_set(NRF_VPR_Type *p_reg, uint32_t pc)
{
	p_reg->INITPC = pc;
	mock_vpr.initpc = pc;
	mock_vpr.initpc_set_count++;
}

uint32_t nrf_vpr_initpc_get(NRF_VPR_Type const *p_reg)
{
	mock_vpr.initpc_get_count++;
	return p_reg->INITPC;
}

void nrf_vpr_debugif_dmcontrol_set(NRF_VPR_Type *p_reg, int signal, bool enable)
{
	(void)p_reg;
	(void)signal;
	(void)enable;
	mock_vpr.dmcontrol_set_count++;
}

void nrf_vpr_debugif_dmcontrol_mask_set(NRF_VPR_Type *p_reg, uint32_t mask)
{
	/* Write through to the register file: readbacks in the production
	 * restart body observe exactly the mask written. */
	p_reg->DEBUGIF.DMCONTROL = mask;
	if (mask & VPR_DEBUGIF_DMCONTROL_NDMRESET_Msk) {
		restoring_context = (flpr_rt_test_memconf.POWER[1].RET & 1U) != 0U;
		rtperiph_up = false;
		p_reg->INTENSET = 0U;
	} else if ((p_reg->CPURUN & VPR_CPURUN_EN_Msk) && !restoring_context) {
		rtperiph_up = true;
	}

	/* Record sequential DMCONTROL writes for order verification. */
	if (mock_vpr.dmcontrol_write_count < MOCK_MAX_DMCONTROL_WRITES) {
		mock_vpr.dmcontrol_writes[mock_vpr.dmcontrol_write_count] = mask;
		mock_vpr.dmcontrol_write_count++;
	}
}

void nrf_vpr_int_enable(NRF_VPR_Type *p_reg, uint32_t mask)
{
	if (!fail_interrupt_rearm) {
		p_reg->INTENSET |= mask;
	}
}

uint32_t nrf_vpr_int_enable_check(NRF_VPR_Type const *p_reg, uint32_t mask)
{
	return rtperiph_up ? p_reg->INTENSET & mask : 0U;
}

bool mock_vpr_fresh_boot_running(void)
{
	return rtperiph_up && (flpr_rt_test_vpr.CPURUN & VPR_CPURUN_EN_Msk) &&
	       !(flpr_rt_test_vpr.DEBUGIF.DMCONTROL & VPR_DEBUGIF_DMCONTROL_NDMRESET_Msk);
}

void mock_vpr_fail_interrupt_rearm(bool fail)
{
	fail_interrupt_rearm = fail;
}

void mock_vpr_fail_context_selection(bool fail)
{
	fail_context_selection = fail;
}

void nrf_memconf_ramblock_ret_enable_set(NRF_MEMCONF_Type *reg, uint8_t power, uint8_t block,
					 bool enable)
{
	if (!enable && fail_context_selection) {
		return;
	}
	if (enable) {
		reg->POWER[power].RET |= 1U << block;
	} else {
		reg->POWER[power].RET &= ~(1U << block);
	}
}

bool nrf_memconf_ramblock_ret_enable_check(NRF_MEMCONF_Type const *reg, uint8_t power,
					   uint8_t block)
{
	return (reg->POWER[power].RET & (1U << block)) != 0U;
}

bool nrf_vpr_debugif_dmcontrol_get(NRF_VPR_Type const *p_reg, int signal)
{
	(void)p_reg;
	(void)signal;
	mock_vpr.dmcontrol_get_count++;
	return false;
}
```

## src/mock_nrf_vpr.h
```c
/*
 * Copyright (c) 2025
 * SPDX-License-Identifier: Apache-2.0
 *
 * Mock nRF VPR HAL for unit testing flpr_runtime restart sequence.
 * Provides minimal types and inline functions matching nrfx hal/nrf_vpr.h.
 */
#ifndef MOCK_NRF_VPR_H_
#define MOCK_NRF_VPR_H_

#include <stdint.h>
#include <stdbool.h>

#ifdef __cplusplus
extern "C" {
#endif

/* ── Mock VPR register structure ──────────────────────────── */

typedef struct {
	volatile uint32_t DMCONTROL;
} VPR_DEBUGIF_Type;

typedef struct {
	volatile uint32_t CPURUN;
	volatile uint32_t INITPC;
	volatile uint32_t EVENTS_TRIGGERED[32];
	volatile uint32_t TASKS_TRIGGER[32];
	volatile uint32_t INTENSET;
	volatile uint32_t INTENCLR;
	VPR_DEBUGIF_Type DEBUGIF;
} NRF_VPR_Type;

/* ── CPURUN values ─────────────────────────────────────────── */

#define VPR_CPURUN_EN_Msk     (1UL)
#define VPR_CPURUN_EN_Pos     0
#define VPR_CPURUN_EN_Running (1UL)
#define VPR_CPURUN_EN_Stopped (0UL)

/* ── DMCONTROL field positions and values ──────────────────── */

#define VPR_DEBUGIF_DMCONTROL_DMACTIVE_Msk      (1UL << 0)
#define VPR_DEBUGIF_DMCONTROL_DMACTIVE_Pos      0
#define VPR_DEBUGIF_DMCONTROL_DMACTIVE_Enabled  (1UL)
#define VPR_DEBUGIF_DMCONTROL_DMACTIVE_Disabled (0UL)

#define VPR_DEBUGIF_DMCONTROL_NDMRESET_Msk      (1UL << 1)
#define VPR_DEBUGIF_DMCONTROL_NDMRESET_Pos      1
#define VPR_DEBUGIF_DMCONTROL_NDMRESET_Active   (1UL)
#define VPR_DEBUGIF_DMCONTROL_NDMRESET_Inactive (0UL)

/* ── VPR HAL prototypes ────────────────────────────────────── */

void nrf_vpr_cpurun_set(NRF_VPR_Type *p_reg, bool enable);
bool nrf_vpr_cpurun_get(NRF_VPR_Type const *p_reg);
void nrf_vpr_initpc_set(NRF_VPR_Type *p_reg, uint32_t pc);
uint32_t nrf_vpr_initpc_get(NRF_VPR_Type const *p_reg);
void nrf_vpr_int_enable(NRF_VPR_Type *p_reg, uint32_t mask);
uint32_t nrf_vpr_int_enable_check(NRF_VPR_Type const *p_reg, uint32_t mask);
bool mock_vpr_fresh_boot_running(void);
void mock_vpr_fail_interrupt_rearm(bool fail);
void mock_vpr_fail_context_selection(bool fail);
void nrf_vpr_debugif_dmcontrol_set(NRF_VPR_Type *p_reg, int signal, bool enable);
void nrf_vpr_debugif_dmcontrol_mask_set(NRF_VPR_Type *p_reg, uint32_t mask);
bool nrf_vpr_debugif_dmcontrol_get(NRF_VPR_Type const *p_reg, int signal);

#ifdef __cplusplus
}
#endif

#endif /* MOCK_NRF_VPR_H_ */
```

## src/mock_state.h
```c
/*
 * Copyright (c) 2025
 * SPDX-License-Identifier: Apache-2.0
 *
 * Shared mock state type for flpr_runtime unit tests.
 * Tracks VPR register writes and call counts for verification.
 */
#ifndef MOCK_STATE_H_
#define MOCK_STATE_H_

#include <stdint.h>
#include <stdbool.h>

#ifdef __cplusplus
extern "C" {
#endif

#define MOCK_MAX_DMCONTROL_WRITES 8

typedef struct {
	uint32_t dmcontrol_writes[MOCK_MAX_DMCONTROL_WRITES];
	uint32_t dmcontrol_write_count;
	uint32_t dmcontrol_set_count;
	uint32_t dmcontrol_get_count;
	bool cpurun;
	uint32_t cpurun_set_count;
	uint32_t cpurun_get_count;
	uint32_t initpc;
	uint32_t initpc_set_count;
	uint32_t initpc_get_count;
} mock_vpr_state_t;

extern mock_vpr_state_t mock_vpr;

void mock_reset(void);

#ifdef __cplusplus
}
#endif

#endif /* MOCK_STATE_H_ */
```

## src/test_flpr_runtime.c
```c
/*
 * Copyright (c) 2025
 * SPDX-License-Identifier: Apache-2.0
 *
 * Unit tests for the FLPR runtime restart manager — real production
 * source execution (T1A).
 *
 * This suite compiles src/flpr_runtime.c with FLPR_RUNTIME_NATIVE_TEST,
 * executing the actual nRF54 restart body against test-provided VPR
 * register storage, source/execution arrays, a mock handshake transport,
 * and time/cache/barrier hooks.  No copied restart algorithm is used.
 *
 * The mock handshake models FLPR reboot semantics: a successful
 * disconnect arms a reboot and wait_new_ready() only succeeds once the
 * mock FLPR epoch differs from the snapshot epoch.
 */
#include <zephyr/ztest.h>
#include <string.h>
#include <errno.h>

#include "flpr_runtime.h"
#include "flpr_runtime_hooks.h"
#include "mock_flpr_handshake.h"
#include "mock_nrf_vpr.h"
#include "mock_state.h"
#include "flpr_ring.h" /* production CRC for expected values */
#include <hal/nrf_memconf.h>

/* ── Expected DMCONTROL masks (same field constants as production) ── */

#define EXPECTED_RESET_ASSERT                                                                      \
	((VPR_DEBUGIF_DMCONTROL_NDMRESET_Active << VPR_DEBUGIF_DMCONTROL_NDMRESET_Pos) |           \
	 (VPR_DEBUGIF_DMCONTROL_DMACTIVE_Enabled << VPR_DEBUGIF_DMCONTROL_DMACTIVE_Pos))

#define EXPECTED_RESET_RELEASE                                                                     \
	((VPR_DEBUGIF_DMCONTROL_NDMRESET_Inactive << VPR_DEBUGIF_DMCONTROL_NDMRESET_Pos) |         \
	 (VPR_DEBUGIF_DMCONTROL_DMACTIVE_Enabled << VPR_DEBUGIF_DMCONTROL_DMACTIVE_Pos))

#define SUCCESS_EVENTS                                                                             \
	FLPR_RT_EV_SNAPSHOT, FLPR_RT_EV_SRC_CRC, FLPR_RT_EV_DISCONNECT, FLPR_RT_EV_STOP_CPURUN,    \
		FLPR_RT_EV_ASSERT_RESET, FLPR_RT_EV_COPY, FLPR_RT_EV_CACHE_FLUSH_BARRIERS,         \
		FLPR_RT_EV_EXEC_CRC, FLPR_RT_EV_INITPC, FLPR_RT_EV_SET_CPURUN,                     \
		FLPR_RT_EV_RELEASE_RESET, FLPR_RT_EV_RECONNECT, FLPR_RT_EV_WAIT_BOUND,             \
		FLPR_RT_EV_WAIT_READY, FLPR_RT_EV_SUCCESS

/* ── Helpers ────────────────────────────────────────────────────── */

static void rt_setup(void *fixture)
{
	(void)fixture;
	flpr_rt_test_reset_all();
	mock_hs_reset();
	mock_reset();
}

/* Deterministic source image. */
static void rt_fill_source(void)
{
	for (uint32_t i = 0; i < FLPR_RT_TEST_IMAGE_SIZE; i++) {
		flpr_rt_test_source[i] = (uint8_t)(i * 31U + 7U);
	}
}

/* Standard success arrangement: epoch 42, reboot armed by disconnect. */
static void rt_success_arrange(void)
{
	rt_fill_source();
	mock_hs_set_epoch(42);
	zassert_ok(flpr_runtime_init(), "init");
}

static void rt_assert_success_events(void)
{
	static const enum flpr_rt_test_event expected[] = {SUCCESS_EVENTS};
	const uint32_t n = sizeof(expected) / sizeof(expected[0]);

	zassert_equal(flpr_rt_test_event_count(), n, "event count");
	for (uint32_t i = 0; i < n; i++) {
		zassert_equal(flpr_rt_test_event_at(i), expected[i], "event[%u]", i);
	}
}

/* ── Init ──────────────────────────────────────────────────────── */

ZTEST(flpr_runtime, test_init_success)
{
	zassert_ok(flpr_runtime_init(), "init");

	struct flpr_runtime_status s;
	flpr_runtime_get_status(&s);
	zassert_equal(s.state, FLPR_RUNTIME_IDLE, "state");
	zassert_equal(s.requests, 0, "requests");
}

ZTEST(flpr_runtime, test_init_idempotent)
{
	zassert_ok(flpr_runtime_init(), "first init");
	zassert_ok(flpr_runtime_init(), "second init");

	struct flpr_runtime_status s;
	flpr_runtime_get_status(&s);
	zassert_equal(s.state, FLPR_RUNTIME_IDLE, "state");
	zassert_equal(s.requests, 0, "requests unchanged");
}

ZTEST(flpr_runtime, test_restart_before_init_enodev)
{
	int ret = flpr_runtime_restart(1000);
	zassert_equal(ret, -ENODEV, "restart before init must be -ENODEV");
}

/* ── Full success path ──────────────────────────────────────────── */

ZTEST(flpr_runtime, test_fresh_reload_rebinds_without_saved_context)
{
	rt_success_arrange();
	uint32_t control0 = flpr_rt_test_memconf.POWER[0].CONTROL;
	uint32_t retention0 = flpr_rt_test_memconf.POWER[0].RET;
	uint32_t retention2 = flpr_rt_test_memconf.POWER[0].RET2;
	uint32_t special_retention = flpr_rt_test_memconf.POWER[1].RET;

	zassert_ok(flpr_runtime_restart(1500U), "fresh boot, bound and READY");
	struct flpr_runtime_status status;
	flpr_runtime_get_status(&status);
	zassert_equal(status.new_epoch, 43U, "fresh remote generation");
	zassert_equal(status.success_count, 1U, "successful protocol restart");
	zassert_equal(flpr_rt_test_memconf.POWER[0].CONTROL, control0,
		      "physical SRAM power unchanged");
	zassert_equal(flpr_rt_test_memconf.POWER[0].RET, retention0,
		      "physical SRAM retention unchanged");
	zassert_equal(flpr_rt_test_memconf.POWER[0].RET2, retention2, "second SRAM bank unchanged");
	zassert_equal(flpr_rt_test_memconf.POWER[1].RET, special_retention & ~1U,
		      "only context-restore feature changed");

	/* Another fresh reload must also produce a new generation and binding. */
	zassert_ok(flpr_runtime_restart(1500U), "repeated restart");
	flpr_runtime_get_status(&status);
	zassert_equal(status.new_epoch, 44U, "next remote generation");
	zassert_equal(status.success_count, 2U, "both restarts complete");
}

ZTEST(flpr_runtime, test_context_selection_failure_preserves_image_then_recovers)
{
	rt_success_arrange();
	memset(flpr_rt_test_exec, 0xa5, FLPR_RT_TEST_IMAGE_SIZE);
	mock_vpr_fail_context_selection(true);
	zassert_equal(flpr_runtime_restart(1500U), -EIO, "cannot select fresh reset");
	for (uint32_t i = 0U; i < FLPR_RT_TEST_IMAGE_SIZE; i++) {
		zassert_equal(flpr_rt_test_exec[i], 0xa5, "unsafe reload did not occur");
	}
	mock_vpr_fail_context_selection(false);
	zassert_ok(flpr_runtime_restart(1500U), "valid retry recovers");
}

ZTEST(flpr_runtime, test_interrupt_rearm_failure_retains_mask_for_retry)
{
	rt_success_arrange();
	mock_vpr_fail_interrupt_rearm(true);
	zassert_equal(flpr_runtime_restart(1500U), -EIO, "disabled notification cannot pass");
	zassert_false(mock_vpr_fresh_boot_running(), "failed launched core returned to reset");
	mock_vpr_fail_interrupt_rearm(false);
	zassert_ok(flpr_runtime_restart(1500U),
		   "retry uses prior IRQ mask, not reset readback zero");
	struct flpr_runtime_status status;
	flpr_runtime_get_status(&status);
	zassert_equal(status.fail_count, 1U, "failed attempt retained");
	zassert_equal(status.success_count, 1U, "retry bound and READY succeed");
}

ZTEST(flpr_runtime, test_corrupt_reload_recovers_after_reset_held_failure)
{
	rt_success_arrange();
	flpr_rt_test_set_corrupt_after_copy(true);
	zassert_equal(flpr_runtime_restart(1500U), -EIO, "corrupt execution rejected");
	flpr_rt_test_set_corrupt_after_copy(false);
	zassert_ok(flpr_runtime_restart(1500U), "fresh recopy and rebind after held reset");
	struct flpr_runtime_status status;
	flpr_runtime_get_status(&status);
	zassert_equal(status.execution_crc, status.source_crc, "valid replacement image");
	zassert_equal(status.success_count, 1U, "retry succeeded");
}

ZTEST(flpr_runtime, test_full_success_event_order)
{
	rt_success_arrange();

	zassert_ok(flpr_runtime_restart(1000), "restart");
	rt_assert_success_events();
}

ZTEST(flpr_runtime, test_exactly_two_dmcontrol_writes)
{
	rt_success_arrange();

	zassert_ok(flpr_runtime_restart(1000), "restart");

	zassert_equal(mock_vpr.dmcontrol_write_count, 2, "exactly 2 DMCONTROL writes");
	zassert_equal(mock_vpr.dmcontrol_writes[0], EXPECTED_RESET_ASSERT, "write 0 = assert");
	zassert_equal(mock_vpr.dmcontrol_writes[1], EXPECTED_RESET_RELEASE, "write 1 = release");
}

ZTEST(flpr_runtime, test_dmactive_enabled_in_both_masks)
{
	rt_success_arrange();

	zassert_ok(flpr_runtime_restart(1000), "restart");

	struct flpr_runtime_status s;
	flpr_runtime_get_status(&s);

	uint32_t after_assert =
		(s.readbacks.dmcontrol_after_assert & VPR_DEBUGIF_DMCONTROL_DMACTIVE_Msk) >>
		VPR_DEBUGIF_DMCONTROL_DMACTIVE_Pos;
	uint32_t after_release =
		(s.readbacks.dmcontrol_after_release & VPR_DEBUGIF_DMCONTROL_DMACTIVE_Msk) >>
		VPR_DEBUGIF_DMCONTROL_DMACTIVE_Pos;

	zassert_equal(after_assert, VPR_DEBUGIF_DMCONTROL_DMACTIVE_Enabled,
		      "DMACTIVE enabled after assert");
	zassert_equal(after_release, VPR_DEBUGIF_DMCONTROL_DMACTIVE_Enabled,
		      "DMACTIVE enabled after release");
}

ZTEST(flpr_runtime, test_cpurun_readbacks)
{
	rt_success_arrange();

	zassert_ok(flpr_runtime_restart(1000), "restart");

	struct flpr_runtime_status s;
	flpr_runtime_get_status(&s);

	zassert_false(s.readbacks.cpurun_after_assert, "CPURUN false after stop+assert");
	zassert_true(s.readbacks.cpurun_after_set, "CPURUN true before release");
	zassert_equal(mock_vpr.cpurun_set_count, 2, "cpurun set false then true");
}

ZTEST(flpr_runtime, test_source_copied_exactly)
{
	rt_success_arrange();

	zassert_ok(flpr_runtime_restart(1000), "restart");

	zassert_equal(memcmp(flpr_rt_test_source, flpr_rt_test_exec, FLPR_RT_TEST_IMAGE_SIZE), 0,
		      "execution image must equal source image");

	struct flpr_runtime_status s;
	flpr_runtime_get_status(&s);
	zassert_equal(s.reload_bytes, FLPR_RT_TEST_IMAGE_SIZE, "reload_bytes");
}

ZTEST(flpr_runtime, test_cache_flush_and_barriers_after_copy)
{
	rt_success_arrange();

	zassert_ok(flpr_runtime_restart(1000), "restart");

	/* Hook observability. */
	zassert_equal(flpr_rt_test_cache_flush_count(), 1, "one cache flush");
	zassert_equal(flpr_rt_test_barrier_count(FLPR_RT_BARRIER_DSB), 1, "one DSB");
	zassert_equal(flpr_rt_test_barrier_count(FLPR_RT_BARRIER_ISB), 1, "one ISB");
	zassert_equal(flpr_rt_test_busy_wait_count(), 3, "three busy waits");
	zassert_equal(flpr_rt_test_sleep_count(), 1, "one sleep");

	/* Order: copy → flush+barriers → execution CRC. */
	const uint32_t n = flpr_rt_test_event_count();
	uint32_t copy_pos = 0;
	uint32_t flush_pos = 0;
	uint32_t crc_pos = 0;
	for (uint32_t i = 0; i < n; i++) {
		enum flpr_rt_test_event ev = flpr_rt_test_event_at(i);
		if (ev == FLPR_RT_EV_COPY) {
			copy_pos = i;
		}
		if (ev == FLPR_RT_EV_CACHE_FLUSH_BARRIERS) {
			flush_pos = i;
		}
		if (ev == FLPR_RT_EV_EXEC_CRC) {
			crc_pos = i;
		}
	}
	zassert_true(copy_pos < flush_pos && flush_pos < crc_pos,
		     "flush+barriers must occur after copy and before execution CRC");
}

ZTEST(flpr_runtime, test_matching_crc_success)
{
	rt_success_arrange();

	zassert_ok(flpr_runtime_restart(1000), "restart");

	struct flpr_runtime_status s;
	flpr_runtime_get_status(&s);

	uint32_t expected = flpr_ring_crc32(flpr_rt_test_source, FLPR_RT_TEST_IMAGE_SIZE);
	zassert_equal(s.source_crc, expected, "source_crc is real CRC of source image");
	zassert_equal(s.execution_crc, expected, "execution_crc equals source CRC");
	zassert_equal(s.last_errno, 0, "last_errno");
	zassert_equal(s.state, FLPR_RUNTIME_IDLE, "state IDLE after success");
}

ZTEST(flpr_runtime, test_injected_corruption_crc_eio)
{
	rt_success_arrange();
	flpr_rt_test_set_corrupt_after_copy(true);

	int ret = flpr_runtime_restart(1000);
	zassert_equal(ret, -EIO, "CRC mismatch must produce -EIO");

	struct flpr_runtime_status s;
	flpr_runtime_get_status(&s);
	zassert_equal(s.failed_stage, FLPR_STAGE_CRC_VERIFY, "stage CRC_VERIFY");
	zassert_equal(s.fail_count, 1, "fail_count");
	zassert_equal(s.last_errno, -EIO, "last_errno");
	zassert_equal(s.state, FLPR_RUNTIME_UNAVAILABLE, "state UNAVAILABLE");
	zassert_not_equal(s.source_crc, s.execution_crc, "execution CRC must differ");

	/* Copy happened, flush happened, but no launch edges after CRC. */
	zassert_equal(mock_vpr.dmcontrol_write_count, 1, "only assert write");
	zassert_false(mock_vpr.cpurun, "CPURUN stays stopped");
}

/* ── Failure stages ──────────────────────────────────────────────── */

ZTEST(flpr_runtime, test_disconnect_failure_no_vpr_touch)
{
	rt_success_arrange();
	mock_hs_set_disconnect_result(-EIO);

	int ret = flpr_runtime_restart(1000);
	zassert_equal(ret, -EIO, "disconnect failure propagates");

	struct flpr_runtime_status s;
	flpr_runtime_get_status(&s);
	zassert_equal(s.failed_stage, FLPR_STAGE_DISCONNECT, "stage DISCONNECT");
	zassert_equal(s.state, FLPR_RUNTIME_UNAVAILABLE, "state UNAVAILABLE");
	zassert_equal(s.fail_count, 1, "fail_count");

	/* VPR must be untouched: no cpurun, no dmcontrol, no initpc. */
	zassert_equal(mock_vpr.cpurun_set_count, 0, "no cpurun writes");
	zassert_equal(mock_vpr.dmcontrol_write_count, 0, "no dmcontrol writes");
	zassert_equal(mock_vpr.initpc_set_count, 0, "no initpc writes");

	/* Events: snapshot, source CRC, disconnect stage reached — no failure stop. */
	zassert_equal(flpr_rt_test_event_count(), 3, "event count");
	zassert_equal(flpr_rt_test_event_at(0), FLPR_RT_EV_SNAPSHOT, "ev 0");
	zassert_equal(flpr_rt_test_event_at(1), FLPR_RT_EV_SRC_CRC, "ev 1");
	zassert_equal(flpr_rt_test_event_at(2), FLPR_RT_EV_DISCONNECT, "ev 2");
}

ZTEST(flpr_runtime, test_reconnect_failure_reset_held)
{
	rt_success_arrange();
	mock_hs_set_reconnect_result(-EIO);

	int ret = flpr_runtime_restart(1000);
	zassert_equal(ret, -EIO, "reconnect failure propagates");

	struct flpr_runtime_status s;
	flpr_runtime_get_status(&s);
	zassert_equal(s.failed_stage, FLPR_STAGE_RECONNECT, "stage RECONNECT");
	zassert_equal(s.state, FLPR_RUNTIME_UNAVAILABLE, "state UNAVAILABLE");

	/* Re-registration is after launch. Failure reasserts reset with CPURUN off. */
	zassert_equal(mock_vpr.cpurun_set_count, 3, "stop, launch, failure stop");
	zassert_false(mock_vpr.cpurun, "CPURUN false");
	zassert_equal(mock_vpr.dmcontrol_write_count, 3, "assert, release, safe failure reset");
	zassert_equal(mock_vpr.dmcontrol_writes[2], EXPECTED_RESET_ASSERT, "reset held on failure");
	zassert_equal(s.readbacks.dmcontrol_after_assert, EXPECTED_RESET_ASSERT,
		      "readback shows held reset");
}

ZTEST(flpr_runtime, test_wait_bound_failure_stops_cpurun)
{
	rt_success_arrange();
	mock_hs_set_wait_bound_result(-EAGAIN);

	int ret = flpr_runtime_restart(1000);
	zassert_equal(ret, -EAGAIN, "wait bound failure propagates");

	struct flpr_runtime_status s;
	flpr_runtime_get_status(&s);
	zassert_equal(s.failed_stage, FLPR_STAGE_WAIT_BOUND, "stage WAIT_BOUND");
	zassert_equal(s.state, FLPR_RUNTIME_UNAVAILABLE, "state UNAVAILABLE");

	/* stop(false) + start(true) + failure stop(false). */
	zassert_equal(mock_vpr.cpurun_set_count, 3, "cpurun set false,true,false");
	zassert_false(mock_vpr.cpurun, "CPURUN stopped on failure");

	/* Release happened before waiting. */
	zassert_equal(mock_vpr.dmcontrol_write_count, 3, "assert + release + failure reset");
	zassert_equal(mock_vpr.dmcontrol_writes[1], EXPECTED_RESET_RELEASE, "released");

	/* Events end with failure stop. */
	static const enum flpr_rt_test_event expected[] = {
		FLPR_RT_EV_SNAPSHOT,
		FLPR_RT_EV_SRC_CRC,
		FLPR_RT_EV_DISCONNECT,
		FLPR_RT_EV_STOP_CPURUN,
		FLPR_RT_EV_ASSERT_RESET,
		FLPR_RT_EV_COPY,
		FLPR_RT_EV_CACHE_FLUSH_BARRIERS,
		FLPR_RT_EV_EXEC_CRC,
		FLPR_RT_EV_INITPC,
		FLPR_RT_EV_SET_CPURUN,
		FLPR_RT_EV_RELEASE_RESET,
		FLPR_RT_EV_RECONNECT,
		FLPR_RT_EV_WAIT_BOUND,
		FLPR_RT_EV_FAILURE_STOP,
	};
	const uint32_t n = sizeof(expected) / sizeof(expected[0]);
	zassert_equal(flpr_rt_test_event_count(), n, "event count");
	for (uint32_t i = 0; i < n; i++) {
		zassert_equal(flpr_rt_test_event_at(i), expected[i], "event[%u]", i);
	}
}

ZTEST(flpr_runtime, test_wait_ready_failure_stops_cpurun)
{
	rt_success_arrange();
	mock_hs_set_reboot_on_disconnect(false); /* same epoch → wait fails */

	int ret = flpr_runtime_restart(1000);
	zassert_equal(ret, -EAGAIN, "wait ready failure propagates");

	struct flpr_runtime_status s;
	flpr_runtime_get_status(&s);
	zassert_equal(s.failed_stage, FLPR_STAGE_WAIT_READY, "stage WAIT_READY");
	zassert_equal(s.state, FLPR_RUNTIME_UNAVAILABLE, "state UNAVAILABLE");
	zassert_equal(mock_vpr.cpurun_set_count, 3, "cpurun stopped on failure");
	zassert_false(mock_vpr.cpurun, "CPURUN stopped");
	zassert_equal(flpr_rt_test_event_at(flpr_rt_test_event_count() - 1),
		      FLPR_RT_EV_FAILURE_STOP, "last event is failure stop");
}

ZTEST(flpr_runtime, test_changed_epoch_required_for_wait_ready)
{
	rt_success_arrange();
	mock_hs_set_reboot_on_disconnect(false);

	/* No reboot → same epoch → wait_new_ready must fail. */
	int ret = flpr_runtime_restart(1000);
	zassert_equal(ret, -EAGAIN, "same-epoch wait must fail");
	zassert_equal(mock_hs_last_prev_epoch(), 42, "waited on snapshot epoch 42");

	struct flpr_runtime_status s;
	flpr_runtime_get_status(&s);
	zassert_equal(s.failed_stage, FLPR_STAGE_WAIT_READY, "stage WAIT_READY");

	/* Reboot armed by disconnect → changed epoch → success. */
	mock_hs_set_reboot_on_disconnect(true);
	zassert_ok(flpr_runtime_restart(1000), "restart with changed epoch");

	flpr_runtime_get_status(&s);
	zassert_equal(s.previous_epoch, 42, "snapshot epoch");
	zassert_equal(s.new_epoch, 43, "mock FLPR rebooted to 43");
	zassert_equal(mock_hs_last_prev_epoch(), 42, "waited on snapshot epoch again");
}

/* ── Mutex busy ──────────────────────────────────────────────────── */

ZTEST(flpr_runtime, test_mutex_busy_ebusy)
{
	rt_success_arrange();

	flpr_runtime_test_hold_mutex();

	int ret = flpr_runtime_restart(0);
	zassert_equal(ret, -EBUSY, "restart while busy must be -EBUSY");

	/* Release before reading status: get_status() takes the same mutex. */
	flpr_runtime_test_release_mutex();

	struct flpr_runtime_status s;
	flpr_runtime_get_status(&s);
	zassert_equal(s.busy_reject, 1, "busy_reject incremented");
	zassert_equal(s.requests, 0, "requests NOT incremented");

	zassert_ok(flpr_runtime_restart(1000), "restart after release");
	flpr_runtime_get_status(&s);
	zassert_equal(s.requests, 1, "request counted after busy window");
	zassert_equal(s.busy_reject, 1, "busy_reject unchanged");
}

/* ── Counters and accounting ─────────────────────────────────────── */

ZTEST(flpr_runtime, test_counters_exact)
{
	rt_success_arrange();

	zassert_ok(flpr_runtime_restart(1000), "restart 1");

	struct flpr_runtime_status s;
	flpr_runtime_get_status(&s);
	zassert_equal(s.requests, 1, "requests");
	zassert_equal(s.success_count, 1, "successes");
	zassert_equal(s.fail_count, 0, "fails");
	zassert_equal(s.last_errno, 0, "last_errno");
	zassert_equal(s.reload_bytes, FLPR_RT_TEST_IMAGE_SIZE, "reload_bytes");
	zassert_equal(s.source_crc, flpr_ring_crc32(flpr_rt_test_source, FLPR_RT_TEST_IMAGE_SIZE),
		      "source_crc");
	zassert_equal(s.execution_crc, s.source_crc, "execution_crc");
	zassert_equal(s.readbacks.initpc_after_set, (uint32_t)(uintptr_t)flpr_rt_test_exec,
		      "INITPC = execution base");
	zassert_equal(s.readbacks.dmcontrol_before_release, EXPECTED_RESET_ASSERT,
		      "DMCONTROL before release = assert mask");

	/* Failure resets the success markers. */
	mock_hs_set_disconnect_result(-EIO);
	zassert_equal(flpr_runtime_restart(1000), -EIO, "restart 2 fails");
	flpr_runtime_get_status(&s);
	zassert_equal(s.requests, 2, "requests");
	zassert_equal(s.success_count, 1, "successes");
	zassert_equal(s.fail_count, 1, "fails");
	zassert_equal(s.last_errno, -EIO, "last_errno");

	mock_hs_set_disconnect_result(0);
	zassert_ok(flpr_runtime_restart(1000), "restart 3");
	flpr_runtime_get_status(&s);
	zassert_equal(s.requests, 3, "requests");
	zassert_equal(s.success_count, 2, "successes");
	zassert_equal(s.fail_count, 1, "fails");
	zassert_equal(s.last_errno, 0, "last_errno");
}

ZTEST(flpr_runtime, test_duration_accounting_includes_failures)
{
	rt_success_arrange();

	/* Success: one 200 ms sleep. */
	zassert_ok(flpr_runtime_restart(1000), "restart 1");
	struct flpr_runtime_status s;
	flpr_runtime_get_status(&s);
	zassert_equal(s.total_duration_ms, 200, "total after success");
	zassert_equal(s.max_duration_ms, 200, "max after success");

	/* Wait-bound failure also reaches the 200 ms sleep. */
	mock_hs_set_wait_bound_result(-EAGAIN);
	zassert_equal(flpr_runtime_restart(1000), -EAGAIN, "restart 2 fails");
	flpr_runtime_get_status(&s);
	zassert_equal(s.total_duration_ms, 400, "failed attempt counted");
	zassert_equal(s.max_duration_ms, 200, "max unchanged");

	/* Disconnect failure adds zero duration. */
	mock_hs_set_wait_bound_result(0);
	mock_hs_clear_wait_bound_result();
	mock_hs_set_disconnect_result(-EIO);
	zassert_equal(flpr_runtime_restart(1000), -EIO, "restart 3 fails early");
	flpr_runtime_get_status(&s);
	zassert_equal(s.total_duration_ms, 400, "early failure adds nothing");
	zassert_equal(s.max_duration_ms, 200, "max unchanged");

	/* Longer failed attempt must extend max_duration_ms. */
	mock_hs_set_disconnect_result(0);
	flpr_rt_test_set_sleep_advance(500);
	mock_hs_set_wait_bound_result(-EAGAIN);
	zassert_equal(flpr_runtime_restart(1000), -EAGAIN, "restart 4 fails late");
	flpr_runtime_get_status(&s);
	zassert_equal(s.total_duration_ms, 900, "total includes 500 ms failure");
	zassert_equal(s.max_duration_ms, 500, "max includes failed attempt");

	/* Success afterwards still tracks correctly. */
	mock_hs_set_wait_bound_result(0);
	mock_hs_clear_wait_bound_result();
	zassert_ok(flpr_runtime_restart(1000), "restart 5 succeeds");
	flpr_runtime_get_status(&s);
	zassert_equal(s.total_duration_ms, 1400, "total after long success");
	zassert_equal(s.max_duration_ms, 500, "max unchanged");

	flpr_rt_test_set_sleep_advance(0);
	zassert_ok(flpr_runtime_restart(1000), "restart 6 succeeds");
	flpr_runtime_get_status(&s);
	zassert_equal(s.total_duration_ms, 1600, "total after normal success");
	zassert_equal(s.max_duration_ms, 500, "max still longest attempt");
}

ZTEST(flpr_runtime, test_second_run_early_failure_no_success_stage)
{
	rt_success_arrange();

	zassert_ok(flpr_runtime_restart(1000), "restart 1 succeeds");

	struct flpr_runtime_status s;
	flpr_runtime_get_status(&s);
	zassert_equal(s.failed_stage, FLPR_STAGE_SUCCESS, "success stage recorded");

	/* Second restart fails at disconnect: must NOT retain SUCCESS stage. */
	mock_hs_set_disconnect_result(-EIO);
	zassert_equal(flpr_runtime_restart(1000), -EIO, "restart 2 fails");
	flpr_runtime_get_status(&s);
	zassert_equal(s.failed_stage, FLPR_STAGE_DISCONNECT,
		      "failed_stage reset to DISCONNECT, not stale SUCCESS");
}

/* ── Status API ──────────────────────────────────────────────────── */

ZTEST(flpr_runtime, test_null_status_output_harmless)
{
	flpr_runtime_get_status(NULL);

	struct flpr_runtime_status s;
	memset(&s, 0xAA, sizeof(s));
	flpr_runtime_get_status(&s);
	zassert_equal(s.state, FLPR_RUNTIME_IDLE, "status filled");
}

ZTEST_SUITE(flpr_runtime, NULL, NULL, rt_setup, NULL, NULL);
```
