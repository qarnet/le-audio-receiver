## CMakeLists.txt
```
cmake_minimum_required(VERSION 3.20.0)
find_package(Zephyr REQUIRED HINTS $ENV{ZEPHYR_BASE})
project(test_audio_shell_nrf54)

# Same production shell command bodies as the audio_shell suite, but
# with CONFIG_SOC_NRF54L15 forced for this translation unit so the FLPR
# command groups (production diagnostics in flpr_shell.c, acceptance
# harness in flpr_acceptance_shell.c, bt unpair in bt_shell.c) compile
# and execute against mocked FLPR APIs.  Common subsystem APIs are faked
# from ../audio_shell; audio_perf.c is production source.
set(SHELL_SUITE_DIR ${CMAKE_CURRENT_SOURCE_DIR}/../audio_shell)

target_sources(app PRIVATE
  src/test_audio_shell_nrf54.c
  src/fake_flpr_deps.c
  ${SHELL_SUITE_DIR}/src/fake_audio_shell_deps.c
  ${CMAKE_CURRENT_SOURCE_DIR}/../../../src/audio_shell.c
  ${CMAKE_CURRENT_SOURCE_DIR}/../../../src/bt_shell.c
  ${CMAKE_CURRENT_SOURCE_DIR}/../../../src/flpr_shell.c
  ${CMAKE_CURRENT_SOURCE_DIR}/../../../src/flpr_acceptance_shell.c
  ${CMAKE_CURRENT_SOURCE_DIR}/../../../src/audio_perf.c
)

target_include_directories(app PRIVATE
  src
  ${SHELL_SUITE_DIR}/src
  ${CMAKE_CURRENT_SOURCE_DIR}/../../../src
)

# CONFIG_SOC_NRF54L15, CONFIG_AUDIO_OFFLOAD_ASRC, and
# CONFIG_AUDIO_ACCEPTANCE_DIAGNOSTICS are production Kconfig symbols; the
# test app Kconfig does not define them, so they are forced for this
# translation unit to compile the FLPR command bodies (production +
# acceptance) and the ASRC offload section.  The resampler variant string
# is the nRF54 production choice (ASRC linear).
target_compile_definitions(app PRIVATE
  AUDIO_SHELL_TEST=1
  CONFIG_SOC_NRF54L15=1
  CONFIG_AUDIO_OFFLOAD_ASRC=1
  CONFIG_AUDIO_ACCEPTANCE_DIAGNOSTICS=1
  CONFIG_AUDIO_RESAMPLER_ASRC_LINEAR=1
  CONFIG_BT_ASCS_MAX_ASE_SNK_COUNT=2
)
```

## prj.conf
```kconfig
CONFIG_ZTEST=y
CONFIG_SHELL=y
CONFIG_SHELL_BACKEND_SERIAL=n
CONFIG_SHELL_BACKEND_DUMMY=y
CONFIG_SHELL_BACKEND_DUMMY_BUF_SIZE=2048
CONFIG_AUDIO_PERF_MEASUREMENT=y
CONFIG_AUDIO_PERF_DEADLINE_US=10000
```

## src/audio_shell_test.h
```c
/*
 * Copyright (c) 2026
 * SPDX-License-Identifier: Apache-2.0
 *
 * Declarations of the AUDIO_SHELL_TEST seam wrappers compiled into
 * src/audio_shell.c when AUDIO_SHELL_TEST is defined (test builds only;
 * never present in production firmware).  nRF54 variant: includes the
 * FLPR command wrappers.
 */

#ifndef AUDIO_SHELL_TEST_H
#define AUDIO_SHELL_TEST_H

#include <stddef.h>

#include <zephyr/shell/shell.h>

int audio_shell_test_cmd_status(const struct shell *sh, size_t argc, char **argv);
int audio_shell_test_cmd_reset_stats(const struct shell *sh, size_t argc, char **argv);
int audio_shell_test_cmd_stop(const struct shell *sh, size_t argc, char **argv);
int audio_shell_test_cmd_perf(const struct shell *sh, size_t argc, char **argv);
int audio_shell_test_cmd_perf_reset(const struct shell *sh, size_t argc, char **argv);
int audio_shell_test_cmd_bt_unpair(const struct shell *sh, size_t argc, char **argv);
int audio_shell_test_cmd_flpr_status(const struct shell *sh, size_t argc, char **argv);
int audio_shell_test_cmd_flpr_ring_status(const struct shell *sh, size_t argc, char **argv);
int audio_shell_test_cmd_offload_status(const struct shell *sh, size_t argc, char **argv);
int audio_shell_test_cmd_flpr_runtime_status(const struct shell *sh, size_t argc, char **argv);
int audio_shell_test_cmd_flpr_restart(const struct shell *sh, size_t argc, char **argv);

#endif /* AUDIO_SHELL_TEST_H */
```

## src/fake_flpr_deps.c
```c
/*
 * Copyright (c) 2026
 * SPDX-License-Identifier: Apache-2.0
 *
 * Mock implementations of the FLPR APIs that the nRF54 shell command
 * bodies call (R8): handshake status, the acceptance module surface
 * (stress, fault hang, ring test, stalls, stale produce, acceptance
 * status, gates), core ring status, offload, and runtime.  Status
 * structs are controlled by the test; acceptance/stress/stall mechanics
 * are link-only stubs (their real production modules have their own
 * direct suites).
 */

#include <errno.h>
#include <stdbool.h>
#include <stdint.h>
#include <string.h>

#include "audio_offload.h"
#include "fake_flpr_deps.h"
#include "flpr_acceptance.h"
#include "flpr_handshake.h"
#include "flpr_ring.h"
#include "flpr_ring_mgr.h"
#include "flpr_runtime.h"

/* ---- handshake ---- */

static struct flpr_status test_hs_status;

void flpr_handshake_get_status(struct flpr_status *status)
{
	*status = test_hs_status;
}

void test_flpr_set_status(const struct flpr_status *s)
{
	test_hs_status = *s;
}

/* ---- acceptance module ---- */

static struct flpr_acceptance_status test_acc_status;
static int test_hang_result;
static int test_ring_test_result;
static int test_flpr_stall_result;
static int test_flpr_stall_timed_result;
static bool test_stall_producer_value;
static bool test_stall_producer_called;
static uint32_t test_stall_acked;
static int test_gates_result;
static bool test_stress_active_value;
static struct flpr_status test_stress_snapshot;

void flpr_acceptance_init(void)
{
}

void flpr_acceptance_get_status(struct flpr_acceptance_status *status)
{
	*status = test_acc_status;
}

void flpr_acceptance_stall_producer(bool stall)
{
	test_stall_producer_value = stall;
	test_stall_producer_called = true;
}

bool flpr_acceptance_stall_producer_active(void)
{
	return test_stall_producer_value;
}

int flpr_acceptance_flpr_stall(uint8_t stall_bits, uint32_t timeout_ms)
{
	(void)stall_bits;
	(void)timeout_ms;
	return test_flpr_stall_result;
}

int flpr_acceptance_flpr_stall_timed(uint8_t stall_bits, uint32_t duration_ms, uint32_t timeout_ms)
{
	(void)stall_bits;
	(void)duration_ms;
	(void)timeout_ms;
	return test_flpr_stall_timed_result;
}

uint32_t flpr_acceptance_flpr_stall_acked(void)
{
	return test_stall_acked;
}

int flpr_acceptance_test_run(uint32_t block_count, uint32_t timeout_ms,
			     struct flpr_acceptance_status *out)
{
	(void)block_count;
	(void)timeout_ms;
	*out = test_acc_status;
	return test_ring_test_result;
}

int flpr_acceptance_test_run_rate(uint32_t block_count, uint32_t timeout_ms, uint32_t rate_per_sec,
				  struct flpr_acceptance_status *out)
{
	(void)block_count;
	(void)timeout_ms;
	(void)rate_per_sec;
	*out = test_acc_status;
	return test_ring_test_result;
}

int flpr_acceptance_produce_stale_test(uint32_t stale_epoch)
{
	(void)stale_epoch;
	return 0;
}

static void stress_fields_into(struct flpr_status *out)
{
	if (!out) {
		return;
	}
	out->stress_active = test_stress_snapshot.stress_active;
	out->stress_count = test_stress_snapshot.stress_count;
	out->stress_sent = test_stress_snapshot.stress_sent;
	out->stress_recv = test_stress_snapshot.stress_recv;
	out->stress_timeouts = test_stress_snapshot.stress_timeouts;
	out->stress_stale = test_stress_snapshot.stress_stale;
	out->stress_mismatch = test_stress_snapshot.stress_mismatch;
	out->stress_err_send = test_stress_snapshot.stress_err_send;
}

void flpr_acceptance_stress(uint32_t count, struct flpr_status *out)
{
	(void)count;
	stress_fields_into(out);
}

bool flpr_acceptance_stress_active(void)
{
	return test_stress_active_value;
}

void flpr_acceptance_stress_snapshot(struct flpr_status *out)
{
	stress_fields_into(out);
}

int flpr_acceptance_send_fault_hang(uint32_t timeout_ms)
{
	(void)timeout_ms;
	return test_hang_result;
}

int flpr_acceptance_run_gates(uint32_t count, void *ctx, flpr_acceptance_print_t print)
{
	(void)count;
	if (print != NULL) {
		print(ctx, FLPR_ACC_PRINT_NORMAL, "fake gate line");
	}
	return test_gates_result;
}

/* ---- ring manager (core status only) ---- */

static struct flpr_ring_status test_ring_status;
static int test_reset_result;
static int test_init_result;

void flpr_ring_mgr_get_status(struct flpr_ring_status *status)
{
	*status = test_ring_status;
}

int flpr_ring_mgr_coordinated_reset(uint32_t new_epoch, uint32_t timeout_ms)
{
	(void)new_epoch;
	(void)timeout_ms;
	return test_reset_result;
}

int flpr_ring_mgr_init(void)
{
	return test_init_result;
}

enum flpr_produce_result flpr_ring_mgr_produce_block(const uint8_t *pcm_data, uint16_t valid_frames,
						     uint32_t sequence, int32_t correction_ppm,
						     bool compute_crc)
{
	(void)pcm_data;
	(void)valid_frames;
	(void)sequence;
	(void)correction_ppm;
	(void)compute_crc;
	return FLPR_PRODUCE_OK;
}

enum flpr_consume_result flpr_ring_mgr_consume_block(uint8_t *pcm_out, uint16_t *valid_frames_out,
						     uint32_t *sequence_out, uint32_t *crc32_out,
						     uint32_t *latency_cycles_out)
{
	(void)pcm_out;
	(void)valid_frames_out;
	(void)sequence_out;
	(void)crc32_out;
	(void)latency_cycles_out;
	return FLPR_CONSUME_EMPTY;
}

int flpr_ring_mgr_wait_consume(uint32_t timeout_ms)
{
	(void)timeout_ms;
	return 0;
}

int flpr_ring_mgr_notify_producer(void)
{
	return 0;
}

/* ---- test controls ---- */

void test_flpr_set_ring_status(const struct flpr_ring_status *s)
{
	test_ring_status = *s;
}

void test_flpr_set_acceptance_status(const struct flpr_acceptance_status *s)
{
	test_acc_status = *s;
}

void test_flpr_set_hang_result(int result)
{
	test_hang_result = result;
}

void test_flpr_set_ring_test_result(int result)
{
	test_ring_test_result = result;
}

void test_flpr_set_reset_result(int result)
{
	test_reset_result = result;
}

void test_flpr_set_init_result(int result)
{
	test_init_result = result;
}

void test_flpr_set_stall_result(int result)
{
	test_flpr_stall_result = result;
}

void test_flpr_set_stall_timed_result(int result)
{
	test_flpr_stall_timed_result = result;
}

void test_flpr_set_stall_acked(uint32_t value)
{
	test_stall_acked = value;
}

void test_flpr_set_stress_active(bool active)
{
	test_stress_active_value = active;
}

void test_flpr_set_stress_snapshot(const struct flpr_status *s)
{
	test_stress_snapshot = *s;
}

void test_flpr_set_gates_result(int result)
{
	test_gates_result = result;
}

bool test_flpr_stall_producer_called(void)
{
	return test_stall_producer_called;
}

bool test_flpr_stall_producer_value(void)
{
	return test_stall_producer_value;
}

/* ---- offload ---- */

static struct audio_offload_status test_offload_status;
static struct audio_offload_asrc_stats test_asrc_stats;
static bool test_offload_healthy;

void audio_offload_get_status(struct audio_offload_status *s)
{
	*s = test_offload_status;
}

void audio_offload_get_asrc_stats(struct audio_offload_asrc_stats *s)
{
	*s = test_asrc_stats;
}

bool audio_offload_is_healthy(void)
{
	return test_offload_healthy;
}

void test_flpr_set_offload_status(const struct audio_offload_status *s)
{
	test_offload_status = *s;
}

void test_flpr_set_asrc_stats(const struct audio_offload_asrc_stats *s)
{
	test_asrc_stats = *s;
}

void test_flpr_set_offload_healthy(bool healthy)
{
	test_offload_healthy = healthy;
}

/* ---- runtime ---- */

static struct flpr_runtime_status test_runtime_status;
static int test_restart_result;
static int test_restart_calls;

void flpr_runtime_get_status(struct flpr_runtime_status *out)
{
	*out = test_runtime_status;
}

int flpr_runtime_restart(uint32_t timeout_ms)
{
	(void)timeout_ms;
	test_restart_calls++;
	return test_restart_result;
}

void test_flpr_set_runtime_status(const struct flpr_runtime_status *s)
{
	test_runtime_status = *s;
}

void test_flpr_set_restart_result(int result)
{
	test_restart_result = result;
}

int test_flpr_restart_calls(void)
{
	return test_restart_calls;
}

/* ---- global reset ---- */

void test_flpr_reset(void)
{
	memset(&test_hs_status, 0, sizeof(test_hs_status));
	memset(&test_ring_status, 0, sizeof(test_ring_status));
	memset(&test_acc_status, 0, sizeof(test_acc_status));
	memset(&test_offload_status, 0, sizeof(test_offload_status));
	memset(&test_asrc_stats, 0, sizeof(test_asrc_stats));
	memset(&test_runtime_status, 0, sizeof(test_runtime_status));
	memset(&test_stress_snapshot, 0, sizeof(test_stress_snapshot));
	test_stall_acked = 0;
	test_offload_healthy = false;
	test_restart_result = 0;
	test_restart_calls = 0;
	test_hang_result = -ENOTSUP;
	test_ring_test_result = 0;
	test_reset_result = 0;
	test_init_result = 0;
	test_flpr_stall_result = 0;
	test_flpr_stall_timed_result = 0;
	test_gates_result = 0;
	test_stall_producer_called = false;
	test_stall_producer_value = false;
	test_stress_active_value = false;
}
```

## src/fake_flpr_deps.h
```c
/*
 * Copyright (c) 2026
 * SPDX-License-Identifier: Apache-2.0
 *
 * Test controls for the nRF54 shell FLPR API fakes (R8): the fake
 * implements the acceptance-module surface (flpr_acceptance_*), the
 * core handshake/ring/runtime/offload status APIs, and exposes setters
 * used by the audio_shell_nrf54 tests.
 */
#ifndef FAKE_FLPR_DEPS_H_
#define FAKE_FLPR_DEPS_H_

#include <stdbool.h>
#include <stdint.h>

#include "audio_offload.h"
#include "flpr_acceptance.h"
#include "flpr_handshake.h"
#include "flpr_ring_mgr.h"
#include "flpr_runtime.h"

#ifdef __cplusplus
extern "C" {
#endif

/* handshake */
void test_flpr_set_status(const struct flpr_status *s);

/* acceptance module */
void test_flpr_set_acceptance_status(const struct flpr_acceptance_status *s);
void test_flpr_set_hang_result(int result);
void test_flpr_set_ring_test_result(int result);
void test_flpr_set_stall_result(int result);
void test_flpr_set_stall_timed_result(int result);
void test_flpr_set_stall_acked(uint32_t value);
void test_flpr_set_stress_active(bool active);
void test_flpr_set_stress_snapshot(const struct flpr_status *s);
void test_flpr_set_gates_result(int result);

/* ring manager (core status) */
void test_flpr_set_ring_status(const struct flpr_ring_status *s);
void test_flpr_set_reset_result(int result);
void test_flpr_set_init_result(int result);

/* offload */
void test_flpr_set_offload_status(const struct audio_offload_status *s);
void test_flpr_set_asrc_stats(const struct audio_offload_asrc_stats *s);
void test_flpr_set_offload_healthy(bool healthy);

/* runtime */
void test_flpr_set_runtime_status(const struct flpr_runtime_status *s);
void test_flpr_set_restart_result(int result);
int test_flpr_restart_calls(void);

/* observation */
bool test_flpr_stall_producer_called(void);
bool test_flpr_stall_producer_value(void);

/* global reset */
void test_flpr_reset(void);

#ifdef __cplusplus
}
#endif

#endif /* FAKE_FLPR_DEPS_H_ */
```
