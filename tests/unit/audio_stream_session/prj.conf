## CMakeLists.txt
```
cmake_minimum_required(VERSION 3.20.0)
find_package(Zephyr REQUIRED HINTS $ENV{ZEPHYR_BASE})
project(test_audio_stream_session)

set(FIXTURES ${CMAKE_CURRENT_SOURCE_DIR}/../../fixtures/lc3)

# Direct production-source suite for src/audio_stream_session.c: compiles
# the real session, decoder, Mode A assembler, ISO sequence tracker,
# statistics, and perf against faithful fake sink/volume/observer seams.
# lc3_decode() is linker-wrapped (src/lc3_wrap.c) only to inject hard
# failures for the production error-accounting path — all other calls pass
# through to the real liblc3 (same seam as tests/unit/decode).
target_sources(app PRIVATE
  src/test_audio_stream_session.c
  src/fake_sink.c
  src/fake_volume.c
  src/fake_observer.c
  src/lc3_wrap.c
  ${CMAKE_CURRENT_SOURCE_DIR}/../../../src/audio_stream_session.c
  ${CMAKE_CURRENT_SOURCE_DIR}/../../../src/audio_decode.c
  ${CMAKE_CURRENT_SOURCE_DIR}/../../../src/audio_modea.c
  ${CMAKE_CURRENT_SOURCE_DIR}/../../../src/audio_iso_seq.c
  ${CMAKE_CURRENT_SOURCE_DIR}/../../../src/audio_stats.c
  ${CMAKE_CURRENT_SOURCE_DIR}/../../../src/audio_perf.c
)

target_include_directories(app PRIVATE
  src
  ${CMAKE_CURRENT_SOURCE_DIR}/../../../src
  ${CMAKE_CURRENT_SOURCE_DIR}/../../../tests/bsim/src
  ${CMAKE_CURRENT_BINARY_DIR}
)

foreach(f mono_48k_10ms_60b modeb_48k_10ms_60b)
  generate_inc_file_for_target(app ${FIXTURES}/${f}.lc3 ${CMAKE_CURRENT_BINARY_DIR}/${f}_lc3.inc)
  generate_inc_file_for_target(app ${FIXTURES}/${f}.pcm ${CMAKE_CURRENT_BINARY_DIR}/${f}_pcm.inc)
endforeach()

target_link_options(app PUBLIC -Wl,--wrap=lc3_decode)
```

## Kconfig
```
# audio_stream_session unit test — local Kconfig seam.
# Mirrors the BSim sink-pool seam so the production session header resolves
# AUDIO_STREAM_SESSION_MAX_SLOTS to 2 without a BT build; the fake observer
# compiles the production session's CONFIG_BSIM_OBSERVER call sites; the
# perf instrumentation is enabled so real production audio_perf.c counters
# (push-failure accounting) execute.

mainmenu "LE Audio Receiver — audio_stream_session unit tests"

config BSIM_OBSERVER
	bool "Fake passive observer (unit test)"
	help
	  Enables the session's observer call sites against the suite-local
	  fake bsim_observer implementation.

config BSIM_SINK_POOL_LIMIT
	int "Sink stream pool limit (unit test)"
	default 2
	help
	  Same seam as the BSim build: caps the repository stream pool at 2
	  so the session header resolves its slot count without a BT ASCS
	  configuration.

config AUDIO_PERF_MEASUREMENT
	bool "Audio performance instrumentation"
	default y

config AUDIO_PERF_DEADLINE_US
	int "Per-path deadline threshold in microseconds"
	default 10000

source "Kconfig.zephyr"
```

## prj.conf
```kconfig
CONFIG_ZTEST=y
CONFIG_FPU=y
CONFIG_LIBLC3=y
CONFIG_CRC=y
CONFIG_AUDIO_PERF_MEASUREMENT=y
CONFIG_BSIM_OBSERVER=y
CONFIG_BSIM_SINK_POOL_LIMIT=2

# BSim observer needs public BAP enum declarations, whose headers require BT
# buffer defaults. This suite has no Bluetooth or random runtime dependency;
# keep native_sim from opening a user-channel HCI device or fake entropy.
CONFIG_BT=y
CONFIG_BT_DRIVERS=n
CONFIG_BT_HOST_CRYPTO=n
CONFIG_ENTROPY_GENERATOR=n
```

## src/fake_observer.c
```c
/*
 * Copyright (c) 2026
 * SPDX-License-Identifier: Apache-2.0
 *
 * Fake bsim_observer for the audio_stream_session unit suite.
 */

#include "bsim_observer.h"
#include "fake_observer.h"

#include <stdatomic.h>
#include <stdbool.h>
#include <stdint.h>
#include <string.h>

#define FAKE_OBSERVER_MAX_PRE_PUSH 32U

static atomic_uint malformed_cnt;
static atomic_uint stale_half_cnt;
static atomic_uint missing_ts_cnt;
static atomic_uint pre_push_cnt;
static struct bsim_observer_push last_push;
static struct bsim_observer_push pre_pushes[FAKE_OBSERVER_MAX_PRE_PUSH];
static atomic_bool push_ready;

static bool push_half_well_formed(bool valid, const uint8_t *payload, size_t payload_len)
{
	if (valid) {
		return payload != NULL && payload_len > 0U &&
		       payload_len <= BSIM_OBSERVER_MAX_PAYLOAD_BYTES;
	}

	return payload == NULL && payload_len == 0U;
}

static const struct bsim_observer_push_half *pre_push_half_at(uint32_t index, bool right)
{
	if (index >= FAKE_OBSERVER_MAX_PRE_PUSH || index >= atomic_load(&pre_push_cnt)) {
		return NULL;
	}

	return right ? &pre_pushes[index].right : &pre_pushes[index].left;
}

void fake_observer_reset(void)
{
	atomic_store(&malformed_cnt, 0U);
	atomic_store(&stale_half_cnt, 0U);
	atomic_store(&missing_ts_cnt, 0U);
	atomic_store(&pre_push_cnt, 0U);
	atomic_store(&push_ready, false);
	memset(&last_push, 0, sizeof(last_push));
	memset(pre_pushes, 0, sizeof(pre_pushes));
}

uint32_t fake_observer_malformed_sdu(void)
{
	return atomic_load(&malformed_cnt);
}

uint32_t fake_observer_stale_half(void)
{
	return atomic_load(&stale_half_cnt);
}

uint32_t fake_observer_missing_ts(void)
{
	return atomic_load(&missing_ts_cnt);
}

uint32_t fake_observer_pre_push_count(void)
{
	return atomic_load(&pre_push_cnt);
}

bool fake_observer_last_push_l_valid(void)
{
	return last_push.left.source_valid;
}

bool fake_observer_last_push_r_valid(void)
{
	return last_push.right.source_valid;
}

uint16_t fake_observer_last_push_l_payload_len(void)
{
	return last_push.left.payload_len;
}

uint16_t fake_observer_last_push_r_payload_len(void)
{
	return last_push.right.payload_len;
}

const uint8_t *fake_observer_last_push_l_payload(void)
{
	return last_push.left.payload;
}

const uint8_t *fake_observer_last_push_r_payload(void)
{
	return last_push.right.payload;
}

bool fake_observer_pre_push_l_valid_at(uint32_t index)
{
	const struct bsim_observer_push_half *half = pre_push_half_at(index, false);

	return half != NULL && half->source_valid;
}

bool fake_observer_pre_push_r_valid_at(uint32_t index)
{
	const struct bsim_observer_push_half *half = pre_push_half_at(index, true);

	return half != NULL && half->source_valid;
}

uint16_t fake_observer_pre_push_l_payload_len_at(uint32_t index)
{
	const struct bsim_observer_push_half *half = pre_push_half_at(index, false);

	return half != NULL ? half->payload_len : 0U;
}

uint16_t fake_observer_pre_push_r_payload_len_at(uint32_t index)
{
	const struct bsim_observer_push_half *half = pre_push_half_at(index, true);

	return half != NULL ? half->payload_len : 0U;
}

const uint8_t *fake_observer_pre_push_l_payload_at(uint32_t index)
{
	const struct bsim_observer_push_half *half = pre_push_half_at(index, false);

	return half != NULL ? half->payload : NULL;
}

const uint8_t *fake_observer_pre_push_r_payload_at(uint32_t index)
{
	const struct bsim_observer_push_half *half = pre_push_half_at(index, true);

	return half != NULL ? half->payload : NULL;
}

/* bsim_observer API used by production session call sites. */

void bsim_observer_config(bool accepted, enum bt_audio_dir dir, enum bt_bap_ascs_rsp_code code,
			  enum bt_bap_ascs_reason reason)
{
	(void)accepted;
	(void)dir;
	(void)code;
	(void)reason;
}

void bsim_observer_gate_open(void)
{
}

void bsim_observer_gate_close(void)
{
}

void bsim_observer_malformed_sdu(void)
{
	atomic_fetch_add(&malformed_cnt, 1U);
}

void bsim_observer_recv_gate_blocked(void)
{
}

void bsim_observer_stale_half(void)
{
	atomic_fetch_add(&stale_half_cnt, 1U);
}

void bsim_observer_cleanup_release(unsigned int slot)
{
	(void)slot;
}

void bsim_observer_cleanup_disconnect(void)
{
}

void bsim_observer_release_sink_stop(void)
{
}

void bsim_observer_missing_ts(void)
{
	atomic_fetch_add(&missing_ts_cnt, 1U);
}

void bsim_observer_pre_push(bool l_valid, const uint8_t *l_payload, size_t l_payload_len,
			    bool r_valid, const uint8_t *r_payload, size_t r_payload_len)
{
	struct bsim_observer_push snapshot = {0};
	const uint32_t index = atomic_load(&pre_push_cnt);

	atomic_store(&push_ready, false);
	if (!push_half_well_formed(l_valid, l_payload, l_payload_len) ||
	    !push_half_well_formed(r_valid, r_payload, r_payload_len)) {
		return;
	}

	snapshot.left.source_valid = l_valid;
	snapshot.left.payload_len = (uint16_t)l_payload_len;
	snapshot.right.source_valid = r_valid;
	snapshot.right.payload_len = (uint16_t)r_payload_len;
	if (l_valid) {
		memcpy(snapshot.left.payload, l_payload, l_payload_len);
	}
	if (r_valid) {
		memcpy(snapshot.right.payload, r_payload, r_payload_len);
	}

	last_push = snapshot;
	if (index < FAKE_OBSERVER_MAX_PRE_PUSH) {
		pre_pushes[index] = snapshot;
	}
	atomic_fetch_add(&pre_push_cnt, 1U);
	atomic_store(&push_ready, true);
}

bool bsim_observer_take_push(struct bsim_observer_push *out)
{
	if (out == NULL || !atomic_exchange(&push_ready, false)) {
		return false;
	}

	*out = last_push;
	return true;
}

uint32_t bsim_observer_get_config_accepted(void)
{
	return 0U;
}

uint32_t bsim_observer_get_config_rejected(void)
{
	return 0U;
}

int bsim_observer_get_last_config_dir(void)
{
	return 0;
}

int bsim_observer_get_last_config_code(void)
{
	return 0;
}

int bsim_observer_get_last_config_reason(void)
{
	return 0;
}

int bsim_observer_get_last_rej_dir(void)
{
	return 0;
}

int bsim_observer_get_last_rej_code(void)
{
	return 0;
}

int bsim_observer_get_last_rej_reason(void)
{
	return 0;
}

uint32_t bsim_observer_get_gate_open(void)
{
	return 0U;
}

uint32_t bsim_observer_get_gate_close(void)
{
	return 0U;
}

uint32_t bsim_observer_get_malformed_sdu(void)
{
	return atomic_load(&malformed_cnt);
}

uint32_t bsim_observer_get_recv_gate_blocked(void)
{
	return 0U;
}

uint32_t bsim_observer_get_stale_half(void)
{
	return atomic_load(&stale_half_cnt);
}

uint32_t bsim_observer_get_release_cleanup(void)
{
	return 0U;
}

uint32_t bsim_observer_get_disconnect_cleanup(void)
{
	return 0U;
}

uint32_t bsim_observer_get_release_sink_stop(void)
{
	return 0U;
}

uint32_t bsim_observer_get_missing_ts(void)
{
	return atomic_load(&missing_ts_cnt);
}

uint32_t bsim_observer_get_event_seq(void)
{
	return 0U;
}

uint32_t bsim_observer_get_release_sink_stop_seq(void)
{
	return 0U;
}

uint32_t bsim_observer_get_disconnect_seq(void)
{
	return 0U;
}
```

## src/fake_observer.h
```c
/*
 * Copyright (c) 2026
 * SPDX-License-Identifier: Apache-2.0
 *
 * Test knobs for the fake bsim_observer used by the audio_stream_session
 * unit suite.
 */

#ifndef FAKE_OBSERVER_H
#define FAKE_OBSERVER_H

#include <stdbool.h>
#include <stdint.h>

void fake_observer_reset(void);
uint32_t fake_observer_malformed_sdu(void);
uint32_t fake_observer_stale_half(void);
uint32_t fake_observer_missing_ts(void);
uint32_t fake_observer_pre_push_count(void);
bool fake_observer_last_push_l_valid(void);
bool fake_observer_last_push_r_valid(void);
uint16_t fake_observer_last_push_l_payload_len(void);
uint16_t fake_observer_last_push_r_payload_len(void);
const uint8_t *fake_observer_last_push_l_payload(void);
const uint8_t *fake_observer_last_push_r_payload(void);
bool fake_observer_pre_push_l_valid_at(uint32_t index);
bool fake_observer_pre_push_r_valid_at(uint32_t index);
uint16_t fake_observer_pre_push_l_payload_len_at(uint32_t index);
uint16_t fake_observer_pre_push_r_payload_len_at(uint32_t index);
const uint8_t *fake_observer_pre_push_l_payload_at(uint32_t index);
const uint8_t *fake_observer_pre_push_r_payload_at(uint32_t index);

#endif /* FAKE_OBSERVER_H */
```

## src/fake_sink.c
```c
/*
 * Copyright (c) 2026
 * SPDX-License-Identifier: Apache-2.0
 *
 * Faithful audio_sink.h fake for the audio_stream_session unit suite.
 *
 * Records every accepted push (count, last sample count, and a copy of
 * the FIRST push for golden content assertions) and exposes test knobs:
 * forced push failure (-ENOMEM) for the sink-failure accounting path, and
 * a blocking push mode (semaphore in / semaphore out) that lets the
 * concurrency tests park a receive lease inside a push while the test
 * thread inspects session lock discipline and rx_close drain behavior.
 */

#include "audio_sink.h"
#include "fake_sink.h"

#include <zephyr/kernel.h>
#include <stdatomic.h>
#include <stdint.h>
#include <string.h>

#define FAKE_SINK_MAX_PUSHES  64
#define FAKE_SINK_MAX_SAMPLES 960 /* 48 kHz × 10 ms × 2 ch */

static int16_t first_push[FAKE_SINK_MAX_SAMPLES];
static atomic_uint push_count;
static atomic_uint last_sample_count;
static atomic_uint fail_pushes;  /* pushes that returned < 0 */
static atomic_uint input_frames; /* last audio_sink_set_input_frames value */
static atomic_bool admission_open;
static atomic_bool configured;
static atomic_bool fail_next;    /* when set, push returns -ENOMEM */
static atomic_bool block_pushes; /* when set, push parks between two semaphores */
static K_SEM_DEFINE(in_sem, 0, 1);
static K_SEM_DEFINE(out_sem, 0, 1);

void fake_sink_reset(void)
{
	atomic_store(&push_count, 0U);
	atomic_store(&last_sample_count, 0U);
	atomic_store(&fail_pushes, 0U);
	atomic_store(&input_frames, 0U);
	atomic_store(&admission_open, false);
	atomic_store(&configured, false);
	atomic_store(&fail_next, false);
	atomic_store(&block_pushes, false);
	memset(first_push, 0, sizeof(first_push));
	k_sem_reset(&in_sem);
	k_sem_reset(&out_sem);
}

/* Ordered FNV-1a of the first @p n int16 values of the first accepted push. */
uint32_t fake_sink_first_push_hash(size_t n)
{
	uint32_t hash = 0x811c9dc5UL;

	if (n > FAKE_SINK_MAX_SAMPLES) {
		n = FAKE_SINK_MAX_SAMPLES;
	}
	for (size_t i = 0; i < n; i++) {
		uint16_t u = (uint16_t)first_push[i];

		hash ^= (uint8_t)(u & 0xFF);
		hash *= 0x01000193UL;
		hash ^= (uint8_t)((u >> 8) & 0xFF);
		hash *= 0x01000193UL;
	}
	return hash;
}

uint32_t fake_sink_push_count(void)
{
	return atomic_load(&push_count);
}

uint32_t fake_sink_last_sample_count(void)
{
	return atomic_load(&last_sample_count);
}

uint32_t fake_sink_input_frames(void)
{
	return atomic_load(&input_frames);
}

uint32_t fake_sink_fail_pushes(void)
{
	return atomic_load(&fail_pushes);
}

void fake_sink_set_fail_next(bool fail)
{
	atomic_store(&fail_next, fail);
}

void fake_sink_set_block_pushes(bool block)
{
	atomic_store(&block_pushes, block);
}

void fake_sink_blocked_enter(void)
{
	k_sem_take(&in_sem, K_FOREVER);
}

void fake_sink_blocked_release(void)
{
	k_sem_give(&out_sem);
}

/* ── public audio_sink API ───────────────────────────────────────── */

int audio_sink_init(void)
{
	atomic_store(&configured, true);
	atomic_store(&admission_open, false);
	return 0;
}

int audio_sink_stream_open(void)
{
	atomic_store(&admission_open, true);
	return 0;
}

void audio_sink_stream_close(void)
{
	atomic_store(&admission_open, false);
}

void audio_sink_stop(void)
{
	atomic_store(&admission_open, false);
}

void audio_sink_set_input_frames(uint16_t frames)
{
	atomic_store(&input_frames, frames);
}

int audio_sink_push(const int16_t *data, size_t sample_count)
{
	if (data == NULL || sample_count == 0U || (sample_count & 1U)) {
		return -EINVAL;
	}

	if (atomic_load(&fail_next)) {
		atomic_store(&fail_next, false);
		atomic_fetch_add(&fail_pushes, 1U);
		return -ENOMEM;
	}

	if (atomic_load(&block_pushes)) {
		/* Park the lease inside the push: proves rx_close waits and
		 * that the session mutex is not held across the push. */
		k_sem_give(&in_sem);
		k_sem_take(&out_sem, K_FOREVER);
	}

	uint32_t idx = atomic_fetch_add(&push_count, 1U);

	if (idx == 0U) {
		memcpy(first_push, data, sample_count * sizeof(int16_t));
	}
	atomic_store(&last_sample_count, sample_count);
	return 0;
}
```

## src/fake_sink.h
```c
/*
 * Copyright (c) 2026
 * SPDX-License-Identifier: Apache-2.0
 *
 * Test knobs for the audio_sink.h fake used by the audio_stream_session
 * unit suite.
 */

#ifndef FAKE_SINK_H
#define FAKE_SINK_H

#include <stdbool.h>
#include <stddef.h>
#include <stdint.h>

void fake_sink_reset(void);
uint32_t fake_sink_first_push_hash(size_t n);
uint32_t fake_sink_push_count(void);
uint32_t fake_sink_last_sample_count(void);
uint32_t fake_sink_input_frames(void);
uint32_t fake_sink_fail_pushes(void);
void fake_sink_set_fail_next(bool fail);
void fake_sink_set_block_pushes(bool block);
void fake_sink_blocked_enter(void);   /* block until the fake enters a blocked push */
void fake_sink_blocked_release(void); /* let the blocked push finish */

#endif /* FAKE_SINK_H */
```

## src/fake_volume.c
```c
/*
 * Copyright (c) 2026
 * SPDX-License-Identifier: Apache-2.0
 *
 * Faithful audio_volume.h fake for the audio_stream_session unit suite.
 *
 * Identity volume (no scaling, never muted): the session's volume call
 * site is exercised (a per-call counter proves the ordering), while the
 * real audio_volume.c scaling/VCP behavior stays proven by the volume
 * suite.  Identity keeps the golden push hashes equal to the checked-in
 * decode fixtures, so the session tests prove decode->volume->push wiring
 * exactly.
 */

#include "audio_volume.h"

#include <stdatomic.h>
#include <stdbool.h>
#include <stdint.h>

static atomic_uint apply_count;

void fake_volume_reset(void)
{
	atomic_store(&apply_count, 0U);
}

uint32_t fake_volume_apply_count(void)
{
	return atomic_load(&apply_count);
}

int audio_volume_init(void)
{
	return 0;
}

uint8_t audio_volume_get(void)
{
	return 255U;
}

bool audio_volume_is_muted(void)
{
	return false;
}

void audio_volume_apply(int16_t *buf, size_t samples)
{
	(void)buf;
	(void)samples;
	atomic_fetch_add(&apply_count, 1U);
}
```

## src/fake_volume.h
```c
/*
 * Copyright (c) 2026
 * SPDX-License-Identifier: Apache-2.0
 *
 * Test knobs for the audio_volume.h fake used by the audio_stream_session
 * unit suite.
 */

#ifndef FAKE_VOLUME_H
#define FAKE_VOLUME_H

#include <stdint.h>

void fake_volume_reset(void);
uint32_t fake_volume_apply_count(void);

#endif /* FAKE_VOLUME_H */
```

## src/lc3_wrap.c
```c
/*
 * Copyright (c) 2026
 * SPDX-License-Identifier: Apache-2.0
 */

#include "lc3_wrap.h"

#include <stdbool.h>
#include <stddef.h>

/* Linker wrap of the real liblc3 entry point (see lc3_wrap.h). */
int __real_lc3_decode(lc3_decoder_t decoder, const void *in, int nbytes, enum lc3_pcm_format fmt,
		      void *pcm, int stride);

#define LC3_WRAP_MAX_FAIL 4

static lc3_decoder_t fail_decoders[LC3_WRAP_MAX_FAIL];
static int fail_count;
static int invocation_count;
static bool fail_all; /* R6 session suite: fail every lc3_decode call */

int __wrap_lc3_decode(lc3_decoder_t decoder, const void *in, int nbytes, enum lc3_pcm_format fmt,
		      void *pcm, int stride)
{
	invocation_count++;

	if (fail_all) {
		return -1;
	}

	for (int i = 0; i < fail_count; i++) {
		if (decoder == fail_decoders[i]) {
			return -1;
		}
	}

	return __real_lc3_decode(decoder, in, nbytes, fmt, pcm, stride);
}

void lc3_wrap_reset(void)
{
	fail_count = 0;
	invocation_count = 0;
	fail_all = false;
}

void lc3_wrap_fail_decoder(lc3_decoder_t decoder)
{
	if (fail_count < LC3_WRAP_MAX_FAIL) {
		fail_decoders[fail_count++] = decoder;
	}
}

void lc3_wrap_fail_all(bool fail)
{
	fail_all = fail;
}

int lc3_wrap_invocation_count(void)
{
	return invocation_count;
}
```

## src/lc3_wrap.h
```c
/*
 * Copyright (c) 2026
 * SPDX-License-Identifier: Apache-2.0
 *
 * Linker-wrap seam for lc3_decode (see lc3_wrap.c).  The session suite
 * uses the fail-all mode: the production session owns the decoder
 * pointers internally, so hard-failure tests fail EVERY lc3_decode call
 * and assert the observable outcome (decode-error accounting, no push,
 * event consumed) rather than inspecting private state.
 */

#ifndef LC3_WRAP_H
#define LC3_WRAP_H

#include <stdbool.h>

#include "lc3.h"

int __real_lc3_decode(lc3_decoder_t decoder, const void *in, int nbytes, enum lc3_pcm_format fmt,
		      void *pcm, int stride);

void lc3_wrap_reset(void);
void lc3_wrap_fail_decoder(lc3_decoder_t decoder);
void lc3_wrap_fail_all(bool fail);
int lc3_wrap_invocation_count(void);

#endif /* LC3_WRAP_H */
```
