## CMakeLists.txt
```
cmake_minimum_required(VERSION 3.20.0)
find_package(Zephyr REQUIRED HINTS $ENV{ZEPHYR_BASE})
project(test_audio_shell)

# Compile and execute the REAL production shell command bodies
# (src/audio_shell.c + src/bt_shell.c) registered normally and driven
# through the Zephyr dummy shell backend.  Subsystem APIs
# (stats/drift/volume/sink/unpair) are mocked; audio_perf.c is compiled
# for real so queue fields and the deadline percentage come from
# production instrumentation.
#
# The `unit.audio_shell_noperf` testcase disables CONFIG_AUDIO_PERF_MEASUREMENT
# so the same production file is proven without measurement enabled.
target_sources(app PRIVATE
  src/test_audio_shell.c
  src/fake_audio_shell_deps.c
  ${CMAKE_CURRENT_SOURCE_DIR}/../../../src/audio_shell.c
  ${CMAKE_CURRENT_SOURCE_DIR}/../../../src/bt_shell.c
)

zephyr_sources_ifdef(CONFIG_AUDIO_PERF_MEASUREMENT
  ${CMAKE_CURRENT_SOURCE_DIR}/../../../src/audio_perf.c
)

target_include_directories(app PRIVATE
  src
  ${CMAKE_CURRENT_SOURCE_DIR}/../../../src
)

# AUDIO_SHELL_TEST exposes the narrow test seam wrappers.  The resampler
# variant string is chosen by test-only compile definition (production
# chooses it via the AUDIO_RESAMPLER Kconfig choice); the nRF54 suite
# compiles the ASRC linear variant instead.
target_compile_definitions(app PRIVATE
  AUDIO_SHELL_TEST=1
  CONFIG_AUDIO_RESAMPLER_IDENTITY=1
)
```

## Kconfig
```
source "Kconfig.zephyr"

# Test-local definition of the performance Kconfig used by prj.conf
# (mirror of the production app Kconfig; needed because test apps do
# not include the production app Kconfig).
config AUDIO_PERF_MEASUREMENT
	bool "Audio performance instrumentation"
	default y

config AUDIO_PERF_DEADLINE_US
	int "Per-path deadline threshold in microseconds"
	default 10000
```

## prj.conf
```kconfig
CONFIG_ZTEST=y
CONFIG_SHELL=y
CONFIG_SHELL_BACKEND_SERIAL=n
CONFIG_SHELL_BACKEND_DUMMY=y
CONFIG_SHELL_BACKEND_DUMMY_BUF_SIZE=2048
CONFIG_LOG=n
CONFIG_AUDIO_PERF_MEASUREMENT=y
CONFIG_AUDIO_PERF_DEADLINE_US=10000
```

## src/audio_shell_test.h
```c
/*
 * Copyright (c) 2026
 * SPDX-License-Identifier: Apache-2.0
 *
 * Declarations of the AUDIO_SHELL_TEST seam wrappers compiled into
 * src/audio_shell.c when AUDIO_SHELL_TEST is defined (test builds only;
 * never present in production firmware).
 */

#ifndef AUDIO_SHELL_TEST_H
#define AUDIO_SHELL_TEST_H

#include <stddef.h>

#include <zephyr/shell/shell.h>

int audio_shell_test_cmd_status(const struct shell *sh, size_t argc, char **argv);
int audio_shell_test_cmd_reset_stats(const struct shell *sh, size_t argc, char **argv);
int audio_shell_test_cmd_stop(const struct shell *sh, size_t argc, char **argv);
int audio_shell_test_cmd_perf(const struct shell *sh, size_t argc, char **argv);
int audio_shell_test_cmd_perf_reset(const struct shell *sh, size_t argc, char **argv);
int audio_shell_test_cmd_bt_unpair(const struct shell *sh, size_t argc, char **argv);
int audio_shell_test_cmd_bt_identity(const struct shell *sh, size_t argc, char **argv);
int audio_shell_test_cmd_bt_bonds(const struct shell *sh, size_t argc, char **argv);

#endif /* AUDIO_SHELL_TEST_H */
```

## src/fake_audio_shell_deps.c
```c
/*
 * Copyright (c) 2026
 * SPDX-License-Identifier: Apache-2.0
 *
 * Mock implementations of the public subsystem APIs that
 * src/audio_shell.c calls.  audio_perf_* comes from the real production
 * audio_perf.c; everything else is controlled here.
 */

#include <stdbool.h>
#include <errno.h>
#include <stdint.h>
#include <string.h>

#include <zephyr/bluetooth/addr.h>
#include <zephyr/bluetooth/bluetooth.h>
#include <zephyr/sys/util.h>

#include "audio_drift.h"
#include "audio_sink.h"
#include "audio_stats.h"
#include "audio_volume.h"
#include "fake_audio_shell_deps.h"

/* Forward declarations of counters defined below (sink/unpair sections). */
static int sink_stop_calls;
static int unpair_result;
static int unpair_calls;
static int bap_path_stop_calls;
static struct bt_bap_iso_link_quality test_iso_link_quality[TEST_SHELL_MAX_ISO_LINK_QUALITY];
static size_t test_iso_link_quality_count;
static int test_iso_link_quality_result;

/* ---- bt identity (fake bt_id_get) ---- */

static bt_addr_le_t test_identities[TEST_SHELL_MAX_IDENTITIES];
static size_t test_identity_count;

/* The production bt_shell identity command calls this; the test suites
 * script the identity table.  bt_addr_le_to_str() itself is the real
 * inline formatter from the public addr.h header, never mocked. */
void bt_id_get(bt_addr_le_t *addrs, size_t *count)
{
	size_t n = MIN(*count, test_identity_count);

	memcpy(addrs, test_identities, n * sizeof(bt_addr_le_t));
	*count = test_identity_count;
}

void test_shell_set_identities(const bt_addr_le_t *ids, size_t count)
{
	size_t n = MIN(count, TEST_SHELL_MAX_IDENTITIES);

	test_identity_count = n;
	memcpy(test_identities, ids, n * sizeof(bt_addr_le_t));
}

const bt_addr_le_t *test_shell_identity_at(size_t index)
{
	if (index >= test_identity_count) {
		return NULL;
	}
	return &test_identities[index];
}

size_t test_shell_identity_count(void)
{
	return test_identity_count;
}

/* ---- stats ---- */

static struct audio_stats test_stats;
static int stats_reset_calls;

struct audio_stats audio_stats_get(void)
{
	return test_stats;
}

void audio_stats_reset(void)
{
	stats_reset_calls++;
}

void test_shell_set_stats(const struct audio_stats *s)
{
	test_stats = *s;
}

int test_shell_stats_reset_calls(void)
{
	return stats_reset_calls;
}

/* ---- call counters (reset between tests) ---- */

void test_shell_reset_counters(void)
{
	stats_reset_calls = 0;
	sink_stop_calls = 0;
	unpair_calls = 0;
	unpair_result = 0;
	bap_path_stop_calls = 0;
	test_iso_link_quality_count = 0U;
	test_iso_link_quality_result = 0;
	/* Default identity table: exactly one usable public identity so the
	 * identity command never fails by accident in unrelated tests. */
	test_identities[0].type = BT_ADDR_LE_PUBLIC;
	memset(test_identities[0].a.val, 0, sizeof(test_identities[0].a.val));
	test_identities[0].a.val[0] = 0xAA;
	test_identities[0].a.val[5] = 0x01;
	test_identity_count = 1;
}

/* ---- drift ---- */

static const char *drift_state = "INIT";
static int32_t drift_ppm;

const char *audio_drift_state_str(void)
{
	return drift_state;
}

int32_t audio_drift_get_ppm(void)
{
	return drift_ppm;
}

void test_shell_set_drift(const char *state, int32_t ppm)
{
	drift_state = state;
	drift_ppm = ppm;
}

/* ---- volume ---- */

static uint8_t vol_value;
static bool muted;

uint8_t audio_volume_get(void)
{
	return vol_value;
}

bool audio_volume_is_muted(void)
{
	return muted;
}

void test_shell_set_volume(uint8_t vol, bool m)
{
	vol_value = vol;
	muted = m;
}

/* ---- sink ---- */

void audio_sink_stop(void)
{
	sink_stop_calls++;
}

int test_shell_sink_stop_calls(void)
{
	return sink_stop_calls;
}

/* ---- BAP audio-path stop (shell 'audio stop' routes through it) ---- */

void bt_bap_audio_path_stop(void)
{
	bap_path_stop_calls++;
}

int test_shell_bap_path_stop_calls(void)
{
	return bap_path_stop_calls;
}

/* ---- bt unpair (production pairing-mode reset) ---- */

int bt_bap_pairing_reset(void)
{
	unpair_calls++;
	return unpair_result;
}

void test_shell_set_unpair_result(int result)
{
	unpair_result = result;
}

int test_shell_unpair_calls(void)
{
	return unpair_calls;
}

/* ---- bt ISO link quality (fake public API for shell boundary tests) ---- */

int bt_bap_iso_link_quality_get_active(struct bt_bap_iso_link_quality *snapshots, size_t capacity,
				       size_t *count)
{
	if (test_iso_link_quality_result != 0) {
		return test_iso_link_quality_result;
	}
	if (capacity < test_iso_link_quality_count) {
		return -ENOSPC;
	}

	memcpy(snapshots, test_iso_link_quality, test_iso_link_quality_count * sizeof(*snapshots));
	*count = test_iso_link_quality_count;
	return 0;
}

void test_shell_set_iso_link_quality(const struct bt_bap_iso_link_quality *snapshots, size_t count,
				     int result)
{
	size_t n = MIN(count, TEST_SHELL_MAX_ISO_LINK_QUALITY);

	test_iso_link_quality_count = n;
	test_iso_link_quality_result = result;
	memcpy(test_iso_link_quality, snapshots, n * sizeof(*snapshots));
}

/* ---- perf ---- */

void test_shell_perf_reset_state(void)
{
	/* The shell test drives real audio_perf.c; nothing to reset here. */
}
```

## src/fake_audio_shell_deps.h
```c
/*
 * Copyright (c) 2026
 * SPDX-License-Identifier: Apache-2.0
 *
 * Test-local fakes of the subsystem APIs consumed by src/audio_shell.c,
 * with knobs for the shell test suites.  audio_perf.c is compiled for
 * real (production instrumentation); everything else is faked here.
 */

#ifndef FAKE_AUDIO_SHELL_DEPS_H
#define FAKE_AUDIO_SHELL_DEPS_H

#include <stdbool.h>
#include <stddef.h>
#include <stdint.h>

#include <zephyr/bluetooth/addr.h>

#include "bt_bap.h"
#include "audio_stats.h"

/* ---- stats ---- */
void test_shell_set_stats(const struct audio_stats *s);
int test_shell_stats_reset_calls(void);

/* ---- call counters (reset between tests) ---- */
void test_shell_reset_counters(void);

/* ---- drift ---- */
void test_shell_set_drift(const char *state, int32_t ppm);

/* ---- volume ---- */
void test_shell_set_volume(uint8_t vol, bool muted);

/* ---- sink ---- */
int test_shell_sink_stop_calls(void);

/* ---- BAP audio-path stop (R1) ---- */
int test_shell_bap_path_stop_calls(void);

/* ---- bt unpair ---- */
void test_shell_set_unpair_result(int result);
int test_shell_unpair_calls(void);

/* ---- bt ISO link quality ---- */
#define TEST_SHELL_MAX_ISO_LINK_QUALITY 2
void test_shell_set_iso_link_quality(const struct bt_bap_iso_link_quality *snapshots, size_t count,
				     int result);

/* ---- bt identity ---- */
/* Fake bt_id_get() identity table.  test_shell_set_identities() copies up
 * to TEST_SHELL_MAX_IDENTITIES entries; test_shell_reset_counters() resets
 * to exactly one usable public identity so unrelated tests never observe
 * "Identity unavailable." by accident. */
#define TEST_SHELL_MAX_IDENTITIES 8
void test_shell_set_identities(const bt_addr_le_t *ids, size_t count);
const bt_addr_le_t *test_shell_identity_at(size_t index);
size_t test_shell_identity_count(void);

/* ---- perf (real production audio_perf.c) ---- */
void test_shell_perf_reset_state(void);

#endif /* FAKE_AUDIO_SHELL_DEPS_H */
```

## src/test_audio_shell.c
```c
/*
 * Copyright (c) 2026
 * SPDX-License-Identifier: Apache-2.0
 *
 * Direct tests of the production shell command bodies
 * (src/audio_shell.c) through the real Zephyr dummy backend and
 * shell_execute_cmd().  Subsystem state is controlled via the fakes;
 * audio_perf.c is production source with deterministic injection.
 */

#include <errno.h>
#include <stdbool.h>
#include <stdint.h>
#include <stdio.h>
#include <string.h>

#include <zephyr/autoconf.h>
#include <zephyr/bluetooth/addr.h>
#include <zephyr/kernel.h>
#include <zephyr/shell/shell.h>
#include <zephyr/shell/shell_dummy.h>
#include <zephyr/ztest.h>

#include "audio_perf.h"
#include "audio_shell_test.h"
#include "fake_audio_shell_deps.h"

/* ── helpers ─────────────────────────────────────────────────────── */

/* The dummy backend's shell thread runs at the lowest application
 * priority and may not have executed shell_start() before the test
 * thread does; drive the real shell state machine into ACTIVE
 * explicitly.  -ENOTSUP means it is already active. */
static const struct shell *active_shell(void)
{
	const struct shell *sh = shell_backend_dummy_get_ptr();
	int ret = shell_start(sh);

	zassert_true(ret == 0 || ret == -ENOTSUP, "shell_start: %d", ret);
	return sh;
}

static const char *run_cmd(const char *cmd, int *rc)
{
	const struct shell *sh = active_shell();

	shell_backend_dummy_clear_output(sh);
	int ret = shell_execute_cmd(sh, cmd);

	if (rc != NULL) {
		*rc = ret;
	}
	return shell_backend_dummy_get_output(sh, &(size_t){0});
}

static void assert_output_contains(const char *out, const char *needle)
{
	zassert_not_null(strstr(out, needle), "output missing '%s':\n%s", needle, out);
}

static void assert_output_has_line(const char *out, const char *line)
{
	char buf[256];
	size_t len = strlen(line);

	zassert_true(len < sizeof(buf) - 2, "line too long: %s", line);
	snprintf(buf, sizeof(buf), "\r\n%s\r\n", line);
	assert_output_contains(out, buf);
}

/* ── suite ───────────────────────────────────────────────────────── */

ZTEST_SUITE(audio_shell, NULL, NULL, NULL, NULL, NULL);

/* Config-off native shell behavior: bond inventory remains unavailable when
 * pairing input is disabled.  This does not select a legacy receiver target. */
ZTEST(audio_shell, test_bt_bonds_feature_off_unavailable)
{
	test_shell_reset_counters();
	int rc = 0;
	const char *out = run_cmd("bt bonds", &rc);

	zassert_equal(rc, -ENOTSUP);
	assert_output_contains(out, "Bond inventory unavailable.");
}

/* audio status: exact field order/labels and values. */
ZTEST(audio_shell, test_status_exact_fields)
{
	test_shell_reset_counters();
	struct audio_stats s = {
		.total_frames = 1234,
		.plc_frames = 56,
		.decode_errors = 2,
		.i2s_underruns = 3,
		.stream_resets = 1,
		.empty_sdus = 4,
	};

	test_shell_set_stats(&s);
	test_shell_set_drift("STEADY", -5);
	test_shell_set_volume(195, true);

	const char *out = run_cmd("audio status", NULL);

	assert_output_has_line(out, "--- Audio status ---");
	assert_output_has_line(out, "  Frames decoded : 1234");
	assert_output_has_line(out, "  PLC frames     : 56 (4%)");
	assert_output_has_line(out, "  Decode errors  : 2");
	assert_output_has_line(out, "  I2S underruns  : 3");
	assert_output_has_line(out, "  Stream resets  : 1");
	assert_output_has_line(out, "  Empty SDUs     : 4");
	assert_output_has_line(out, "  Drift state    : STEADY");
	assert_output_has_line(out, "  Drift ppm      : -5");
	assert_output_has_line(out, "  Resampler      : identity");
	assert_output_has_line(out, "  Volume         : 195 / 255 (muted)");
}

/* Zero frames: no division by zero, explicit (0%). */
ZTEST(audio_shell, test_status_zero_frames_no_div0)
{
	test_shell_reset_counters();
	struct audio_stats s = {0};

	test_shell_set_stats(&s);
	test_shell_set_drift("INIT", 0);
	test_shell_set_volume(0, false);

	const char *out = run_cmd("audio status", NULL);

	assert_output_has_line(out, "  Frames decoded : 0");
	assert_output_has_line(out, "  PLC frames     : 0 (0%)");
	assert_output_has_line(out, "  Empty SDUs     : 0");
}

/* Unmuted volume: no suffix. */
ZTEST(audio_shell, test_status_unmuted_no_suffix)
{
	test_shell_reset_counters();
	struct audio_stats s = {.total_frames = 10};

	test_shell_set_stats(&s);
	test_shell_set_volume(200, false);

	const char *out = run_cmd("audio status", NULL);

	assert_output_has_line(out, "  Volume         : 200 / 255");
	zassert_is_null(strstr(out, "(muted)"), "unexpected muted suffix:\n%s", out);
}

/* Large plc/total: uint64 numerator must not overflow.
 * 4000000000 * 100 would wrap in uint32 (0x21D78400 % 2^32 = 0x21D78400*...);
 * expected truncating result: 4000000000 * 100 / 4294967295 = 93. */
ZTEST(audio_shell, test_status_large_percentage_no_overflow)
{
	test_shell_reset_counters();
	struct audio_stats s = {
		.total_frames = UINT32_MAX,
		.plc_frames = 4000000000U,
	};

	test_shell_set_stats(&s);

	const char *out = run_cmd("audio status", NULL);

	assert_output_has_line(out, "  PLC frames     : 4000000000 (93%)");
}

/* audio perf: path labels, exact values, one-decimal deadline %. */
#if defined(CONFIG_AUDIO_PERF_MEASUREMENT)
ZTEST(audio_shell, test_perf_exact_values_and_labels)
{
	test_shell_reset_counters();
	audio_perf_reset();

	/* native_sim: 1 cycle == 1 us (SYS_CLOCK_HW_CYCLES_PER_SEC=1000000),
	 * so max_us == max_cycles and permille = max_us * 1000 / 10000. */
	audio_perf_test_inject_cycles(AUDIO_PERF_PATH_ISO_RECV, 10000);
	audio_perf_test_inject_cycles(AUDIO_PERF_PATH_LC3_DECODE, 2000);
	audio_perf_queue_sample(3, 240);
	audio_perf_push_failure();
	audio_perf_repeat_fallback();
	audio_perf_asrc_capacity_failure();
	audio_perf_i2s_write_failure(-EIO);
	audio_perf_i2s_write_failure(-ENOMSG);
	audio_perf_i2s_write_failure(-EBUSY);
	audio_perf_i2s_dma_restart();
	audio_perf_i2s_dma_restart();
	audio_perf_test_inject_rx_callback_start(100);
	audio_perf_test_inject_rx_callback_start(125);
	audio_perf_test_inject_i2s_dma_start(1000);
	audio_perf_test_inject_i2s_write(1125, 12, true);

	const char *out = run_cmd("audio perf", NULL);

	assert_output_has_line(out, "--- Performance ---");
	assert_output_has_line(
		out, "  Path          Count   Avg(cyc)  Avg(us)  Max(cyc)  Max(us)  %deadline");
	/* 10000 us * 1000 / 10000 = 1000 permille -> 100.0% */
	assert_output_contains(out, "iso_recv");
	assert_output_contains(out, "100.0%");
	assert_output_contains(out, "lc3_decode");
	/* 2000 us * 1000 / 10000 = 200 permille -> 20.0% */
	assert_output_contains(out, "20.0%");
	assert_output_contains(out, "volume");
	assert_output_contains(out, "sink_push");
	assert_output_contains(out, "asrc");
	assert_output_has_line(out, "  Queue:");
	assert_output_has_line(out, "    Slab free     : 3 / 3 (min/max)");
	assert_output_has_line(out, "    Output frames : 240 / 240 (min/max)");
	assert_output_has_line(out, "    Output blocks : 1");
	assert_output_has_line(out, "    Push failures : 1");
	assert_output_has_line(out, "    Repeat fb     : 1");
	assert_output_has_line(out, "    ASRC cap fail : 1");
	char i2s_line[128];
	snprintf(i2s_line, sizeof(i2s_line), "    I2S write fail : total=3 eio=1 enomsg=1 last=%d",
		 -EBUSY);
	assert_output_has_line(out, i2s_line);
	assert_output_has_line(out, "    I2S DMA restart: 2");
	assert_output_has_line(out, "    RX callback gap: 25 us (max)");
	assert_output_has_line(out, "    I2S write gap  : 137 us (max)");
	assert_output_has_line(out, "    I2S write time : 12 us (max)");
}

/* audio perf: zero counts average to zero; no divide by zero. */
ZTEST(audio_shell, test_perf_zero_counts)
{
	test_shell_reset_counters();
	audio_perf_reset();

	const char *out = run_cmd("audio perf", NULL);

	assert_output_contains(out, "iso_recv");
	assert_output_contains(out, "0.0%");
	assert_output_has_line(out, "    Output blocks : 0");
	assert_output_has_line(out, "    I2S write fail : total=0 eio=0 enomsg=0 last=0");
	assert_output_has_line(out, "    I2S DMA restart: 0");
	assert_output_has_line(out, "    RX callback gap: 0 us (max)");
	assert_output_has_line(out, "    I2S write gap  : 0 us (max)");
	assert_output_has_line(out, "    I2S write time : 0 us (max)");
}

/* audio perf: avg over multiple injections uses integer truncation. */
ZTEST(audio_shell, test_perf_average_integer_truncation)
{
	test_shell_reset_counters();
	audio_perf_reset();

	/* count=2, total=15000, avg=7500, max=10000 -> 100.0% */
	audio_perf_test_inject_cycles(AUDIO_PERF_PATH_VOLUME, 5000);
	audio_perf_test_inject_cycles(AUDIO_PERF_PATH_VOLUME, 10000);

	const char *out = run_cmd("audio perf", NULL);

	assert_output_contains(out, "7500");
	assert_output_contains(out, "100.0%");
}

/* audio perf-reset: zeroes production perf state observably. */
ZTEST(audio_shell, test_perf_reset_observable_zeroing)
{
	test_shell_reset_counters();
	audio_perf_reset();
	audio_perf_test_inject_cycles(AUDIO_PERF_PATH_SINK_PUSH, 10000);
	audio_perf_i2s_write_failure(-EIO);
	audio_perf_i2s_dma_restart();

	int rc = -1;
	const char *out = run_cmd("audio perf-reset", &rc);

	zassert_equal(rc, 0);
	assert_output_has_line(out, "Perf counters cleared.");

	out = run_cmd("audio perf", NULL);
	assert_output_contains(out, "sink_push");
	/* After reset the path must be zeroed: count 0, max 0 -> 0.0%. */
	assert_output_contains(out, "0.0%");
	assert_output_has_line(out, "    I2S write fail : total=0 eio=0 enomsg=0 last=0");
	assert_output_has_line(out, "    I2S DMA restart: 0");
	assert_output_has_line(out, "    RX callback gap: 0 us (max)");
	assert_output_has_line(out, "    I2S write gap  : 0 us (max)");
	assert_output_has_line(out, "    I2S write time : 0 us (max)");
}
#else  /* !CONFIG_AUDIO_PERF_MEASUREMENT */
/* Measurement disabled: production snapshot is a zeroed no-op and no
 * deadline exists.  The command must print a truthful unavailable (zero)
 * deadline percentage — never a fake value computed against a made-up
 * deadline — and stay division-safe.  Table shape stays identical. */
ZTEST(audio_shell, test_perf_disabled_truthful_unavailable)
{
	test_shell_reset_counters();
	const char *out = run_cmd("audio perf", NULL);

	assert_output_has_line(out, "--- Performance ---");
	assert_output_contains(out, "iso_recv");
	assert_output_contains(out, "lc3_decode");
	assert_output_contains(out, "volume");
	assert_output_contains(out, "sink_push");
	assert_output_contains(out, "asrc");
	/* Every path: count 0 and a zero/unavailable deadline percentage. */
	assert_output_contains(out, "0.0%");
	assert_output_has_line(out, "  Queue:");
	assert_output_has_line(out, "    Slab free     : 0 / 0 (min/max)");
	assert_output_has_line(out, "    Output frames : 0 / 0 (min/max)");
	assert_output_has_line(out, "    Output blocks : 0");
	assert_output_has_line(out, "    Push failures : 0");
	assert_output_has_line(out, "    Repeat fb     : 0");
	assert_output_has_line(out, "    ASRC cap fail : 0");
	assert_output_has_line(out, "    I2S write fail : total=0 eio=0 enomsg=0 last=0");
	assert_output_has_line(out, "    I2S DMA restart: 0");
	assert_output_has_line(out, "    RX callback gap: 0 us (max)");
	assert_output_has_line(out, "    I2S write gap  : 0 us (max)");
	assert_output_has_line(out, "    I2S write time : 0 us (max)");
}
#endif /* CONFIG_AUDIO_PERF_MEASUREMENT */

/* audio reset-stats: calls the dependency exactly once, stable text. */
ZTEST(audio_shell, test_reset_stats_exactly_once)
{
	test_shell_reset_counters();
	zassert_equal(test_shell_stats_reset_calls(), 0);

	int rc = -1;
	const char *out = run_cmd("audio reset-stats", &rc);

	zassert_equal(rc, 0);
	assert_output_has_line(out, "Stats cleared.");
	zassert_equal(test_shell_stats_reset_calls(), 1);
}

/* audio stop: calls the BAP audio-path stop exactly once; the old direct
 * sink stop is no longer called; output and return stay exact. */
ZTEST(audio_shell, test_stop_exactly_once)
{
	test_shell_reset_counters();
	zassert_equal(test_shell_bap_path_stop_calls(), 0);
	zassert_equal(test_shell_sink_stop_calls(), 0);

	int rc = -1;
	const char *out = run_cmd("audio stop", &rc);

	zassert_equal(rc, 0);
	assert_output_has_line(out, "I2S stopped; drift reset.");
	zassert_equal(test_shell_bap_path_stop_calls(), 1, "BAP path stop called exactly once");
	zassert_equal(test_shell_sink_stop_calls(), 0, "direct sink stop not called");
}

/* bt unpair success: zero result and stable pairing-reset text. */
ZTEST(audio_shell, test_bt_unpair_success)
{
	test_shell_reset_counters();
	test_shell_set_unpair_result(0);

	int rc = -1;
	const char *out = run_cmd("bt unpair", &rc);

	zassert_equal(rc, 0);
	assert_output_has_line(out, "Pairing mode reset: bonds cleared; open pairing enabled.");
	zassert_equal(test_shell_unpair_calls(), 1);
}

/* bt unpair failure: error text and exact negative errno propagation. */
ZTEST(audio_shell, test_bt_unpair_error_propagation)
{
	test_shell_reset_counters();
	test_shell_set_unpair_result(-EACCES);

	int rc = 0;
	const char *out = run_cmd("bt unpair", &rc);

	zassert_equal(rc, -EACCES);
	assert_output_contains(out, "bt_bap_pairing_reset failed: -13");
}

/* The AUDIO_SHELL_TEST wrapper seam behaves identically to the
 * registered command dispatch for the same handler. */
ZTEST(audio_shell, test_wrapper_seam_matches_dispatch)
{
	test_shell_reset_counters();
	struct audio_stats s = {.total_frames = 7, .plc_frames = 1};

	test_shell_set_stats(&s);
	test_shell_set_drift("STEADY", 0);
	test_shell_set_volume(100, false);

	const struct shell *sh = active_shell();
	int rc = -1;

	shell_backend_dummy_clear_output(sh);
	rc = audio_shell_test_cmd_status(sh, 1, NULL);
	zassert_equal(rc, 0);

	const char *out = run_cmd("audio status", NULL);

	assert_output_has_line(out, "  Frames decoded : 7");
	assert_output_has_line(out, "  PLC frames     : 1 (14%)");
}

/* Config-off native suite compiles only audio/bt shell TUs (no FLPR shell or
 * acceptance TU).  FLPR acceptance commands must not exist in the registry:
 * unknown command, never acceptance output.  No legacy target is implied. */
ZTEST(audio_shell, test_flpr_acceptance_absent_config_off)
{
	test_shell_reset_counters();

	int rc = 0;
	const char *out = run_cmd("flpr ring status", &rc);

	zassert_not_equal(rc, 0,
			  "flpr ring status must not resolve without "
			  "CONFIG_AUDIO_ACCEPTANCE_DIAGNOSTICS");
	zassert_is_null(strstr(out, "FLPR PCM rings"), "acceptance output must not appear:\n%s",
			out);

	rc = 0;
	out = run_cmd("flpr hang", &rc);
	zassert_not_equal(rc, 0,
			  "flpr hang must not resolve without "
			  "CONFIG_AUDIO_ACCEPTANCE_DIAGNOSTICS");

	rc = 0;
	out = run_cmd("flpr status", &rc);
	zassert_not_equal(rc, 0,
			  "flpr status must not resolve without "
			  "CONFIG_SOC_NRF54L15 FLPR TUs");
}

/* ── bt identity (feature-off build) ─────────────────────────────── */

/* Canonical identity bytes that render as "DB:A6:0C:05:A2:AA": the shell
 * prints val[5]..val[0], so the array holds the reversed byte order. */
static void set_identity(bt_addr_le_t *id, uint8_t type, uint8_t b0, uint8_t b1, uint8_t b2,
			 uint8_t b3, uint8_t b4, uint8_t b5)
{
	id->type = type;
	id->a.val[0] = b0;
	id->a.val[1] = b1;
	id->a.val[2] = b2;
	id->a.val[3] = b3;
	id->a.val[4] = b4;
	id->a.val[5] = b5;
}

/* Success, public type: exact "Identity: DB:A6:0C:05:A2:AA (public)" line,
 * zero result. */
ZTEST(audio_shell, test_bt_identity_success_public)
{
	test_shell_reset_counters();
	bt_addr_le_t ids[1];

	set_identity(&ids[0], BT_ADDR_LE_PUBLIC, 0xAA, 0xA2, 0x05, 0x0C, 0xA6, 0xDB);
	test_shell_set_identities(ids, 1);

	int rc = -1;
	const char *out = run_cmd("bt identity", &rc);

	zassert_equal(rc, 0);
	assert_output_has_line(out, "Identity: DB:A6:0C:05:A2:AA (public)");
}

/* Success, random type: exact "(random)" suffix. */
ZTEST(audio_shell, test_bt_identity_success_random)
{
	test_shell_reset_counters();
	bt_addr_le_t ids[1];

	set_identity(&ids[0], BT_ADDR_LE_RANDOM, 0xAA, 0xA2, 0x05, 0x0C, 0xA6, 0xDB);
	test_shell_set_identities(ids, 1);

	int rc = -1;
	const char *out = run_cmd("bt identity", &rc);

	zassert_equal(rc, 0);
	assert_output_has_line(out, "Identity: DB:A6:0C:05:A2:AA (random)");
}

/* Identity aliases still expose only public/random on runner shell wire. */
ZTEST(audio_shell, test_bt_identity_public_id_normalizes_to_public)
{
	test_shell_reset_counters();
	bt_addr_le_t ids[1];

	set_identity(&ids[0], BT_ADDR_LE_PUBLIC_ID, 0xAA, 0xA2, 0x05, 0x0C, 0xA6, 0xDB);
	test_shell_set_identities(ids, 1);

	int rc = -1;
	const char *out = run_cmd("bt identity", &rc);

	zassert_equal(rc, 0);
	assert_output_has_line(out, "Identity: DB:A6:0C:05:A2:AA (public)");
}

/* No usable identity (empty table): shell error text and -ENOENT, never a
 * fabricated address. */
ZTEST(audio_shell, test_bt_identity_no_identity_fails)
{
	test_shell_reset_counters();
	test_shell_set_identities(NULL, 0);

	int rc = 0;
	const char *out = run_cmd("bt identity", &rc);

	zassert_equal(rc, -ENOENT);
	assert_output_contains(out, "Identity unavailable.");
}

/* All identities are BT_ADDR_LE_ANY (deleted identities): same failure as
 * an empty table. */
ZTEST(audio_shell, test_bt_identity_all_any_fails)
{
	test_shell_reset_counters();
	bt_addr_le_t ids[2];

	memset(&ids[0], 0, sizeof(ids[0]));
	memset(&ids[1], 0, sizeof(ids[1]));
	test_shell_set_identities(ids, 2);

	int rc = 0;
	const char *out = run_cmd("bt identity", &rc);

	zassert_equal(rc, -ENOENT);
	assert_output_contains(out, "Identity unavailable.");
}

/* A non-public zero address is not BT_ADDR_LE_ANY and must remain a valid
 * random identity for the shell protocol. */
ZTEST(audio_shell, test_bt_identity_zero_random_is_usable)
{
	test_shell_reset_counters();
	bt_addr_le_t ids[1];

	memset(&ids[0], 0, sizeof(ids[0]));
	ids[0].type = BT_ADDR_LE_RANDOM;
	test_shell_set_identities(ids, 1);

	int rc = -1;
	const char *out = run_cmd("bt identity", &rc);

	zassert_equal(rc, 0);
	assert_output_has_line(out, "Identity: 00:00:00:00:00:00 (random)");
}

/* Deleted identity 0 is skipped; the first usable identity is printed. */
ZTEST(audio_shell, test_bt_identity_skips_any_and_prints_next)
{
	test_shell_reset_counters();
	bt_addr_le_t ids[2];

	memset(&ids[0], 0, sizeof(ids[0]));
	set_identity(&ids[1], BT_ADDR_LE_PUBLIC, 0xAA, 0xA2, 0x05, 0x0C, 0xA6, 0xDB);
	test_shell_set_identities(ids, 2);

	int rc = -1;
	const char *out = run_cmd("bt identity", &rc);

	zassert_equal(rc, 0);
	assert_output_has_line(out, "Identity: DB:A6:0C:05:A2:AA (public)");
}

/* The AUDIO_SHELL_TEST wrapper seam dispatches identically to the
 * registered command. */
ZTEST(audio_shell, test_bt_identity_wrapper_seam_matches_dispatch)
{
	test_shell_reset_counters();
	bt_addr_le_t ids[1];

	set_identity(&ids[0], BT_ADDR_LE_RANDOM, 0xAA, 0xA2, 0x05, 0x0C, 0xA6, 0xDB);
	test_shell_set_identities(ids, 1);

	const struct shell *sh = active_shell();

	shell_backend_dummy_clear_output(sh);
	int rc = audio_shell_test_cmd_bt_identity(sh, 1, NULL);

	zassert_equal(rc, 0);
	const char *out = shell_backend_dummy_get_output(sh, &(size_t){0});

	/* Direct handler invocation does not add the command-dispatch framing
	 * (leading CRLF), unlike run_cmd(). The registered-command tests above
	 * pin that full public line; this seam test pins the handler payload. */
	assert_output_contains(out, "Identity: DB:A6:0C:05:A2:AA (random)");
}
```
